
PHDRS
{
  text PT_LOAD ;
  rodata PT_LOAD ;
  data PT_LOAD ;
  dynamic PT_DYNAMIC ;
}

SECTIONS
{
  . = SIZEOF_HEADERS;
  .text : {
    *pump_recovered.pump_recovered.*-cgu.0.rcgu.o(".text._ZN103_$LT$anchor_lang..accounts..interface..Interface$LT$T$GT$$u20$as$u20$anchor_lang..Accounts$LT$B$GT$$GT$12try_accounts17h2b1e4d981c1e1263E")
    *pump_recovered.pump_recovered.*-cgu.0.rcgu.o(".text._ZN118_$LT$anchor_lang..accounts..interface_account..InterfaceAccount$LT$T$GT$$u20$as$u20$anchor_lang..Accounts$LT$B$GT$$GT$12try_accounts17h22664528d8d30db5E")
    *pump_recovered.pump_recovered.*-cgu.0.rcgu.o(".text._ZN118_$LT$anchor_lang..accounts..interface_account..InterfaceAccount$LT$T$GT$$u20$as$u20$anchor_lang..Accounts$LT$B$GT$$GT$12try_accounts17h05add979dc509abcE")
    *pump_recovered.pump_recovered.*-cgu.0.rcgu.o(".text._ZN11anchor_lang5error5Error11with_values17h671cdb2ca8d46d39E")
    *pump_recovered.pump_recovered.*-cgu.0.rcgu.o(".text._ZN11anchor_lang5error5Error11with_values17h18907f21d3f95087E")
    *pump_recovered.pump_recovered.*-cgu.0.rcgu.o(".text._ZN11anchor_lang5error5Error11with_values17hd453c060b3c9d466E")
    *pump_recovered.pump_recovered.*-cgu.0.rcgu.o(".text._ZN11anchor_lang5error5Error11with_values17hb7219cd94c14dc11E")
    *pump_recovered.pump_recovered.*-cgu.0.rcgu.o(".text._ZN11anchor_lang5error5Error11with_values17h87f6aa4b291fdbaaE")
    *pump_recovered.pump_recovered.*-cgu.0.rcgu.o(".text._ZN11anchor_lang5error5Error11with_values17h860d6d4119a155c9E")
    *pump_recovered.pump_recovered.*-cgu.0.rcgu.o(".text._ZN11anchor_lang5error5Error17with_account_name17h14f1b0726042feccE")
    *pump_recovered.pump_recovered.*-cgu.0.rcgu.o(".text._ZN11anchor_lang5error5Error17with_account_name17ha1bb388c39be2b20E")
    *pump_recovered.pump_recovered.*-cgu.0.rcgu.o(".text._ZN11anchor_lang8accounts12account_info93_$LT$impl$u20$anchor_lang..Accounts$LT$B$GT$$u20$for$u20$solana_account_info..AccountInfo$GT$12try_accounts17h0b2df1014dba9607E")
    *pump_recovered.pump_recovered.*-cgu.0.rcgu.o(".text._ZN11anchor_lang8accounts17interface_account25InterfaceAccount$LT$T$GT$18try_from_unchecked17h747e094632631974E")
    *pump_recovered.pump_recovered.*-cgu.0.rcgu.o(".text._ZN11anchor_lang8accounts17interface_account25InterfaceAccount$LT$T$GT$18try_from_unchecked17hbec0261429083616E")
    *pump_recovered.pump_recovered.*-cgu.0.rcgu.o(".text._ZN11anchor_lang8accounts5boxed87_$LT$impl$u20$anchor_lang..Accounts$LT$B$GT$$u20$for$u20$alloc..boxed..Box$LT$T$GT$$GT$12try_accounts17hc173451b92831c28E")
    *pump_recovered.pump_recovered.*-cgu.0.rcgu.o(".text._ZN11anchor_lang8accounts5boxed87_$LT$impl$u20$anchor_lang..Accounts$LT$B$GT$$u20$for$u20$alloc..boxed..Box$LT$T$GT$$GT$12try_accounts17h2772aa3bb15b908eE")
    *pump_recovered.pump_recovered.*-cgu.0.rcgu.o(".text._ZN11anchor_lang8accounts5boxed87_$LT$impl$u20$anchor_lang..Accounts$LT$B$GT$$u20$for$u20$alloc..boxed..Box$LT$T$GT$$GT$12try_accounts17h123baba5551aac65E")
    *pump_recovered.pump_recovered.*-cgu.0.rcgu.o(".text._ZN11anchor_lang8accounts5boxed87_$LT$impl$u20$anchor_lang..Accounts$LT$B$GT$$u20$for$u20$alloc..boxed..Box$LT$T$GT$$GT$12try_accounts17h19ccd33bd6d720fcE")
    *pump_recovered.pump_recovered.*-cgu.0.rcgu.o(".text._ZN11anchor_lang8accounts5boxed87_$LT$impl$u20$anchor_lang..Accounts$LT$B$GT$$u20$for$u20$alloc..boxed..Box$LT$T$GT$$GT$12try_accounts17h0b4a9ba9b874e4fdE")
    *pump_recovered.pump_recovered.*-cgu.0.rcgu.o(".text._ZN11anchor_lang8accounts7account16Account$LT$T$GT$18try_from_unchecked17h883ca7086d0da60aE")
    *pump_recovered.pump_recovered.*-cgu.0.rcgu.o(".text._ZN11anchor_lang8accounts7account16Account$LT$T$GT$18try_from_unchecked17h71efb635ba39c576E")
    *pump_recovered.pump_recovered.*-cgu.0.rcgu.o(".text._ZN11anchor_lang8accounts7account16Account$LT$T$GT$18try_from_unchecked17h726a49d1035a1dc0E")
    *pump_recovered.pump_recovered.*-cgu.0.rcgu.o(".text._ZN11anchor_lang8accounts7account16Account$LT$T$GT$18try_from_unchecked17h187a0b6ffa9a83e1E")
    *pump_recovered.pump_recovered.*-cgu.0.rcgu.o(".text._ZN11anchor_lang8accounts7account16Account$LT$T$GT$18try_from_unchecked17h95a3141a22c803ceE")
    *pump_recovered.pump_recovered.*-cgu.0.rcgu.o(".text._ZN11anchor_lang8accounts7account16Account$LT$T$GT$18try_from_unchecked17h63843439ba8aba4fE")
    *pump_recovered.pump_recovered.*-cgu.0.rcgu.o(".text._ZN11anchor_lang8accounts7account16Account$LT$T$GT$18try_from_unchecked17h1ef2ccb764feb733E")
    *pump_recovered.pump_recovered.*-cgu.0.rcgu.o(".text._ZN11anchor_lang8accounts7account16Account$LT$T$GT$24exit_with_expected_owner17h17571e389938f2a1E")
    *pump_recovered.pump_recovered.*-cgu.0.rcgu.o(".text._ZN11anchor_lang8accounts7account16Account$LT$T$GT$24exit_with_expected_owner17hbfbc35415082f747E")
    *pump_recovered.pump_recovered.*-cgu.0.rcgu.o(".text._ZN11anchor_lang8accounts7account16Account$LT$T$GT$24exit_with_expected_owner17heeb477d0b787200cE")
    *pump_recovered.pump_recovered.*-cgu.0.rcgu.o(".text._ZN11anchor_lang8accounts7account16Account$LT$T$GT$24exit_with_expected_owner17h402068884b8ec592E")
    *pump_recovered.pump_recovered.*-cgu.0.rcgu.o(".text._ZN11anchor_lang8accounts7account16Account$LT$T$GT$24exit_with_expected_owner17h6aa71f2e3ce3d877E")
    *pump_recovered.pump_recovered.*-cgu.0.rcgu.o(".text._ZN11anchor_lang8accounts7account16Account$LT$T$GT$6reload17hc80d8cae2ee31afdE")
    *pump_recovered.pump_recovered.*-cgu.0.rcgu.o(".text._ZN11anchor_lang8accounts7account16Account$LT$T$GT$8try_from17h0351fd613d8e2a9cE")
    *pump_recovered.pump_recovered.*-cgu.0.rcgu.o(".text._ZN11anchor_lang8accounts7account16Account$LT$T$GT$8try_from17h2710bc1e35e415a0E")
    *pump_recovered.pump_recovered.*-cgu.0.rcgu.o(".text._ZN11anchor_lang8accounts7account16Account$LT$T$GT$8try_from17h854428507509ff49E")
    *pump_recovered.pump_recovered.*-cgu.0.rcgu.o(".text._ZN11anchor_lang8accounts7account16Account$LT$T$GT$8try_from17h5181624771f5f147E")
    *pump_recovered.pump_recovered.*-cgu.0.rcgu.o(".text._ZN11anchor_lang8accounts7account16Account$LT$T$GT$8try_from17h5a13d40e58e3a37bE")
    *pump_recovered.pump_recovered.*-cgu.0.rcgu.o(".text._ZN11anchor_lang8accounts7account16Account$LT$T$GT$8try_from17h1c904625a417e069E")
    *pump_recovered.pump_recovered.*-cgu.0.rcgu.o(".text._ZN11anchor_lang8accounts7account16Account$LT$T$GT$8try_from17hbac0c05a5f9e51ceE")
    *pump_recovered.pump_recovered.*-cgu.0.rcgu.o(".text._ZN11anchor_lang8accounts7account16Account$LT$T$GT$8try_from17h5b0aeba816cb82e1E")
    *pump_recovered.pump_recovered.*-cgu.0.rcgu.o(".text._ZN11anchor_lang8accounts7account16Account$LT$T$GT$8try_from17h451930d2b2982d03E")
    *pump_recovered.pump_recovered.*-cgu.0.rcgu.o(".text._ZN139_$LT$anchor_lang..accounts..interface..Interface$LT$T$GT$$u20$as$u20$core..convert..TryFrom$LT$$RF$solana_account_info..AccountInfo$GT$$GT$8try_from17h5e6af5e493acff26E")
    *pump_recovered.pump_recovered.*-cgu.0.rcgu.o(".text._ZN3std2io5error5Error3new17h43ef7ed686c4878bE")
    *pump_recovered.pump_recovered.*-cgu.0.rcgu.o(".text._ZN3std2io5error5Error3new17h1b30d69763989e2bE")
    *pump_recovered.pump_recovered.*-cgu.0.rcgu.o(".text._ZN42_$LT$$RF$T$u20$as$u20$core..fmt..Debug$GT$3fmt17h4ff35b6216a40ed5E")
    *pump_recovered.pump_recovered.*-cgu.0.rcgu.o(".text._ZN42_$LT$$RF$T$u20$as$u20$core..fmt..Debug$GT$3fmt17h53b179cc1d7f7e79E")
    *pump_recovered.pump_recovered.*-cgu.0.rcgu.o(".text._ZN42_$LT$$RF$T$u20$as$u20$core..fmt..Debug$GT$3fmt17hc49c56ffa469469bE")
    *pump_recovered.pump_recovered.*-cgu.0.rcgu.o(".text._ZN42_$LT$$RF$T$u20$as$u20$core..fmt..Debug$GT$3fmt17hbc73631fb23b9a71E")
    *pump_recovered.pump_recovered.*-cgu.0.rcgu.o(".text._ZN42_$LT$$RF$T$u20$as$u20$core..fmt..Debug$GT$3fmt17hfa916cc1caf72622E")
    *pump_recovered.pump_recovered.*-cgu.0.rcgu.o(".text._ZN42_$LT$$RF$T$u20$as$u20$core..fmt..Debug$GT$3fmt17h224faf946767fbc8E")
    *pump_recovered.pump_recovered.*-cgu.0.rcgu.o(".text._ZN42_$LT$$RF$T$u20$as$u20$core..fmt..Debug$GT$3fmt17h44a058432f38c65bE")
    *pump_recovered.pump_recovered.*-cgu.0.rcgu.o(".text._ZN44_$LT$$RF$T$u20$as$u20$core..fmt..Display$GT$3fmt17h4a074702d7895a98E")
    *pump_recovered.pump_recovered.*-cgu.0.rcgu.o(".text._ZN45_$LT$T$u20$as$u20$alloc..string..ToString$GT$9to_string17hf3143c9adfa65d69E")
    *pump_recovered.pump_recovered.*-cgu.0.rcgu.o(".text._ZN45_$LT$T$u20$as$u20$alloc..string..ToString$GT$9to_string17h824d01baebdf26b8E")
    *pump_recovered.pump_recovered.*-cgu.0.rcgu.o(".text._ZN4core3fmt3num49_$LT$impl$u20$core..fmt..Debug$u20$for$u20$u8$GT$3fmt17h56fe0bc454683bb8E")
    *pump_recovered.pump_recovered.*-cgu.0.rcgu.o(".text._ZN4core3fmt3num50_$LT$impl$u20$core..fmt..Debug$u20$for$u20$i64$GT$3fmt17h09fd8368c16afbbbE")
    *pump_recovered.pump_recovered.*-cgu.0.rcgu.o(".text._ZN4core3fmt5Write9write_fmt17h53c8d8d7fdb75a67E")
    *pump_recovered.pump_recovered.*-cgu.0.rcgu.o(".text._ZN4core3fmt9Formatter9write_fmt17ha225da5d76e7eb00E")
    *pump_recovered.pump_recovered.*-cgu.0.rcgu.o(".text._ZN4core3ptr166drop_in_place$LT$anchor_lang..context..CpiContext$LT$pump_recovered..pump_fees..internal..__cpi_client_accounts_get_fees_with_quote_mint..GetFeesWithQuoteMint$GT$$GT$17haac61273b9c99382E")
    *pump_recovered.pump_recovered.*-cgu.0.rcgu.o(".text._ZN4core3ptr205drop_in_place$LT$$LT$alloc..boxed..Box$LT$dyn$u20$core..error..Error$u2b$core..marker..Sync$u2b$core..marker..Send$GT$$u20$as$u20$core..convert..From$LT$alloc..string..String$GT$$GT$..from..StringError$GT$17h27ac60e58d0430abE")
    *pump_recovered.pump_recovered.*-cgu.0.rcgu.o(".text._ZN4core3ptr24drop_in_place$LT$i64$GT$17h16b078187564023cE")
    *pump_recovered.pump_recovered.*-cgu.0.rcgu.o(".text._ZN4core3ptr37drop_in_place$LT$core..fmt..Error$GT$17hfff795df28ddb366E")
    *pump_recovered.pump_recovered.*-cgu.0.rcgu.o(".text._ZN4core3ptr42drop_in_place$LT$alloc..string..String$GT$17h53681e21be2b428cE")
    *pump_recovered.pump_recovered.*-cgu.0.rcgu.o(".text._ZN4core3ptr42drop_in_place$LT$solana_pubkey..Pubkey$GT$17hda00edcff73cda79E")
    *pump_recovered.pump_recovered.*-cgu.0.rcgu.o(".text._ZN4core3ptr42drop_in_place$LT$std..io..error..Error$GT$17h53bad7d65d9ed72bE")
    *pump_recovered.pump_recovered.*-cgu.0.rcgu.o(".text._ZN4core3ptr53drop_in_place$LT$pump_recovered..migrate..Migrate$GT$17h4ba8b13364577530E")
    *pump_recovered.pump_recovered.*-cgu.0.rcgu.o(".text._ZN4core3ptr46drop_in_place$LT$anchor_lang..error..Error$GT$17h710146501a239d49E")
    *pump_recovered.pump_recovered.*-cgu.0.rcgu.o(".text._ZN4core3ptr56drop_in_place$LT$pump_recovered..admin_cto..AdminCto$GT$17h3412dcecb2d2b07fE")
    *pump_recovered.pump_recovered.*-cgu.0.rcgu.o(".text._ZN4core3ptr55drop_in_place$LT$solana_program_error..ProgramError$GT$17h71466a9929f872e5E")
    *pump_recovered.pump_recovered.*-cgu.0.rcgu.o(".text._ZN4core3ptr72drop_in_place$LT$pump_recovered..__private..__idl..IdlCreateAccounts$GT$17h65afddbb15d98181E")
    *pump_recovered.pump_recovered.*-cgu.0.rcgu.o(".text._ZN4core3ptr72drop_in_place$LT$pump_recovered..idl_authority..AdminSetIdlAuthority$GT$17hf09a22c036131a84E")
    *pump_recovered.pump_recovered.*-cgu.0.rcgu.o(".text._ZN4core3ptr74drop_in_place$LT$$u5b$solana_account_info..AccountInfo$u3b$$u20$4$u5d$$GT$17h62e8fd5e0fdb72c5E")
    *pump_recovered.pump_recovered.*-cgu.0.rcgu.o(".text._ZN4core3ptr74drop_in_place$LT$$u5b$solana_account_info..AccountInfo$u3b$$u20$6$u5d$$GT$17h0fc7b19f3ea24dd6E")
    *pump_recovered.pump_recovered.*-cgu.0.rcgu.o(".text._ZN4core3ptr74drop_in_place$LT$$u5b$solana_account_info..AccountInfo$u3b$$u20$7$u5d$$GT$17h18ee17bb1bf0b901E")
    *pump_recovered.pump_recovered.*-cgu.0.rcgu.o(".text._ZN4core3ptr86drop_in_place$LT$pump_recovered..creator..collect_creator_fee..CollectCreatorFeeV2$GT$17h32eebb3ed97607fcE")
    *pump_recovered.pump_recovered.*-cgu.0.rcgu.o(".text._ZN4core3ptr93drop_in_place$LT$core..option..Option$LT$pump_recovered..multi_hop_curve..PreviousHop$GT$$GT$17h5db1994fd68eedbeE")
    *pump_recovered.pump_recovered.*-cgu.0.rcgu.o(".text._ZN4core3ptr90drop_in_place$LT$alloc..collections..btree..set..BTreeSet$LT$solana_pubkey..Pubkey$GT$$GT$17hb24db9e860bf1690E")
    *pump_recovered.pump_recovered.*-cgu.0.rcgu.o(".text._ZN4core5array69_$LT$impl$u20$core..fmt..Debug$u20$for$u20$$u5b$T$u3b$$u20$N$u5d$$GT$3fmt17h3b707ff253e65a4fE")
    *pump_recovered.pump_recovered.*-cgu.0.rcgu.o(".text._ZN4core5error5Error5cause17h958760fef6acec7aE")
    *pump_recovered.pump_recovered.*-cgu.0.rcgu.o(".text._ZN4core5error5Error7provide17hb16b28c2591f110bE")
    *pump_recovered.pump_recovered.*-cgu.0.rcgu.o(".text._ZN4core5error5Error7type_id17h2110e4cd5cfd7c4fE")
    *pump_recovered.pump_recovered.*-cgu.0.rcgu.o(".text._ZN51_$LT$u64$u20$as$u20$borsh..de..BorshDeserialize$GT$18deserialize_reader17hcd16ae07c605cc32E")
    *pump_recovered.pump_recovered.*-cgu.0.rcgu.o(".text._ZN67_$LT$alloc..vec..Vec$LT$T$C$A$GT$$u20$as$u20$core..clone..Clone$GT$5clone17hc27f9fcf2b79c016E")
    *pump_recovered.pump_recovered.*-cgu.0.rcgu.o(".text._ZN52_$LT$bool$u20$as$u20$borsh..de..BorshDeserialize$GT$18deserialize_reader17h734a25449b45b947E")
    *pump_recovered.pump_recovered.*-cgu.0.rcgu.o(".text._ZN53_$LT$core..fmt..Error$u20$as$u20$core..fmt..Debug$GT$3fmt17h85666afa16c4890eE")
    *pump_recovered.pump_recovered.*-cgu.0.rcgu.o(".text._ZN58_$LT$alloc..string..String$u20$as$u20$core..fmt..Write$GT$10write_char17hfde5b685689164ccE")
    *pump_recovered.pump_recovered.*-cgu.0.rcgu.o(".text._ZN58_$LT$alloc..string..String$u20$as$u20$core..fmt..Write$GT$9write_str17h4b62f46a222bd5b2E")
    *pump_recovered.pump_recovered.*-cgu.0.rcgu.o(".text._ZN5alloc3fmt6format17h5424e8a08f31e4d3E")
    *pump_recovered.pump_recovered.*-cgu.0.rcgu.o(".text._ZN5alloc5alloc15exchange_malloc17h6cd8dd11b0e3424eE")
    *pump_recovered.pump_recovered.*-cgu.0.rcgu.o(".text._ZN5alloc6string6String4push17h96dfc48c19bd6e38E")
    *pump_recovered.pump_recovered.*-cgu.0.rcgu.o(".text._ZN5alloc7raw_vec11finish_grow17h58fbd776b758b2ddE")
    *pump_recovered.pump_recovered.*-cgu.0.rcgu.o(".text.unlikely._ZN5alloc7raw_vec19RawVec$LT$T$C$A$GT$7reserve21do_reserve_and_handle17h6bec1c6dcf71be83E")
    *pump_recovered.pump_recovered.*-cgu.0.rcgu.o(".text.unlikely._ZN5alloc7raw_vec19RawVec$LT$T$C$A$GT$7reserve21do_reserve_and_handle17he7f96b53942b99deE")
    *pump_recovered.pump_recovered.*-cgu.0.rcgu.o(".text.unlikely._ZN5alloc7raw_vec19RawVec$LT$T$C$A$GT$7reserve21do_reserve_and_handle17h085215765f324cfaE")
    *pump_recovered.pump_recovered.*-cgu.0.rcgu.o(".text._ZN5alloc7raw_vec19RawVec$LT$T$C$A$GT$8grow_one17h1152d31f10f21cb3E")
    *pump_recovered.pump_recovered.*-cgu.0.rcgu.o(".text._ZN5alloc7raw_vec19RawVec$LT$T$C$A$GT$8grow_one17h57666bbf12f2ae6dE")
    *pump_recovered.pump_recovered.*-cgu.0.rcgu.o(".text._ZN5alloc7raw_vec19RawVec$LT$T$C$A$GT$8grow_one17h682f2e9eeb90e6e5E")
    *pump_recovered.pump_recovered.*-cgu.0.rcgu.o(".text._ZN5alloc7raw_vec19RawVec$LT$T$C$A$GT$8grow_one17h846c7c83de4c0de9E")
    *pump_recovered.pump_recovered.*-cgu.0.rcgu.o(".text._ZN5alloc7raw_vec19RawVec$LT$T$C$A$GT$8grow_one17h7b4442111dcf63b8E")
    *pump_recovered.pump_recovered.*-cgu.0.rcgu.o(".text._ZN5alloc7raw_vec19RawVec$LT$T$C$A$GT$8grow_one17h4d6447b5a0b02522E")
    *pump_recovered.pump_recovered.*-cgu.0.rcgu.o(".text._ZN5alloc7raw_vec19RawVec$LT$T$C$A$GT$8grow_one17h1c4c007a750d1ad3E")
    *pump_recovered.pump_recovered.*-cgu.0.rcgu.o(".text._ZN60_$LT$alloc..string..String$u20$as$u20$core..fmt..Display$GT$3fmt17heb0494973da8b0beE")
    *pump_recovered.pump_recovered.*-cgu.0.rcgu.o(".text._ZN63_$LT$solana_pubkey..PubkeyError$u20$as$u20$core..fmt..Debug$GT$3fmt17h51eee67aafad0389E")
    *pump_recovered.pump_recovered.*-cgu.0.rcgu.o(".text._ZN69_$LT$$u5b$T$u3b$$u20$N$u5d$$u20$as$u20$borsh..ser..BorshSerialize$GT$9serialize17h07a2614c0bc16918E")
    *pump_recovered.pump_recovered.*-cgu.0.rcgu.o(".text._ZN69_$LT$$u5b$T$u3b$$u20$N$u5d$$u20$as$u20$borsh..ser..BorshSerialize$GT$9serialize17h6d641954400a3881E")
    *pump_recovered.pump_recovered.*-cgu.0.rcgu.o(".text._ZN69_$LT$$u5b$T$u3b$$u20$N$u5d$$u20$as$u20$borsh..ser..BorshSerialize$GT$9serialize17hac08ad2e49330267E")
    *pump_recovered.pump_recovered.*-cgu.0.rcgu.o(".text._ZN69_$LT$$u5b$T$u3b$$u20$N$u5d$$u20$as$u20$borsh..ser..BorshSerialize$GT$9serialize17h50aebee3e4818b57E")
    *pump_recovered.pump_recovered.*-cgu.0.rcgu.o(".text._ZN69_$LT$$u5b$T$u3b$$u20$N$u5d$$u20$as$u20$borsh..ser..BorshSerialize$GT$9serialize17hacdfc1e96b60cd66E")
    *pump_recovered.pump_recovered.*-cgu.0.rcgu.o(".text._ZN69_$LT$alloc..string..String$u20$as$u20$borsh..de..BorshDeserialize$GT$18deserialize_reader17h439ed0005ae2fe15E")
    *pump_recovered.pump_recovered.*-cgu.0.rcgu.o(".text._ZN69_$LT$solana_pubkey..Pubkey$u20$as$u20$borsh..de..BorshDeserialize$GT$18deserialize_reader17h079ea8f0dde380bfE")
    *pump_recovered.pump_recovered.*-cgu.0.rcgu.o(".text._ZN70_$LT$$u5b$T$u3b$$u20$N$u5d$$u20$as$u20$borsh..de..BorshDeserialize$GT$18deserialize_reader17h36e93ff387ed61a5E")
    *pump_recovered.pump_recovered.*-cgu.0.rcgu.o(".text._ZN70_$LT$$u5b$T$u3b$$u20$N$u5d$$u20$as$u20$borsh..de..BorshDeserialize$GT$18deserialize_reader17h103a36c69d68630bE")
    *pump_recovered.pump_recovered.*-cgu.0.rcgu.o(".text._ZN70_$LT$$u5b$T$u3b$$u20$N$u5d$$u20$as$u20$borsh..de..BorshDeserialize$GT$18deserialize_reader17he958da1422e6e613E")
    *pump_recovered.pump_recovered.*-cgu.0.rcgu.o(".text._ZN70_$LT$core..num..error..TryFromIntError$u20$as$u20$core..fmt..Debug$GT$3fmt17h19e859f4ad052900E")
    *pump_recovered.pump_recovered.*-cgu.0.rcgu.o(".text._ZN71_$LT$solana_account_info..AccountInfo$u20$as$u20$core..clone..Clone$GT$5clone17h145eade74514b58aE")
    *pump_recovered.pump_recovered.*-cgu.0.rcgu.o(".text._ZN71_$LT$solana_program_error..ProgramError$u20$as$u20$core..fmt..Debug$GT$3fmt17he5da34f9213c2408E")
    *pump_recovered.pump_recovered.*-cgu.0.rcgu.o(".text._ZN72_$LT$alloc..vec..Vec$LT$T$GT$$u20$as$u20$borsh..de..BorshDeserialize$GT$18deserialize_reader17h70eaa600b0ab16d7E")
    *pump_recovered.pump_recovered.*-cgu.0.rcgu.o(".text._ZN72_$LT$alloc..vec..Vec$LT$T$GT$$u20$as$u20$borsh..de..BorshDeserialize$GT$18deserialize_reader17h676dd05dd74e6c5fE")
    *pump_recovered.pump_recovered.*-cgu.0.rcgu.o(".text._ZN72_$LT$alloc..vec..Vec$LT$T$GT$$u20$as$u20$borsh..de..BorshDeserialize$GT$18deserialize_reader17h2778c58508eae7d6E")
    *pump_recovered.pump_recovered.*-cgu.0.rcgu.o(".text._ZN78_$LT$anchor_lang..idl..IdlAccount$u20$as$u20$anchor_lang..AccountSerialize$GT$13try_serialize17hf4f5d2309d3d5af2E")
    *pump_recovered.pump_recovered.*-cgu.0.rcgu.o(".text._ZN85_$LT$anchor_lang..accounts..account..Account$LT$T$GT$$u20$as$u20$core..fmt..Debug$GT$3fmt17h186e1bb34eb6cd94E")
    *pump_recovered.pump_recovered.*-cgu.0.rcgu.o(".text._ZN88_$LT$anchor_lang..accounts..signer..Signer$u20$as$u20$anchor_lang..Accounts$LT$B$GT$$GT$12try_accounts17h13517cdcb6d8892cE")
    *pump_recovered.pump_recovered.*-cgu.0.rcgu.o(".text._ZN97_$LT$anchor_lang..accounts..sysvar..Sysvar$LT$T$GT$$u20$as$u20$anchor_lang..Accounts$LT$B$GT$$GT$12try_accounts17hc9e52a80af3194d9E")
    *pump_recovered.pump_recovered.*-cgu.0.rcgu.o(".text._ZN98_$LT$alloc..vec..Vec$LT$T$GT$$u20$as$u20$alloc..vec..spec_from_iter..SpecFromIter$LT$T$C$I$GT$$GT$9from_iter17h034825742f19c3e8E")
    *pump_recovered.pump_recovered.*-cgu.0.rcgu.o(".text._ZN99_$LT$anchor_lang..accounts..account..Account$LT$T$GT$$u20$as$u20$anchor_lang..Accounts$LT$B$GT$$GT$12try_accounts17h1f9b966a6c8c7f3fE")
    *pump_recovered.pump_recovered.*-cgu.0.rcgu.o(".text._ZN99_$LT$anchor_lang..accounts..account..Account$LT$T$GT$$u20$as$u20$anchor_lang..Accounts$LT$B$GT$$GT$12try_accounts17h28f96bc9bcabbe61E")
    *pump_recovered.pump_recovered.*-cgu.0.rcgu.o(".text._ZN99_$LT$anchor_lang..accounts..account..Account$LT$T$GT$$u20$as$u20$anchor_lang..Accounts$LT$B$GT$$GT$12try_accounts17h3f09b66a46cfd5c4E")
    *pump_recovered.pump_recovered.*-cgu.0.rcgu.o(".text._ZN99_$LT$anchor_lang..accounts..account..Account$LT$T$GT$$u20$as$u20$anchor_lang..Accounts$LT$B$GT$$GT$12try_accounts17h29c4bbc7b1a5eb67E")
    *pump_recovered.pump_recovered.*-cgu.0.rcgu.o(".text._ZN99_$LT$anchor_lang..accounts..account..Account$LT$T$GT$$u20$as$u20$anchor_lang..Accounts$LT$B$GT$$GT$12try_accounts17h02a0455b43d2881cE")
    *pump_recovered.pump_recovered.*-cgu.0.rcgu.o(".text._ZN99_$LT$anchor_lang..accounts..account..Account$LT$T$GT$$u20$as$u20$anchor_lang..Accounts$LT$B$GT$$GT$12try_accounts17h2f06f048736c0b17E")
    *pump_recovered.pump_recovered.*-cgu.0.rcgu.o(".text._ZN99_$LT$anchor_lang..accounts..account..Account$LT$T$GT$$u20$as$u20$anchor_lang..Accounts$LT$B$GT$$GT$12try_accounts17h2de954084a72cd07E")
    *pump_recovered.pump_recovered.*-cgu.0.rcgu.o(".text._ZN99_$LT$anchor_lang..accounts..account..Account$LT$T$GT$$u20$as$u20$anchor_lang..Accounts$LT$B$GT$$GT$12try_accounts17h35ab7cfc43b464d9E")
    *pump_recovered.pump_recovered.*-cgu.0.rcgu.o(".text._ZN99_$LT$anchor_lang..accounts..account..Account$LT$T$GT$$u20$as$u20$anchor_lang..Accounts$LT$B$GT$$GT$12try_accounts17h589ac0485fc584edE")
    *pump_recovered.pump_recovered.*-cgu.0.rcgu.o(".text._ZN99_$LT$anchor_lang..accounts..account..Account$LT$T$GT$$u20$as$u20$anchor_lang..Accounts$LT$B$GT$$GT$12try_accounts17h42d57951829af405E")
    *pump_recovered.pump_recovered.*-cgu.0.rcgu.o(".text._ZN99_$LT$anchor_lang..accounts..program..Program$LT$T$GT$$u20$as$u20$anchor_lang..Accounts$LT$B$GT$$GT$12try_accounts17h046fd068e55bfc62E")
    *pump_recovered.pump_recovered.*-cgu.0.rcgu.o(".text._ZN99_$LT$anchor_lang..accounts..program..Program$LT$T$GT$$u20$as$u20$anchor_lang..Accounts$LT$B$GT$$GT$12try_accounts17h2aa4db16a592c621E")
    *pump_recovered.pump_recovered.*-cgu.0.rcgu.o(".text._ZN99_$LT$anchor_lang..accounts..program..Program$LT$T$GT$$u20$as$u20$anchor_lang..Accounts$LT$B$GT$$GT$12try_accounts17h1096df153a1539c7E")
    *pump_recovered.pump_recovered.*-cgu.0.rcgu.o(".text._ZN99_$LT$anchor_lang..accounts..program..Program$LT$T$GT$$u20$as$u20$anchor_lang..Accounts$LT$B$GT$$GT$12try_accounts17h1217319da4d62c75E")
    *pump_recovered.pump_recovered.*-cgu.0.rcgu.o(".text._ZN99_$LT$anchor_lang..accounts..program..Program$LT$T$GT$$u20$as$u20$anchor_lang..Accounts$LT$B$GT$$GT$12try_accounts17h06f2f4c870458ab7E")
    *pump_recovered.pump_recovered.*-cgu.0.rcgu.o(".text._ZN99_$LT$anchor_lang..accounts..program..Program$LT$T$GT$$u20$as$u20$anchor_lang..Accounts$LT$B$GT$$GT$12try_accounts17h7491be3510873868E")
    *pump_recovered.pump_recovered.*-cgu.0.rcgu.o(".text._ZN99_$LT$anchor_lang..accounts..program..Program$LT$T$GT$$u20$as$u20$anchor_lang..Accounts$LT$B$GT$$GT$12try_accounts17hfd5b4b42440ea7f1E")
    *pump_recovered.pump_recovered.*-cgu.0.rcgu.o(".text._ZN99_$LT$anchor_lang..accounts..program..Program$LT$T$GT$$u20$as$u20$anchor_lang..Accounts$LT$B$GT$$GT$12try_accounts17h6382ef42ccaccc1fE")
    *pump_recovered.pump_recovered.*-cgu.0.rcgu.o(.text*)
    *(".text.__rust_alloc_error_handler")
    *libpump_token_ext-*.rlib:*(".text._ZN14pump_token_ext26quote_extensions_supported17h29673dc22a0d4c33E")
    *libpump_token_ext-*.rlib:*(".text._ZN14pump_token_ext26required_quote_account_len17h4b0d15cf3522296fE")
    *libpump_token_ext-*.rlib:*(".text._ZN14pump_token_ext3Fee13calculate_fee17hd18de2fab3bdb223E")
    *libpump_token_ext-*.rlib:*(".text._ZN14pump_token_ext3Fee24calculate_pre_fee_amount17h9281ed928792c0c8E")
    *libpump_token_ext-*.rlib:*(".text._ZN14pump_token_ext23get_transfer_fee_config17h18bf7ac8da7867aeE")
    *libanchor_spl-*.rlib:*(".text._ZN4core3ptr74drop_in_place$LT$$u5b$solana_account_info..AccountInfo$u3b$$u20$2$u5d$$GT$17h80d08134ca4d62caE")
    *libanchor_spl-*.rlib:*(".text._ZN4core3ptr74drop_in_place$LT$$u5b$solana_account_info..AccountInfo$u3b$$u20$3$u5d$$GT$17hb2e49b51eaada772E")
    *libanchor_spl-*.rlib:*(".text._ZN4core3ptr74drop_in_place$LT$$u5b$solana_account_info..AccountInfo$u3b$$u20$4$u5d$$GT$17h5df3d0bdfac4e99bE")
    *libanchor_spl-*.rlib:*(".text._ZN4core3ptr74drop_in_place$LT$$u5b$solana_account_info..AccountInfo$u3b$$u20$5$u5d$$GT$17h2d897f85eacb05f3E")
    *libanchor_spl-*.rlib:*(".text._ZN4core3ptr74drop_in_place$LT$$u5b$solana_account_info..AccountInfo$u3b$$u20$6$u5d$$GT$17h9d7b96709e28d80eE")
    *libanchor_spl-*.rlib:*(".text._ZN4core3ptr76drop_in_place$LT$alloc..vec..Vec$LT$solana_account_info..AccountInfo$GT$$GT$17h5cb863ee75bf5623E")
    *libanchor_spl-*.rlib:*(".text._ZN5alloc7raw_vec11finish_grow17hf0bcbab673a46833E")
    *libanchor_spl-*.rlib:*(".text.unlikely._ZN5alloc7raw_vec19RawVec$LT$T$C$A$GT$7reserve21do_reserve_and_handle17h49cd1b0eb2796ca7E")
    *libanchor_spl-*.rlib:*(".text._ZN5alloc7raw_vec19RawVec$LT$T$C$A$GT$8grow_one17h39aa912197b6d77bE")
    *libanchor_spl-*.rlib:*(".text._ZN10anchor_spl16associated_token6create17h570e8792dab4782bE")
    *libanchor_spl-*.rlib:*(".text._ZN10anchor_spl16associated_token17create_idempotent17h9199d72b13d8fa8fE")
    *libanchor_spl-*.rlib:*(".text._ZN10anchor_spl5token7mint_to17h4f0256ae27f3bf9fE")
    *libanchor_spl-*.rlib:*(".text._ZN10anchor_spl5token13set_authority17ha3b9a12fb9706943E")
    *libanchor_spl-*.rlib:*(".text._ZN83_$LT$anchor_spl..token..TokenAccount$u20$as$u20$anchor_lang..AccountDeserialize$GT$25try_deserialize_unchecked17h3105380b98cfacf9E")
    *libanchor_spl-*.rlib:*(".text._ZN75_$LT$anchor_spl..token..Mint$u20$as$u20$anchor_lang..AccountDeserialize$GT$25try_deserialize_unchecked17h40c57027fb284c5bE")
    *libanchor_spl-*.rlib:*(".text._ZN10anchor_spl10token_202216transfer_checked17hf9bc89a183359aedE")
    *libanchor_spl-*.rlib:*(".text._ZN10anchor_spl10token_20227mint_to17h3a514bc6ceeee182E")
    *libanchor_spl-*.rlib:*(".text._ZN10anchor_spl10token_20224burn17h61502cc35cb21374E")
    *libanchor_spl-*.rlib:*(".text._ZN10anchor_spl10token_202213close_account17hfe0091880df9a94dE")
    *libanchor_spl-*.rlib:*(".text._ZN10anchor_spl10token_202216initialize_mint217h4d1f23cdfb602849E")
    *libanchor_spl-*.rlib:*(".text._ZN10anchor_spl10token_202213set_authority17hac088a4cb707b9eaE")
    *libanchor_spl-*.rlib:*(".text._ZN10anchor_spl21token_2022_extensions20group_member_pointer31group_member_pointer_initialize17hf2376a2cd31bde98E")
    *libanchor_spl-*.rlib:*(".text._ZN10anchor_spl21token_2022_extensions13group_pointer24group_pointer_initialize17hfb1b6f6cfff87af3E")
    *libanchor_spl-*.rlib:*(".text._ZN10anchor_spl21token_2022_extensions16metadata_pointer27metadata_pointer_initialize17hb11ecb1fa328ee22E")
    *libanchor_spl-*.rlib:*(".text._ZN10anchor_spl21token_2022_extensions20mint_close_authority31mint_close_authority_initialize17h31022f5d0d890bcdE")
    *libanchor_spl-*.rlib:*(".text._ZN10anchor_spl21token_2022_extensions16non_transferable32non_transferable_mint_initialize17h0c26f6bdb2d4244cE")
    *libanchor_spl-*.rlib:*(".text._ZN10anchor_spl21token_2022_extensions14token_metadata25token_metadata_initialize17h84182e674e1ede89E")
    *libanchor_spl-*.rlib:*(".text._ZN10anchor_spl21token_2022_extensions14token_metadata31token_metadata_update_authority17h3a833ab88ffc8d01E")
    *libanchor_spl-*.rlib:*(".text._ZN10anchor_spl21token_2022_extensions12transfer_fee31harvest_withheld_tokens_to_mint17h0f7402feb50b224bE")
    *libanchor_spl-*.rlib:*(".text._ZN10anchor_spl21token_2022_extensions13transfer_hook24transfer_hook_initialize17hbf6994b4ce84285cE")
    *libanchor_spl-*.rlib:*(".text._ZN93_$LT$anchor_spl..token_interface..TokenAccount$u20$as$u20$anchor_lang..AccountDeserialize$GT$25try_deserialize_unchecked17hc6b024686a0d1f77E")
    *libanchor_spl-*.rlib:*(".text._ZN85_$LT$anchor_spl..token_interface..Mint$u20$as$u20$anchor_lang..AccountDeserialize$GT$25try_deserialize_unchecked17h4d5fc3b66596de83E")
    *libanchor_spl-*.rlib:*(".text._ZN10anchor_spl15token_interface22find_mint_account_size17h0778f41bdfbd7149E")
    *libanchor_spl-*.rlib:*(".text._ZN10anchor_spl8metadata27create_metadata_accounts_v317h25e216105ef778cdE")
    *libanchor_spl-*.rlib:*(".text._ZN89_$LT$anchor_spl..metadata..MetadataAccount$u20$as$u20$anchor_lang..AccountDeserialize$GT$15try_deserialize17hbeb90fb755d1f89fE")
    *libanchor_spl-*.rlib:*(".text._ZN101_$LT$anchor_spl..metadata..SetAndVerifySizedCollectionItem$u20$as$u20$anchor_lang..ToAccountInfos$GT$16to_account_infos17h5d720121a093de39E")
    *libmpl_token_metadata-*.rlib:*(".text._ZN3std2io5error5Error3new17h4c8cb9d58ba66fd7E")
    *libmpl_token_metadata-*.rlib:*(".text._ZN3std2io5error5Error3new17h9da6f2a95abed94eE")
    *libmpl_token_metadata-*.rlib:*(".text._ZN4core3fmt3num49_$LT$impl$u20$core..fmt..Debug$u20$for$u20$u8$GT$3fmt17h56fe0bc454683bb8E")
    *libmpl_token_metadata-*.rlib:*(".text._ZN4core3fmt5Write9write_fmt17h572a5eaaecf9f942E")
    *libmpl_token_metadata-*.rlib:*(".text._ZN4core3ptr176drop_in_place$LT$core..result..Result$LT$core..option..Option$LT$mpl_token_metadata..generated..types..collection_details..CollectionDetails$GT$$C$std..io..error..Error$GT$$GT$17h2e25adeeba005721E")
    *libmpl_token_metadata-*.rlib:*(".text._ZN4core3ptr178drop_in_place$LT$core..result..Result$LT$core..option..Option$LT$mpl_token_metadata..generated..types..programmable_config..ProgrammableConfig$GT$$C$std..io..error..Error$GT$$GT$17h621d563c7c8f962cE")
    *libmpl_token_metadata-*.rlib:*(".text._ZN4core3ptr205drop_in_place$LT$$LT$alloc..boxed..Box$LT$dyn$u20$core..error..Error$u2b$core..marker..Sync$u2b$core..marker..Send$GT$$u20$as$u20$core..convert..From$LT$alloc..string..String$GT$$GT$..from..StringError$GT$17ha470b4f6b072bcd5E")
    *libmpl_token_metadata-*.rlib:*(".text._ZN4core3ptr37drop_in_place$LT$core..fmt..Error$GT$17heb1b2f0284c06b09E")
    *libmpl_token_metadata-*.rlib:*(".text._ZN4core3ptr42drop_in_place$LT$alloc..string..String$GT$17hfdebc6a32fcca3eeE")
    *libmpl_token_metadata-*.rlib:*(".text._ZN4core3ptr42drop_in_place$LT$std..io..error..Error$GT$17h7605eef342b83097E")
    *libmpl_token_metadata-*.rlib:*(".text._ZN4core3ptr450drop_in_place$LT$$LP$core..result..Result$LT$core..option..Option$LT$mpl_token_metadata..generated..types..token_standard..TokenStandard$GT$$C$std..io..error..Error$GT$$C$core..result..Result$LT$core..option..Option$LT$mpl_token_metadata..generated..types..collection..Collection$GT$$C$std..io..error..Error$GT$$C$core..result..Result$LT$core..option..Option$LT$mpl_token_metadata..generated..types..uses..Uses$GT$$C$std..io..error..Error$GT$$RP$$GT$17hae66b051378466f0E")
    *libmpl_token_metadata-*.rlib:*(".text._ZN4core5error5Error5cause17hc9d8c85371f2e395E")
    *libmpl_token_metadata-*.rlib:*(".text._ZN4core5error5Error7provide17h3b87dde365a70353E")
    *libmpl_token_metadata-*.rlib:*(".text._ZN4core5error5Error7type_id17h263e4d6a869349d3E")
    *libmpl_token_metadata-*.rlib:*(".text._ZN53_$LT$core..fmt..Error$u20$as$u20$core..fmt..Debug$GT$3fmt17h85666afa16c4890eE")
    *libmpl_token_metadata-*.rlib:*(".text._ZN58_$LT$alloc..string..String$u20$as$u20$core..fmt..Write$GT$10write_char17hfde5b685689164ccE")
    *libmpl_token_metadata-*.rlib:*(".text._ZN58_$LT$alloc..string..String$u20$as$u20$core..fmt..Write$GT$9write_str17h4b62f46a222bd5b2E")
    *libmpl_token_metadata-*.rlib:*(".text._ZN5alloc7raw_vec11finish_grow17h9484f519952f9157E")
    *libmpl_token_metadata-*.rlib:*(".text.unlikely._ZN5alloc7raw_vec19RawVec$LT$T$C$A$GT$7reserve21do_reserve_and_handle17hbc5a049b6561d884E")
    *libmpl_token_metadata-*.rlib:*(".text.unlikely._ZN5alloc7raw_vec19RawVec$LT$T$C$A$GT$7reserve21do_reserve_and_handle17h9c1916e91c48b25fE")
    *libmpl_token_metadata-*.rlib:*(".text._ZN5alloc7raw_vec19RawVec$LT$T$C$A$GT$8grow_one17h19727c14e71e1fd7E")
    *libmpl_token_metadata-*.rlib:*(".text._ZN5alloc7raw_vec19RawVec$LT$T$C$A$GT$8grow_one17h6d20bd6245a7f615E")
    *libmpl_token_metadata-*.rlib:*(".text._ZN5borsh3ser14BorshSerialize10try_to_vec17hce8a7c6b88396983E")
    *libmpl_token_metadata-*.rlib:*(".text._ZN69_$LT$alloc..string..String$u20$as$u20$borsh..de..BorshDeserialize$GT$18deserialize_reader17h7bf2f6175de578a8E")
    *libmpl_token_metadata-*.rlib:*(".text._ZN72_$LT$alloc..vec..Vec$LT$T$GT$$u20$as$u20$borsh..de..BorshDeserialize$GT$18deserialize_reader17h33fa2632a5db14e9E")
    *libmpl_token_metadata-*.rlib:*(".text._ZN76_$LT$core..option..Option$LT$T$GT$$u20$as$u20$borsh..ser..BorshSerialize$GT$9serialize17h7bfe41c8671ceecfE")
    *libmpl_token_metadata-*.rlib:*(".text._ZN76_$LT$core..option..Option$LT$T$GT$$u20$as$u20$borsh..ser..BorshSerialize$GT$9serialize17h1a01d48e16661ba2E")
    *libmpl_token_metadata-*.rlib:*(".text._ZN76_$LT$core..option..Option$LT$T$GT$$u20$as$u20$borsh..ser..BorshSerialize$GT$9serialize17h3a96484b6323d2ceE")
    *libmpl_token_metadata-*.rlib:*(".text._ZN77_$LT$core..option..Option$LT$T$GT$$u20$as$u20$borsh..de..BorshDeserialize$GT$18deserialize_reader17hd765468a23867dceE")
    *libmpl_token_metadata-*.rlib:*(".text._ZN77_$LT$core..option..Option$LT$T$GT$$u20$as$u20$borsh..de..BorshDeserialize$GT$18deserialize_reader17hb7429bba99497841E")
    *libmpl_token_metadata-*.rlib:*(".text._ZN77_$LT$core..option..Option$LT$T$GT$$u20$as$u20$borsh..de..BorshDeserialize$GT$18deserialize_reader17h32eaeaeef9161e63E")
    *libmpl_token_metadata-*.rlib:*(".text._ZN77_$LT$core..option..Option$LT$T$GT$$u20$as$u20$borsh..de..BorshDeserialize$GT$18deserialize_reader17h6e11ce81f0124a6cE")
    *libmpl_token_metadata-*.rlib:*(".text._ZN77_$LT$core..option..Option$LT$T$GT$$u20$as$u20$borsh..de..BorshDeserialize$GT$18deserialize_reader17hf2da543c49185a91E")
    *libmpl_token_metadata-*.rlib:*(".text._ZN77_$LT$core..option..Option$LT$T$GT$$u20$as$u20$borsh..de..BorshDeserialize$GT$18deserialize_reader17h12a16faa67e0ca0cE")
    *libmpl_token_metadata-*.rlib:*(".text._ZN77_$LT$core..option..Option$LT$T$GT$$u20$as$u20$borsh..de..BorshDeserialize$GT$18deserialize_reader17hdd051ab95615111aE")
    *libmpl_token_metadata-*.rlib:*(".text._ZN18mpl_token_metadata9generated12instructions26create_metadata_account_v323CreateMetadataAccountV311instruction17h744d026441568c91E")
    *libmpl_token_metadata-*.rlib:*(".text._ZN18mpl_token_metadata9generated12instructions26create_metadata_account_v323CreateMetadataAccountV335instruction_with_remaining_accounts17hbf64b53674119839E")
    *libmpl_token_metadata-*.rlib:*(".text._ZN18mpl_token_metadata6traits77_$LT$impl$u20$mpl_token_metadata..generated..accounts..metadata..Metadata$GT$16safe_deserialize17h06df9cf5858206c5E")
    *libmpl_token_metadata-*.rlib:*(".text._ZN122_$LT$mpl_token_metadata..generated..types..collection_details..CollectionDetails$u20$as$u20$borsh..ser..BorshSerialize$GT$9serialize17h35130d0726648a52E")
    *libmpl_token_metadata-*.rlib:*(".text._ZN100_$LT$mpl_token_metadata..generated..types..data_v2..DataV2$u20$as$u20$borsh..ser..BorshSerialize$GT$9serialize17hdf8bccf2509ee3afE")
    *libmpl_token_metadata-*.rlib:*(".text._ZN95_$LT$mpl_token_metadata..generated..types..uses..Uses$u20$as$u20$borsh..ser..BorshSerialize$GT$9serialize17h38f7645ef7e5265fE")
    *libspl_token_2022-*.rlib:*(".text._ZN5alloc7raw_vec11finish_grow17hc0cd718b91c1a9e2E")
    *libspl_token_2022-*.rlib:*(".text.unlikely._ZN5alloc7raw_vec19RawVec$LT$T$C$A$GT$7reserve21do_reserve_and_handle17h0d917ab3047b22dfE")
    *libspl_token_2022-*.rlib:*(".text._ZN5alloc7raw_vec19RawVec$LT$T$C$A$GT$8grow_one17h8d55359745b55b75E")
    *libspl_token_2022-*.rlib:*(".text._ZN5alloc7raw_vec19RawVec$LT$T$C$A$GT$8grow_one17h288a2fdef7bc9d23E")
    *libspl_token_2022-*.rlib:*(".text._ZN5alloc7raw_vec19RawVec$LT$T$C$A$GT$8grow_one17h95e1aab687a11838E")
    *libspl_token_2022-*.rlib:*(".text._ZN14spl_token_20229extension20group_member_pointer11instruction10initialize17hf0df895870e87821E")
    *libspl_token_2022-*.rlib:*(".text._ZN14spl_token_20229extension13group_pointer11instruction10initialize17hb89c6a8bd7fe4cb1E")
    *libspl_token_2022-*.rlib:*(".text._ZN14spl_token_20229extension16metadata_pointer11instruction10initialize17ha53c92f6f700f2d4E")
    *libspl_token_2022-*.rlib:*(".text._ZN14spl_token_20229extension12transfer_fee11instruction22TransferFeeInstruction4pack17h3f92637a5b5a8b98E")
    *libspl_token_2022-*.rlib:*(".text._ZN14spl_token_20229extension12transfer_fee11instruction31harvest_withheld_tokens_to_mint17h75af7ba53b161ac1E")
    *libspl_token_2022-*.rlib:*(".text._ZN14spl_token_20229extension13transfer_hook11instruction10initialize17h86f07dc3e107deb9E")
    *libspl_token_2022-*.rlib:*(".text._ZN14spl_token_20229extension23adjust_len_for_multisig17h522075a14167c9efE")
    *libspl_token_2022-*.rlib:*(".text._ZN14spl_token_20229extension13ExtensionType21try_get_total_tlv_len17h75846c9981d57322E")
    *libspl_token_2022-*.rlib:*(".text._ZN14spl_token_202211instruction16TokenInstruction4pack17h740756b3c93b431fE")
    *libspl_token_2022-*.rlib:*(".text._ZN14spl_token_202211instruction16initialize_mint217h4b7e192e0d8256aaE")
    *libspl_token_2022-*.rlib:*(".text._ZN14spl_token_202211instruction13set_authority17h4efc8b9f41b86ccbE")
    *libspl_token_2022-*.rlib:*(".text._ZN14spl_token_202211instruction7mint_to17h5f74684a1031f070E")
    *libspl_token_2022-*.rlib:*(".text._ZN14spl_token_202211instruction4burn17h313d69b32a0512f4E")
    *libspl_token_2022-*.rlib:*(".text._ZN14spl_token_202211instruction13close_account17hbbc2670e4fe23ae9E")
    *libspl_token_2022-*.rlib:*(".text._ZN14spl_token_202211instruction16transfer_checked17h8d3e63c276d3b640E")
    *libspl_token_2022-*.rlib:*(".text._ZN14spl_token_202211instruction31initialize_mint_close_authority17h7be65bf9ca7af5a7E")
    *libspl_token_2022-*.rlib:*(".text._ZN14spl_token_202211instruction32initialize_non_transferable_mint17ha4923fd8fc002bbbE")
    *libspl_token_2022-*.rlib:*(".text._ZN73_$LT$spl_token_2022..state..Mint$u20$as$u20$solana_program_pack..Pack$GT$17unpack_from_slice17h37375dc46725c279E")
    *libspl_token_2022-*.rlib:*(".text._ZN76_$LT$spl_token_2022..state..Account$u20$as$u20$solana_program_pack..Pack$GT$17unpack_from_slice17h188c3298074136b5E")
    *libspl_token-*.rlib:*(".text._ZN5alloc7raw_vec11finish_grow17h5c6e9b1699b8f1a0E")
    *libspl_token-*.rlib:*(".text.unlikely._ZN5alloc7raw_vec19RawVec$LT$T$C$A$GT$7reserve21do_reserve_and_handle17h724eeefd0a46ad34E")
    *libspl_token-*.rlib:*(".text._ZN5alloc7raw_vec19RawVec$LT$T$C$A$GT$8grow_one17h37c99bf094541ff7E")
    *libspl_token-*.rlib:*(".text._ZN9spl_token11instruction16TokenInstruction4pack17h304eb1dc39fc4273E")
    *libspl_token-*.rlib:*(".text._ZN9spl_token11instruction13set_authority17h0bdc0dc664b8c02aE")
    *libspl_token-*.rlib:*(".text._ZN9spl_token11instruction7mint_to17h6edd4c5495131e7bE")
    *libspl_token-*.rlib:*(".text._ZN9spl_token11instruction11sync_native17hb5ba58dcc88c2fd6E")
    *libspl_token-*.rlib:*(".text._ZN68_$LT$spl_token..state..Mint$u20$as$u20$solana_program_pack..Pack$GT$17unpack_from_slice17h83996ff0f5eec8c4E")
    *libspl_token-*.rlib:*(".text._ZN71_$LT$spl_token..state..Account$u20$as$u20$solana_program_pack..Pack$GT$17unpack_from_slice17hc2fda42f843bca1dE")
    *libspl_token_metadata_interface-*.rlib:*(".text._ZN12solana_borsh2v123get_instance_packed_len17h51c99c826e7143b1E")
    *libspl_token_metadata_interface-*.rlib:*(".text._ZN3std2io5Write9write_all17he7fa8aa5b24d4a18E")
    *libspl_token_metadata_interface-*.rlib:*(".text._ZN3std2io5error14repr_bitpacked14kind_from_prim17h357bcb36090597d1E")
    *libspl_token_metadata_interface-*.rlib:*(".text._ZN4core3ptr42drop_in_place$LT$std..io..error..Error$GT$17h661f0235b552e7a7E")
    *libspl_token_metadata_interface-*.rlib:*(".text._ZN4core3ptr88drop_in_place$LT$spl_token_metadata_interface..instruction..TokenMetadataInstruction$GT$17ha01163402f152352E")
    *libspl_token_metadata_interface-*.rlib:*(".text._ZN58_$LT$$u5b$T$u5d$$u20$as$u20$borsh..ser..BorshSerialize$GT$9serialize17hf0e5bbf93aba3b3aE")
    *libspl_token_metadata_interface-*.rlib:*(".text._ZN5alloc7raw_vec11finish_grow17he23905cb4bf52486E")
    *libspl_token_metadata_interface-*.rlib:*(".text.unlikely._ZN5alloc7raw_vec19RawVec$LT$T$C$A$GT$7reserve21do_reserve_and_handle17hf97d2ee6c63f2ef7E")
    *libspl_token_metadata_interface-*.rlib:*(".text._ZN71_$LT$alloc..vec..Vec$LT$T$GT$$u20$as$u20$borsh..ser..BorshSerialize$GT$9serialize17hc5240eef0b4d0c63E")
    *libspl_token_metadata_interface-*.rlib:*(".text._ZN28spl_token_metadata_interface11instruction24TokenMetadataInstruction4pack17h2cf3f41554521db5E")
    *libspl_token_metadata_interface-*.rlib:*(".text._ZN28spl_token_metadata_interface11instruction10initialize17h6a1cc00e81a6c0a0E")
    *libspl_token_metadata_interface-*.rlib:*(".text._ZN28spl_token_metadata_interface11instruction16update_authority17h15c8354765b453afE")
    *libspl_token_metadata_interface-*.rlib:*(".text._ZN128_$LT$spl_token_metadata_interface..state..TokenMetadata$u20$as$u20$spl_type_length_value..variable_len_pack..VariableLenPack$GT$14get_packed_len17h45028acc6904fd39E")
    *libspl_pod-*.rlib:*(".text._ZN145_$LT$spl_pod..optional_keys..OptionalNonZeroPubkey$u20$as$u20$core..convert..TryFrom$LT$core..option..Option$LT$solana_pubkey..Pubkey$GT$$GT$$GT$8try_from17h86fb47635ea77c3dE")
    *libspl_associated_token_account_client-*.rlib:*(".text._ZN35spl_associated_token_account_client7address44get_associated_token_address_with_program_id17h2d8a730be6f4494aE")
    *libspl_associated_token_account_client-*.rlib:*(".text._ZN35spl_associated_token_account_client11instruction42build_associated_token_account_instruction17h7b7f8a21371b967dE")
    *libspl_associated_token_account_client-*.rlib:*(".text._ZN35spl_associated_token_account_client11instruction31create_associated_token_account17h2c53ca62ca8e6f75E")
    *libspl_associated_token_account_client-*.rlib:*(".text._ZN35spl_associated_token_account_client11instruction42create_associated_token_account_idempotent17hda62cc26b3f05551E")
    *libanchor_lang-*.rlib:*(".text._ZN3std2io5error5Error3new17h44bae102199c04d3E")
    *libanchor_lang-*.rlib:*(".text._ZN42_$LT$$RF$T$u20$as$u20$core..fmt..Debug$GT$3fmt17h689266909db2a158E")
    *libanchor_lang-*.rlib:*(".text._ZN42_$LT$$RF$T$u20$as$u20$core..fmt..Debug$GT$3fmt17hbcd50ba89bd92865E")
    *libanchor_lang-*.rlib:*(".text._ZN44_$LT$$RF$T$u20$as$u20$core..fmt..Display$GT$3fmt17haea9280deb4d3192E")
    *libanchor_lang-*.rlib:*(".text._ZN44_$LT$$RF$T$u20$as$u20$core..fmt..Display$GT$3fmt17hda853df0235f0a08E")
    *libanchor_lang-*.rlib:*(".text._ZN4core3fmt5Write9write_fmt17hda02bfd37fe9827fE")
    *libanchor_lang-*.rlib:*(".text._ZN4core3fmt9Formatter9write_fmt17ha225da5d76e7eb00E")
    *libanchor_lang-*.rlib:*(".text._ZN4core3ptr205drop_in_place$LT$$LT$alloc..boxed..Box$LT$dyn$u20$core..error..Error$u2b$core..marker..Sync$u2b$core..marker..Send$GT$$u20$as$u20$core..convert..From$LT$alloc..string..String$GT$$GT$..from..StringError$GT$17h968aa5d791ba9decE")
    *libanchor_lang-*.rlib:*(".text._ZN4core3ptr28drop_in_place$LT$$RF$str$GT$17h682e4ae9925fac73E")
    *libanchor_lang-*.rlib:*(".text._ZN4core3ptr37drop_in_place$LT$core..fmt..Error$GT$17h9a5fd3a0cf888cb7E")
    *libanchor_lang-*.rlib:*(".text._ZN4core3ptr42drop_in_place$LT$alloc..string..String$GT$17h85755bbf263d8672E")
    *libanchor_lang-*.rlib:*(".text._ZN4core3ptr47drop_in_place$LT$solana_pubkey..PubkeyError$GT$17h8292b5e89bcd6276E")
    *libanchor_lang-*.rlib:*(".text._ZN4core3ptr74drop_in_place$LT$$u5b$solana_account_info..AccountInfo$u3b$$u20$2$u5d$$GT$17h56ac91ed1b9b9d69E")
    *libanchor_lang-*.rlib:*(".text._ZN4core3ptr74drop_in_place$LT$$u5b$solana_account_info..AccountInfo$u3b$$u20$3$u5d$$GT$17hdf2ccfbbf2196886E")
    *libanchor_lang-*.rlib:*(".text._ZN4core3ptr76drop_in_place$LT$alloc..vec..Vec$LT$solana_account_info..AccountInfo$GT$$GT$17hfbabab3da24ef1f6E")
    *libanchor_lang-*.rlib:*(".text._ZN4core5error5Error5cause17h203316d539a1f115E")
    *libanchor_lang-*.rlib:*(".text._ZN4core5error5Error7provide17hc718c1e3176930bcE")
    *libanchor_lang-*.rlib:*(".text._ZN4core5error5Error7type_id17h8e7b8f45f0aae4e9E")
    *libanchor_lang-*.rlib:*(".text._ZN52_$LT$T$u20$as$u20$alloc..slice..hack..ConvertVec$GT$6to_vec17ha853c28aed38db81E")
    *libanchor_lang-*.rlib:*(".text._ZN53_$LT$core..fmt..Error$u20$as$u20$core..fmt..Debug$GT$3fmt17h85666afa16c4890eE")
    *libanchor_lang-*.rlib:*(".text._ZN58_$LT$alloc..string..String$u20$as$u20$core..fmt..Write$GT$10write_char17hfde5b685689164ccE")
    *libanchor_lang-*.rlib:*(".text._ZN58_$LT$alloc..string..String$u20$as$u20$core..fmt..Write$GT$9write_str17h4b62f46a222bd5b2E")
    *libanchor_lang-*.rlib:*(".text._ZN5alloc7raw_vec11finish_grow17hc0182a559248d403E")
    *libanchor_lang-*.rlib:*(".text.unlikely._ZN5alloc7raw_vec19RawVec$LT$T$C$A$GT$7reserve21do_reserve_and_handle17h6273a99bc657094fE")
    *libanchor_lang-*.rlib:*(".text._ZN5alloc7raw_vec19RawVec$LT$T$C$A$GT$8grow_one17hac569b46c36266b0E")
    *libanchor_lang-*.rlib:*(".text._ZN60_$LT$alloc..string..String$u20$as$u20$core..fmt..Display$GT$3fmt17heb0494973da8b0beE")
    *libanchor_lang-*.rlib:*(".text._ZN63_$LT$solana_pubkey..PubkeyError$u20$as$u20$core..fmt..Debug$GT$3fmt17h51eee67aafad0389E")
    *libanchor_lang-*.rlib:*(".text._ZN71_$LT$solana_program_error..ProgramError$u20$as$u20$core..fmt..Debug$GT$3fmt17he5da34f9213c2408E")
    *libanchor_lang-*.rlib:*(".text._ZN73_$LT$solana_program_error..ProgramError$u20$as$u20$core..clone..Clone$GT$5clone17h400b210cf5397ce6E")
    *libanchor_lang-*.rlib:*(".text._ZN11anchor_lang8accounts12account_info90_$LT$impl$u20$anchor_lang..ToAccountInfos$u20$for$u20$solana_account_info..AccountInfo$GT$16to_account_infos17h085788e96404d5e2E")
    *libanchor_lang-*.rlib:*(".text._ZN11anchor_lang8accounts6signer6Signer8try_from17h3ca2a15ffecf58e4E")
    *libanchor_lang-*.rlib:*(".text._ZN101_$LT$anchor_lang..bpf_writer..BpfWriter$LT$$RF$mut$u20$$u5b$u8$u5d$$GT$$u20$as$u20$std..io..Write$GT$9write_all17he3892b03b7ecf797E")
    *libanchor_lang-*.rlib:*(".text._ZN11anchor_lang6common5close17had5daaf9ed408a9cE")
    *libanchor_lang-*.rlib:*(".text._ZN11anchor_lang6common9is_closed17hb60082b4b480bcc8E")
    *libanchor_lang-*.rlib:*(".text._ZN104_$LT$anchor_lang..error..Error$u20$as$u20$core..convert..From$LT$anchor_lang..error..AnchorError$GT$$GT$4from17ha531868a68c48b86E")
    *libanchor_lang-*.rlib:*(".text._ZN107_$LT$anchor_lang..error..Error$u20$as$u20$core..convert..From$LT$solana_program_error..ProgramError$GT$$GT$4from17h910485bee7169999E")
    *libanchor_lang-*.rlib:*(".text._ZN94_$LT$anchor_lang..error..Error$u20$as$u20$core..convert..From$LT$std..io..error..Error$GT$$GT$4from17h5f663a867343fe93E")
    *libanchor_lang-*.rlib:*(".text._ZN106_$LT$anchor_lang..error..Error$u20$as$u20$core..convert..From$LT$core..num..error..TryFromIntError$GT$$GT$4from17h4a311674cb3e2fd1E")
    *libanchor_lang-*.rlib:*(".text._ZN11anchor_lang5error5Error3log17h047ca4660d872c10E")
    *libanchor_lang-*.rlib:*(".text._ZN11anchor_lang5error5Error17with_account_name17h808bb86ff58bb29eE")
    *libanchor_lang-*.rlib:*(".text._ZN11anchor_lang5error5Error12with_pubkeys17h25b89cda3d0139adE")
    *libanchor_lang-*.rlib:*(".text._ZN11anchor_lang5error22ProgramErrorWithOrigin3log17h16c6308e2f0bdf54E")
    *libanchor_lang-*.rlib:*(".text._ZN11anchor_lang5error11AnchorError3log17hdde86e0b1226a4c1E")
    *libanchor_lang-*.rlib:*(".text._ZN11anchor_lang5error117_$LT$impl$u20$core..convert..From$LT$anchor_lang..error..Error$GT$$u20$for$u20$solana_program_error..ProgramError$GT$4from17hd24241c167890ee3E")
    *libanchor_lang-*.rlib:*(".text._ZN11anchor_lang3idl10IdlAccount7address17h11b626c63a49aad1E")
    *libanchor_lang-*.rlib:*(".text._ZN11anchor_lang14system_program8allocate17he194ca4422e7f134E")
    *libanchor_lang-*.rlib:*(".text._ZN11anchor_lang14system_program6assign17h132bf51896467d4aE")
    *libanchor_lang-*.rlib:*(".text._ZN11anchor_lang14system_program14create_account17hbca447b63b359397E")
    *libanchor_lang-*.rlib:*(".text._ZN11anchor_lang14system_program8transfer17h3131995110e37a99E")
    *libanchor_lang-*.rlib:*(".text._ZN11anchor_lang14system_program18transfer_with_seed17h8e7095ad071aa342E")
    *libanchor_lang-*.rlib:*(".text._ZN11anchor_lang5error9ErrorCode4name17h69f4b845cf768421E")
    *libanchor_lang-*.rlib:*(".text._ZN102_$LT$anchor_lang..error..Error$u20$as$u20$core..convert..From$LT$anchor_lang..error..ErrorCode$GT$$GT$4from17h0092fa865ca25508E")
    *libanchor_lang-*.rlib:*(".text._ZN68_$LT$anchor_lang..error..ErrorCode$u20$as$u20$core..fmt..Display$GT$3fmt17h772309a233a8ae00E")
    *libanchor_lang-*.rlib:*(".text._ZN80_$LT$anchor_lang..idl..IdlAccount$u20$as$u20$anchor_lang..AccountDeserialize$GT$15try_deserialize17hbffce015c518aebaE")
    *libanchor_lang-*.rlib:*(".text._ZN80_$LT$anchor_lang..idl..IdlAccount$u20$as$u20$anchor_lang..AccountDeserialize$GT$25try_deserialize_unchecked17hd1ce7530a771233cE")
    *libsolana_program-*.rlib:*(".text._ZN14solana_program3log12sol_log_data17hf0beebd5f5883a69E")
    *libsolana_program-*.rlib:*(".text._ZN14solana_program7program6invoke17ha3ca310cab344d6dE")
    *libsolana_program-*.rlib:*(".text._ZN14solana_program7program13invoke_signed17ha5e7299f76b436f1E")
    *libsolana_program-*.rlib:*(".text._ZN14solana_program7program15set_return_data17h33e0475fe55d4eddE")
    *libsolana_program-*.rlib:*(".text._ZN14solana_program7program15get_return_data17h2a6c8e5fc5d0aeaaE")
    *libsolana_borsh-*.rlib:*(".text._ZN65_$LT$solana_borsh..v1..WriteCounter$u20$as$u20$std..io..Write$GT$5write17hcd3ca4aeebad799aE")
    *libsolana_sysvar-*.rlib:*(".text._ZN13solana_sysvar5clock71_$LT$impl$u20$solana_sysvar..Sysvar$u20$for$u20$solana_clock..Clock$GT$3get17h968837c5c5c04cc1E")
    *libsolana_sysvar-*.rlib:*(".text._ZN13solana_sysvar4rent69_$LT$impl$u20$solana_sysvar..Sysvar$u20$for$u20$solana_rent..Rent$GT$3get17h4a64e953839d24cbE")
    *libsolana_rent-*.rlib:*(".text._ZN11solana_rent4Rent15minimum_balance17h6aa5feadf29308c3E")
    *libsolana_rent-*.rlib:*(".text._ZN11solana_rent4Rent9is_exempt17h45604cd2e6454fe1E")
    *libsolana_rent-*.rlib:*(".text._ZN11solana_rent6sysvar74_$LT$impl$u20$solana_sysvar_id..SysvarId$u20$for$u20$solana_rent..Rent$GT$8check_id17h9acf79f86eba244eE")
    *libsolana_program_entrypoint-*.rlib:*(".text._ZN5alloc7raw_vec11finish_grow17hdc2607dab862574cE")
    *libsolana_program_entrypoint-*.rlib:*(".text._ZN5alloc7raw_vec19RawVec$LT$T$C$A$GT$8grow_one17h8f9176579a930d74E")
    *libsolana_program_entrypoint-*.rlib:*(".text._ZN25solana_program_entrypoint11deserialize17hfda8bd30b19e7c4aE")
    *libsolana_cpi-*.rlib:*(".text._ZN10solana_cpi23invoke_signed_unchecked17hb42e4d84e74bfc14E")
    *libsolana_cpi-*.rlib:*(".text._ZN10solana_cpi15set_return_data17h7bc36a18798140aeE")
    *libsolana_cpi-*.rlib:*(".text._ZN10solana_cpi15get_return_data17h2aab37eae149482cE")
    *libsolana_account_info-*.rlib:*(".text._ZN41_$LT$bool$u20$as$u20$core..fmt..Debug$GT$3fmt17ha1b7b3de7be44e11E")
    *libsolana_account_info-*.rlib:*(".text._ZN42_$LT$$RF$T$u20$as$u20$core..fmt..Debug$GT$3fmt17h3f949b6726433815E")
    *libsolana_account_info-*.rlib:*(".text._ZN4core3fmt3num50_$LT$impl$u20$core..fmt..Debug$u20$for$u20$u64$GT$3fmt17ha41bc41457914c76E")
    *libsolana_account_info-*.rlib:*(".text._ZN4core3fmt3num52_$LT$impl$u20$core..fmt..Debug$u20$for$u20$usize$GT$3fmt17h92ca3aff4bf1c48dE")
    *libsolana_account_info-*.rlib:*(".text._ZN4core3ptr24drop_in_place$LT$u64$GT$17hd76135e96fc7940fE")
    *libsolana_account_info-*.rlib:*(".text._ZN4core3ptr25drop_in_place$LT$bool$GT$17h18be9e9852a40197E")
    *libsolana_account_info-*.rlib:*(".text._ZN81_$LT$solana_account_info..debug_account_data..Hex$u20$as$u20$core..fmt..Debug$GT$3fmt17hf33f0b1acc2420a1E")
    *libsolana_account_info-*.rlib:*(".text._ZN69_$LT$solana_account_info..AccountInfo$u20$as$u20$core..fmt..Debug$GT$3fmt17h1056d54ef3137596E")
    *libsolana_account_info-*.rlib:*(".text._ZN19solana_account_info11AccountInfo8lamports17hd39eba818aa7186bE")
    *libsolana_account_info-*.rlib:*(".text._ZN19solana_account_info11AccountInfo8data_len17h1da413420169f1a3E")
    *libsolana_account_info-*.rlib:*(".text._ZN19solana_account_info11AccountInfo12try_data_len17hc0d410cc92308810E")
    *libsolana_account_info-*.rlib:*(".text._ZN19solana_account_info11AccountInfo13data_is_empty17h758d3dfe2b5ad853E")
    *libsolana_account_info-*.rlib:*(".text._ZN19solana_account_info11AccountInfo19try_borrow_lamports17hf795133bd0dbc4ebE")
    *libsolana_account_info-*.rlib:*(".text._ZN19solana_account_info11AccountInfo23try_borrow_mut_lamports17h3be834b7eae80c62E")
    *libsolana_account_info-*.rlib:*(".text._ZN19solana_account_info11AccountInfo15try_borrow_data17h67884573476e83adE")
    *libsolana_account_info-*.rlib:*(".text._ZN19solana_account_info11AccountInfo19try_borrow_mut_data17h527912cb2844fc90E")
    *libsolana_account_info-*.rlib:*(".text._ZN19solana_account_info11AccountInfo7realloc17h037cb21b56d5d897E")
    *libsolana_account_info-*.rlib:*(".text._ZN19solana_account_info11AccountInfo6assign17h735677a08297a70bE")
    *libsolana_program_error-*.rlib:*(".text._ZN44_$LT$$RF$T$u20$as$u20$core..fmt..Display$GT$3fmt17he90b3dcfe1625903E")
    *libsolana_program_error-*.rlib:*(".text._ZN45_$LT$$RF$T$u20$as$u20$core..fmt..LowerHex$GT$3fmt17h64a4f179da3dbbc7E")
    *libsolana_program_error-*.rlib:*(".text._ZN73_$LT$solana_program_error..ProgramError$u20$as$u20$core..fmt..Display$GT$3fmt17haf50b4e721a6e07fE")
    *libsolana_program_error-*.rlib:*(".text._ZN20solana_program_error95_$LT$impl$u20$core..convert..From$LT$solana_program_error..ProgramError$GT$$u20$for$u20$u64$GT$4from17ha5d3d1cf4de2b063E")
    *libsolana_program_error-*.rlib:*(".text._ZN85_$LT$solana_program_error..ProgramError$u20$as$u20$core..convert..From$LT$u64$GT$$GT$4from17h6853cd09c2464006E")
    *libsolana_program_error-*.rlib:*(".text._ZN103_$LT$solana_program_error..ProgramError$u20$as$u20$core..convert..From$LT$std..io..error..Error$GT$$GT$4from17h19a7879a2dc2aa06E")
    *libsolana_system_interface-*.rlib:*(".text._ZN13solana_pubkey1_78_$LT$impl$u20$serde_core..ser..Serialize$u20$for$u20$solana_pubkey..Pubkey$GT$9serialize17h73539b0eee189521E")
    *libsolana_system_interface-*.rlib:*(".text._ZN18solana_instruction11Instruction16new_with_bincode17h365424f6c383c332E")
    *libsolana_system_interface-*.rlib:*(".text._ZN42_$LT$$RF$T$u20$as$u20$core..fmt..Debug$GT$3fmt17haa72f358db6aa22eE")
    *libsolana_system_interface-*.rlib:*(".text._ZN42_$LT$$RF$T$u20$as$u20$core..fmt..Debug$GT$3fmt17h224cef944499bfa8E")
    *libsolana_system_interface-*.rlib:*(".text._ZN42_$LT$$RF$T$u20$as$u20$core..fmt..Debug$GT$3fmt17h80331f77a3f5fc77E")
    *libsolana_system_interface-*.rlib:*(".text._ZN42_$LT$$RF$T$u20$as$u20$core..fmt..Debug$GT$3fmt17h45d42afd53152014E")
    *libsolana_system_interface-*.rlib:*(".text._ZN42_$LT$$RF$T$u20$as$u20$core..fmt..Debug$GT$3fmt17hf0e6226005e0c035E")
    *libsolana_system_interface-*.rlib:*(".text._ZN42_$LT$$RF$T$u20$as$u20$core..fmt..Debug$GT$3fmt17h33f129650bad8a39E")
    *libsolana_system_interface-*.rlib:*(".text._ZN4core3fmt3num52_$LT$impl$u20$core..fmt..Debug$u20$for$u20$usize$GT$3fmt17h92ca3aff4bf1c48dE")
    *libsolana_system_interface-*.rlib:*(".text._ZN4core3ptr26drop_in_place$LT$usize$GT$17h97fbfe6dbed13ad9E")
    *libsolana_system_interface-*.rlib:*(".text._ZN4core3ptr71drop_in_place$LT$alloc..boxed..Box$LT$bincode..error..ErrorKind$GT$$GT$17h135489e5d9c78435E")
    *libsolana_system_interface-*.rlib:*(".text._ZN5alloc7raw_vec11finish_grow17h7d85f557850d0c52E")
    *libsolana_system_interface-*.rlib:*(".text.unlikely._ZN5alloc7raw_vec19RawVec$LT$T$C$A$GT$7reserve21do_reserve_and_handle17h72c33a61c4d2ef93E")
    *libsolana_system_interface-*.rlib:*(".text._ZN67_$LT$alloc..boxed..Box$LT$T$C$A$GT$$u20$as$u20$core..fmt..Debug$GT$3fmt17h1a8ae7bcaeb29641E")
    *libsolana_system_interface-*.rlib:*(".text._ZN23solana_system_interface11instruction14create_account17h24eaf22e0f5b0f98E")
    *libsolana_system_interface-*.rlib:*(".text._ZN23solana_system_interface11instruction24create_account_with_seed17h30a2101b6a9dbd01E")
    *libsolana_system_interface-*.rlib:*(".text._ZN23solana_system_interface11instruction6assign17ha0cb4308803eebbbE")
    *libsolana_system_interface-*.rlib:*(".text._ZN23solana_system_interface11instruction8transfer17hb32df29488f92c94E")
    *libsolana_system_interface-*.rlib:*(".text._ZN23solana_system_interface11instruction18transfer_with_seed17h3b19a091f497884fE")
    *libsolana_system_interface-*.rlib:*(".text._ZN23solana_system_interface11instruction8allocate17h1e6d820dc6f684ecE")
    *libsolana_instruction-*.rlib:*(".text._ZN18solana_instruction11Instruction14new_with_bytes17h75dd3858b6c4693eE")
    *libbincode-*.rlib:*(".text._ZN7bincode5error129_$LT$impl$u20$core..convert..From$LT$std..io..error..Error$GT$$u20$for$u20$alloc..boxed..Box$LT$bincode..error..ErrorKind$GT$$GT$4from17hf04d328e3a073c06E")
    *libsolana_sdk_ids-*.rlib:*(".text._ZN14solana_sdk_ids6sysvar4rent8check_id17h1bedb5b267d42e5cE")
    *libsolana_pubkey-*.rlib:*(".text._ZN42_$LT$$RF$T$u20$as$u20$core..fmt..Debug$GT$3fmt17h65a8932dda0002ffE")
    *libsolana_pubkey-*.rlib:*(".text._ZN42_$LT$$RF$T$u20$as$u20$core..fmt..Debug$GT$3fmt17h8645ca9562473958E")
    *libsolana_pubkey-*.rlib:*(".text._ZN4core3fmt3num52_$LT$impl$u20$core..fmt..Debug$u20$for$u20$usize$GT$3fmt17h92ca3aff4bf1c48dE")
    *libsolana_pubkey-*.rlib:*(".text._ZN4core3ptr101drop_in_place$LT$$RF$alloc..vec..Vec$LT$$LP$alloc..string..String$C$alloc..string..String$RP$$GT$$GT$17h28bbb65a1de48304E")
    *libsolana_pubkey-*.rlib:*(".text._ZN4core3ptr40drop_in_place$LT$bs58..encode..Error$GT$17hbf790882693f2cedE")
    *libsolana_pubkey-*.rlib:*(".text._ZN56_$LT$bs58..encode..Error$u20$as$u20$core..fmt..Debug$GT$3fmt17h2e547a1a531029f9E")
    *libsolana_pubkey-*.rlib:*(".text._ZN64_$LT$core..str..error..Utf8Error$u20$as$u20$core..fmt..Debug$GT$3fmt17h2fa41155b122786bE")
    *libsolana_pubkey-*.rlib:*(".text._ZN13solana_pubkey6Pubkey16create_with_seed17h31523bcb4f916432E")
    *libsolana_pubkey-*.rlib:*(".text._ZN13solana_pubkey6Pubkey20find_program_address17he32b218811df6dd3E")
    *libsolana_pubkey-*.rlib:*(".text._ZN13solana_pubkey6Pubkey22create_program_address17hfa8f9726e9f78b02E")
    *libsolana_pubkey-*.rlib:*(".text._ZN13solana_pubkey6Pubkey3log17h17adcf106a07b395E")
    *libsolana_pubkey-*.rlib:*(".text._ZN13solana_pubkey15write_as_base5817h76debcc78ebe9c8cE")
    *libsolana_pubkey-*.rlib:*(".text._ZN58_$LT$solana_pubkey..Pubkey$u20$as$u20$core..fmt..Debug$GT$3fmt17h45f9cee000b25b6cE")
    *libborsh-*.rlib:*(".text._ZN3std2io5error14repr_bitpacked14kind_from_prim17h357bcb36090597d1E")
    *libborsh-*.rlib:*(".text._ZN3std2io5error5Error3new17hc29643f15c8dc723E")
    *libborsh-*.rlib:*(".text._ZN4core3ptr205drop_in_place$LT$$LT$alloc..boxed..Box$LT$dyn$u20$core..error..Error$u2b$core..marker..Sync$u2b$core..marker..Send$GT$$u20$as$u20$core..convert..From$LT$alloc..string..String$GT$$GT$..from..StringError$GT$17h6916ce23d17e63caE")
    *libborsh-*.rlib:*(".text._ZN4core5error5Error5cause17h72280aa7a2aa4218E")
    *libborsh-*.rlib:*(".text._ZN4core5error5Error7provide17haa57167b87a8fe90E")
    *libborsh-*.rlib:*(".text._ZN4core5error5Error7type_id17h4857e6a95cb01ee5E")
    *libborsh-*.rlib:*(".text._ZN5borsh2de44unexpected_eof_to_unexpected_length_of_input17h515480ced455dce8E")
    *libsolana_sha256_hasher-*.rlib:*(".text._ZN20solana_sha256_hasher5hashv17h5eb9b6c2a4d77e39E")
    *libbs58-*.rlib:*(".text._ZN4bs586encode15max_encoded_len17hfae7b11af26151d5E")
    *libstd-*.rlib:*(".text._ZN42_$LT$$RF$T$u20$as$u20$core..fmt..Debug$GT$3fmt17hacd4ffaa7c47be3eE")
    *libstd-*.rlib:*(".text._ZN42_$LT$$RF$T$u20$as$u20$core..fmt..Debug$GT$3fmt17hb3a48d441e166368E")
    *libstd-*.rlib:*(".text._ZN44_$LT$$RF$T$u20$as$u20$core..fmt..Display$GT$3fmt17h4a12aaf00bc6eb91E")
    *libstd-*.rlib:*(".text._ZN4core3fmt3num50_$LT$impl$u20$core..fmt..Debug$u20$for$u20$i32$GT$3fmt17hc11af8c6428b7be9E")
    *libstd-*.rlib:*(".text._ZN4core3ptr122drop_in_place$LT$$RF$alloc..boxed..Box$LT$dyn$u20$core..error..Error$u2b$core..marker..Sync$u2b$core..marker..Send$GT$$GT$17hffb69c92d326aa89E")
    *libstd-*.rlib:*(".text._ZN4core3ptr24drop_in_place$LT$i32$GT$17h5892138452e8d0acE")
    *libstd-*.rlib:*(".text._ZN4core3ptr25drop_in_place$LT$bool$GT$17hc0900eae472d6565E")
    *libstd-*.rlib:*(".text._ZN4core3ptr42drop_in_place$LT$alloc..string..String$GT$17hbac89b01ec5b6e98E")
    *libstd-*.rlib:*(".text._ZN58_$LT$alloc..string..String$u20$as$u20$core..fmt..Debug$GT$3fmt17he9ae983dac9351bdE")
    *libstd-*.rlib:*(".text._ZN60_$LT$alloc..string..String$u20$as$u20$core..fmt..Display$GT$3fmt17heb0494973da8b0beE")
    *libstd-*.rlib:*(".text._ZN3std2io5error14repr_bitpacked14kind_from_prim17h357bcb36090597d1E")
    *libstd-*.rlib:*(".text._ZN58_$LT$std..io..error..Error$u20$as$u20$core..fmt..Debug$GT$3fmt17had9d55c5608fe73bE")
    *libstd-*.rlib:*(".text._ZN3std2io5error9ErrorKind6as_str17h9f2f9fbb981740c3E")
    *libstd-*.rlib:*(".text._ZN3std2io5error5Error4_new17h22f74a6f7f505a25E")
    *libstd-*.rlib:*(".text._ZN3std2io5error83_$LT$impl$u20$core..fmt..Debug$u20$for$u20$std..io..error..repr_bitpacked..Repr$GT$3fmt17h882efd8da84ce68bE")
    *libstd-*.rlib:*(".text._ZN60_$LT$std..io..error..Error$u20$as$u20$core..fmt..Display$GT$3fmt17h6f1fce23b165cb49E")
    *libstd-*.rlib:*(".text.unlikely._ZN3std7process5abort17h6e9c75c1fb1896a3E")
    *libstd-*.rlib:*(".text.rust_begin_unwind")
    *libstd-*.rlib:*(".text._ZN62_$LT$std..io..error..ErrorKind$u20$as$u20$core..fmt..Debug$GT$3fmt17h7056c3897a928533E")
    *libstd-*.rlib:*(".text._ZN3std3sys3pal3sbf7sol_log17h72e39c62458c86feE")
    *libstd-*.rlib:*(".text._ZN3std3sys3pal3sbf5panic17h0bde0aa91ab47d38E")
    *libstd-*.rlib:*(".text._ZN3std3sys3pal3sbf14abort_internal17h3bd5992ddcab11c6E")
    *libstd-*.rlib:*(".text._ZN3std5alloc8rust_oom17he7a3a8dfb7e1e822E")
    *libstd-*.rlib:*(".text.__rg_oom")
    *liballoc-*.rlib:*(".text._ZN4core3fmt5Write9write_fmt17h41853e2b01bf2bf4E")
    *liballoc-*.rlib:*(".text._ZN4core3ptr37drop_in_place$LT$core..fmt..Error$GT$17h727a76ec9e106744E")
    *liballoc-*.rlib:*(".text._ZN4core3ptr42drop_in_place$LT$alloc..string..String$GT$17hf9f11e0679d775efE")
    *liballoc-*.rlib:*(".text._ZN53_$LT$core..fmt..Error$u20$as$u20$core..fmt..Debug$GT$3fmt17h85666afa16c4890eE")
    *liballoc-*.rlib:*(".text._ZN5alloc7raw_vec17capacity_overflow17ha1c10832a9d67d74E")
    *liballoc-*.rlib:*(".text.unlikely._ZN5alloc7raw_vec19RawVec$LT$T$C$A$GT$7reserve21do_reserve_and_handle17hfb848a1eba01a183E")
    *liballoc-*.rlib:*(".text._ZN5alloc7raw_vec19RawVec$LT$T$C$A$GT$8grow_one17h3266ee234dbf1514E")
    *liballoc-*.rlib:*(".text._ZN5alloc7raw_vec11finish_grow17h2a9b58a4d29975d9E")
    *liballoc-*.rlib:*(".text.unlikely._ZN5alloc7raw_vec12handle_error17h22fdf317f3a37641E")
    *liballoc-*.rlib:*(".text.unlikely._ZN5alloc5alloc18handle_alloc_error17hdf8d5797c8d8bbffE")
    *liballoc-*.rlib:*(".text._ZN223_$LT$$LT$alloc..boxed..Box$LT$dyn$u20$core..error..Error$u2b$core..marker..Sync$u2b$core..marker..Send$GT$$u20$as$u20$core..convert..From$LT$alloc..string..String$GT$$GT$..from..StringError$u20$as$u20$core..error..Error$GT$11description17hf25e5ff77ea0398dE")
    *liballoc-*.rlib:*(".text._ZN223_$LT$$LT$alloc..boxed..Box$LT$dyn$u20$core..error..Error$u2b$core..marker..Sync$u2b$core..marker..Send$GT$$u20$as$u20$core..convert..From$LT$alloc..string..String$GT$$GT$..from..StringError$u20$as$u20$core..fmt..Display$GT$3fmt17h90a7b52b4b824722E")
    *liballoc-*.rlib:*(".text._ZN221_$LT$$LT$alloc..boxed..Box$LT$dyn$u20$core..error..Error$u2b$core..marker..Sync$u2b$core..marker..Send$GT$$u20$as$u20$core..convert..From$LT$alloc..string..String$GT$$GT$..from..StringError$u20$as$u20$core..fmt..Debug$GT$3fmt17hec448305f4a90e51E")
    *liballoc-*.rlib:*(".text._ZN5alloc3fmt6format12format_inner17ha2861f2eb5816c39E")
    *liballoc-*.rlib:*(".text._ZN5alloc6string6String4push17h96dfc48c19bd6e38E")
    *liballoc-*.rlib:*(".text._ZN67_$LT$alloc..string..FromUtf8Error$u20$as$u20$core..fmt..Display$GT$3fmt17h876048dc57804b5eE")
    *liballoc-*.rlib:*(".text._ZN60_$LT$alloc..string..String$u20$as$u20$core..clone..Clone$GT$5clone17h415f8832ba4c6f63E")
    *liballoc-*.rlib:*(".text._ZN58_$LT$alloc..string..String$u20$as$u20$core..fmt..Write$GT$9write_str17h4b62f46a222bd5b2E")
    *liballoc-*.rlib:*(".text._ZN58_$LT$alloc..string..String$u20$as$u20$core..fmt..Write$GT$10write_char17hfde5b685689164ccE")
    *libcore-*.rlib:*(".text._ZN4core3ptr26drop_in_place$LT$usize$GT$17h5739510b1afbdae5E")
    *libcore-*.rlib:*(".text._ZN4core3ptr37drop_in_place$LT$core..fmt..Error$GT$17ha026248e31a11692E")
    *libcore-*.rlib:*(".text._ZN72_$LT$core..num..error..TryFromIntError$u20$as$u20$core..fmt..Display$GT$3fmt17hbc9869a4fe3080f5E")
    *libcore-*.rlib:*(".text._ZN71_$LT$core..ops..range..Range$LT$Idx$GT$$u20$as$u20$core..fmt..Debug$GT$3fmt17hb4d8325772f511feE")
    *libcore-*.rlib:*(".text._ZN36_$LT$T$u20$as$u20$core..any..Any$GT$7type_id17h4929060c3423c41bE")
    *libcore-*.rlib:*(".text._ZN60_$LT$core..cell..BorrowError$u20$as$u20$core..fmt..Debug$GT$3fmt17h294c05841422bb75E")
    *libcore-*.rlib:*(".text._ZN63_$LT$core..cell..BorrowMutError$u20$as$u20$core..fmt..Debug$GT$3fmt17hf1ce37697cc17579E")
    *libcore-*.rlib:*(".text.unlikely._ZN4core4cell22panic_already_borrowed17heaf1d391c7e3ac3fE")
    *libcore-*.rlib:*(".text.unlikely._ZN4core4cell30panic_already_mutably_borrowed17h1b0d052ee073462cE")
    *libcore-*.rlib:*(".text._ZN4core4char7methods22_$LT$impl$u20$char$GT$16escape_debug_ext17h432481fd8a85ee26E")
    *libcore-*.rlib:*(".text.unlikely._ZN4core6option13unwrap_failed17h74c33646acebf943E")
    *libcore-*.rlib:*(".text.unlikely._ZN4core6option13expect_failed17h7e2cb204b05dab71E")
    *libcore-*.rlib:*(".text._ZN73_$LT$core..panic..panic_info..PanicInfo$u20$as$u20$core..fmt..Display$GT$3fmt17h4777505b2ae1d28dE")
    *libcore-*.rlib:*(".text.unlikely._ZN4core9panicking9panic_fmt17h0f7a5cdbeae7e874E")
    *libcore-*.rlib:*(".text.unlikely._ZN4core9panicking5panic17h0d41b9de9b340d2cE")
    *libcore-*.rlib:*(".text._ZN4core9panicking13panic_display17hc25466684451ad26E")
    *libcore-*.rlib:*(".text.unlikely._ZN4core9panicking18panic_bounds_check17h7ccbe16ef5157d86E")
    *libcore-*.rlib:*(".text.unlikely._ZN4core9panicking13assert_failed17h0bccda201990b6feE")
    *libcore-*.rlib:*(".text.unlikely._ZN4core9panicking19assert_failed_inner17hbe9d8d3e6281311cE")
    *libcore-*.rlib:*(".text.unlikely._ZN4core6result13unwrap_failed17h2dbd2ef42161686dE")
    *libcore-*.rlib:*(".text._ZN68_$LT$core..fmt..builders..PadAdapter$u20$as$u20$core..fmt..Write$GT$9write_str17hc0862e4b7f7f17f1E")
    *libcore-*.rlib:*(".text._ZN68_$LT$core..fmt..builders..PadAdapter$u20$as$u20$core..fmt..Write$GT$10write_char17h02e7db9e58475120E")
    *libcore-*.rlib:*(".text._ZN4core3fmt8builders11DebugStruct5field17ha37d013977aa91fdE")
    *libcore-*.rlib:*(".text._ZN4core3fmt8builders11DebugStruct21finish_non_exhaustive17hf554d15ace7a2712E")
    *libcore-*.rlib:*(".text._ZN4core3fmt8builders11DebugStruct6finish17h8fd3f9471c3ff6f0E")
    *libcore-*.rlib:*(".text._ZN4core3fmt8builders10DebugTuple5field17hf6b28860505edb28E")
    *libcore-*.rlib:*(".text._ZN4core3fmt8builders10DebugTuple6finish17he8ef120405a3623aE")
    *libcore-*.rlib:*(".text._ZN4core3fmt8builders8DebugSet5entry17hbdf59f8814adbd1dE")
    *libcore-*.rlib:*(".text._ZN4core3fmt8builders9DebugList6finish17he23fd077c2176cc5E")
    *libcore-*.rlib:*(".text._ZN4core3fmt5Write9write_fmt17h6837fd873343534aE")
    *libcore-*.rlib:*(".text._ZN59_$LT$core..fmt..Arguments$u20$as$u20$core..fmt..Display$GT$3fmt17h26470d47aac2b227E")
    *libcore-*.rlib:*(".text._ZN4core3fmt5write17h7d5c5d972f6bf082E")
    *libcore-*.rlib:*(".text._ZN4core3fmt9Formatter12pad_integral17heaa37964a6dd8056E")
    *libcore-*.rlib:*(".text._ZN4core3fmt9Formatter12pad_integral12write_prefix17hfbe5552cd6b30346E")
    *libcore-*.rlib:*(".text._ZN4core3fmt9Formatter3pad17h5907829474a9bceeE")
    *libcore-*.rlib:*(".text._ZN4core3fmt9Formatter9write_str17h97ca3d8b34e3baaaE")
    *libcore-*.rlib:*(".text._ZN4core3fmt9Formatter12debug_struct17h37580ee70d759b9aE")
    *libcore-*.rlib:*(".text._ZN4core3fmt9Formatter26debug_struct_field2_finish17h82b80710749c7cfaE")
    *libcore-*.rlib:*(".text._ZN4core3fmt9Formatter26debug_struct_fields_finish17h0d6f5eb6e5e3cf42E")
    *libcore-*.rlib:*(".text._ZN4core3fmt9Formatter11debug_tuple17hb3e7b749cdefa079E")
    *libcore-*.rlib:*(".text._ZN4core3fmt9Formatter25debug_tuple_field1_finish17h1ecb531db1e81cbcE")
    *libcore-*.rlib:*(".text._ZN4core3fmt9Formatter10debug_list17h2bcc3c1fc62b2501E")
    *libcore-*.rlib:*(".text._ZN43_$LT$bool$u20$as$u20$core..fmt..Display$GT$3fmt17h12fdd96791bf4720E")
    *libcore-*.rlib:*(".text._ZN40_$LT$str$u20$as$u20$core..fmt..Debug$GT$3fmt17hae48b4192ee269ddE")
    *libcore-*.rlib:*(".text._ZN42_$LT$str$u20$as$u20$core..fmt..Display$GT$3fmt17h0b6b1c0d11558f97E")
    *libcore-*.rlib:*(".text._ZN41_$LT$char$u20$as$u20$core..fmt..Debug$GT$3fmt17h1fe6a75374a14bbdE")
    *libcore-*.rlib:*(".text.unlikely._ZN4core5slice5index26slice_start_index_len_fail17hb959cdd5411bf208E")
    *libcore-*.rlib:*(".text._ZN4core5slice5index29slice_start_index_len_fail_rt17hce7760188b5b6773E")
    *libcore-*.rlib:*(".text.unlikely._ZN4core5slice5index24slice_end_index_len_fail17h3f8438963677f5b8E")
    *libcore-*.rlib:*(".text._ZN4core5slice5index27slice_end_index_len_fail_rt17h8c7011f54f8a6ea8E")
    *libcore-*.rlib:*(".text.unlikely._ZN4core5slice5index22slice_index_order_fail17hcc61bcee7ef2204dE")
    *libcore-*.rlib:*(".text._ZN4core5slice5index25slice_index_order_fail_rt17h8328cf0ce2de080cE")
    *libcore-*.rlib:*(".text._ZN4core3str8converts9from_utf817he402f91d70305d69E")
    *libcore-*.rlib:*(".text._ZN4core3str5count14do_count_chars17h482c90f559dea5ddE")
    *libcore-*.rlib:*(".text._ZN66_$LT$core..str..error..Utf8Error$u20$as$u20$core..fmt..Display$GT$3fmt17he47bb0dd3b9305e4E")
    *libcore-*.rlib:*(".text.unlikely._ZN4core3str16slice_error_fail17hf42b0f231ab5f2a3E")
    *libcore-*.rlib:*(".text._ZN4core3str19slice_error_fail_rt17h46e4f0f443d74f6aE")
    *libcore-*.rlib:*(".text._ZN4core7unicode9printable5check17hd49316ac30aef8eaE")
    *libcore-*.rlib:*(".text._ZN4core7unicode9printable12is_printable17hfc735d3bd1e2f4bdE")
    *libcore-*.rlib:*(".text.unlikely._ZN4core9panicking11panic_const24panic_const_add_overflow17hf6e3f7f30ea7b475E")
    *libcore-*.rlib:*(".text.unlikely._ZN4core9panicking11panic_const24panic_const_mul_overflow17hda4f409bbdb81e0fE")
    *libcore-*.rlib:*(".text._ZN4core3fmt3num52_$LT$impl$u20$core..fmt..LowerHex$u20$for$u20$i8$GT$3fmt17h9b21bb3d68d263e2E")
    *libcore-*.rlib:*(".text._ZN4core3fmt3num52_$LT$impl$u20$core..fmt..UpperHex$u20$for$u20$i8$GT$3fmt17hc21886e9f484c040E")
    *libcore-*.rlib:*(".text._ZN4core3fmt3num53_$LT$impl$u20$core..fmt..LowerHex$u20$for$u20$i32$GT$3fmt17hba592a4ed6a952beE")
    *libcore-*.rlib:*(".text._ZN4core3fmt3num53_$LT$impl$u20$core..fmt..UpperHex$u20$for$u20$i32$GT$3fmt17h119275f35091df64E")
    *libcore-*.rlib:*(".text._ZN4core3fmt3num53_$LT$impl$u20$core..fmt..LowerHex$u20$for$u20$i64$GT$3fmt17hd6e473fabd88c0e3E")
    *libcore-*.rlib:*(".text._ZN4core3fmt3num53_$LT$impl$u20$core..fmt..UpperHex$u20$for$u20$i64$GT$3fmt17h846afeb54ce0baf8E")
    *libcore-*.rlib:*(".text._ZN4core3fmt3num52_$LT$impl$u20$core..fmt..Debug$u20$for$u20$usize$GT$3fmt17h92ca3aff4bf1c48dE")
    *libcore-*.rlib:*(".text._ZN4core3fmt3num3imp7fmt_u6417h1a8e9846ca374650E")
    *libcore-*.rlib:*(".text._ZN4core3fmt3num3imp51_$LT$impl$u20$core..fmt..Display$u20$for$u20$u8$GT$3fmt17h3fdeac06436d4c67E")
    *libcore-*.rlib:*(".text._ZN4core3fmt3num3imp52_$LT$impl$u20$core..fmt..Display$u20$for$u20$i32$GT$3fmt17hb00e11d2392487b4E")
    *libcore-*.rlib:*(".text._ZN4core3fmt3num3imp52_$LT$impl$u20$core..fmt..Display$u20$for$u20$u32$GT$3fmt17hdf9bfd9306a960f1E")
    *libcore-*.rlib:*(".text._ZN4core3fmt3num3imp52_$LT$impl$u20$core..fmt..Display$u20$for$u20$i64$GT$3fmt17h910bef7c5c363c6cE")
    *libcore-*.rlib:*(".text._ZN4core3fmt3num3imp52_$LT$impl$u20$core..fmt..Display$u20$for$u20$u64$GT$3fmt17h507b2a1c734f693aE")
    *libcore-*.rlib:*(".text._ZN42_$LT$$RF$T$u20$as$u20$core..fmt..Debug$GT$3fmt17h5cebf789a726af6bE")
    *libcore-*.rlib:*(".text._ZN42_$LT$$RF$T$u20$as$u20$core..fmt..Debug$GT$3fmt17hba22cabdf2fe6533E")
    *libcore-*.rlib:*(".text._ZN44_$LT$$RF$T$u20$as$u20$core..fmt..Display$GT$3fmt17had943f84706d0d41E")
    *libcore-*.rlib:*(".text._ZN4core7unicode12unicode_data15grapheme_extend11lookup_slow17hcf98483823ff1d10E")
    *libcompiler_builtins-*.rlib:*(".text.__fixunsdfdi")
    *libcompiler_builtins-*.rlib:*(".text.memcpy")
    *libcompiler_builtins-*.rlib:*(".text.memmove")
    *libcompiler_builtins-*.rlib:*(".text.memset")
    *libcompiler_builtins-*.rlib:*(".text.memcmp")
    *libcompiler_builtins-*.rlib:*(".text.__floatundidf")
    *libcompiler_builtins-*.rlib:*(".text.__muldf3")
    *libcompiler_builtins-*.rlib:*(".text._ZN17compiler_builtins5float3mul8__muldf317hccb5c4c520220eeaE")
    *libcompiler_builtins-*.rlib:*(".text.__udivti3")
    *libcompiler_builtins-*.rlib:*(".text._ZN17compiler_builtins3int19specialized_div_rem12u128_div_rem17h8126f7c9bea9df73E")
    *libcompiler_builtins-*.rlib:*(".text.__lshrti3")
    *libcompiler_builtins-*.rlib:*(".text.__multi3")
    *libcompiler_builtins-*.rlib:*(".text.__gtdf2")
    *libcompiler_builtins-*.rlib:*(".text.__gedf2")
    *libcompiler_builtins-*.rlib:*(".text.__ashlti3")
    *(.text*)
  } :text
  .rodata : { *(.rodata*) } :rodata
  .data.rel.ro : { *(.data.rel.ro*) } :rodata
  .dynamic : { *(.dynamic) } :dynamic
  .dynsym : { *(.dynsym) } :data
  .dynstr : { *(.dynstr) } :data
  .rel.dyn : { *(.rel.dyn) } :data
  /DISCARD/ : {
      *(.eh_frame*)
      *(.gnu.hash*)
      *(.hash*)
    }
}
