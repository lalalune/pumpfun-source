PHDRS
{
  text PT_LOAD ;
  rodata PT_LOAD ;
  data PT_LOAD ;
  dynamic PT_DYNAMIC ;
}

SECTIONS
{
  . = SIZEOF_HEADERS;
  .text : {
    *donation_relay_source_proposal.donation_relay_source_proposal.3e8f165cd5c7a961-cgu.0.rcgu.o(".text._ZN103_$LT$anchor_lang..accounts..interface..Interface$LT$T$GT$$u20$as$u20$anchor_lang..Accounts$LT$B$GT$$GT$12try_accounts17h12bdfce3979b9237E")
    *donation_relay_source_proposal.donation_relay_source_proposal.3e8f165cd5c7a961-cgu.0.rcgu.o(".text._ZN111_$LT$alloc..vec..Vec$LT$T$GT$$u20$as$u20$alloc..vec..spec_from_iter_nested..SpecFromIterNested$LT$T$C$I$GT$$GT$9from_iter17he2a0fef10a2a069eE")
    *donation_relay_source_proposal.donation_relay_source_proposal.3e8f165cd5c7a961-cgu.0.rcgu.o(".text._ZN118_$LT$anchor_lang..accounts..interface_account..InterfaceAccount$LT$T$GT$$u20$as$u20$anchor_lang..Accounts$LT$B$GT$$GT$12try_accounts17h10e1ee1702b15dddE")
    *donation_relay_source_proposal.donation_relay_source_proposal.3e8f165cd5c7a961-cgu.0.rcgu.o(".text._ZN118_$LT$anchor_lang..accounts..interface_account..InterfaceAccount$LT$T$GT$$u20$as$u20$anchor_lang..Accounts$LT$B$GT$$GT$12try_accounts17h507a5765579f4037E")
    *donation_relay_source_proposal.donation_relay_source_proposal.3e8f165cd5c7a961-cgu.0.rcgu.o(".text._ZN11anchor_lang5error5Error11with_values17h0a3d89da7557e74aE")
    *donation_relay_source_proposal.donation_relay_source_proposal.3e8f165cd5c7a961-cgu.0.rcgu.o(".text._ZN11anchor_lang5error5Error11with_values17hc74debb08d53c8ebE")
    *donation_relay_source_proposal.donation_relay_source_proposal.3e8f165cd5c7a961-cgu.0.rcgu.o(".text._ZN11anchor_lang5error5Error11with_values17h9e6c4422836fc1c9E")
    *donation_relay_source_proposal.donation_relay_source_proposal.3e8f165cd5c7a961-cgu.0.rcgu.o(".text._ZN11anchor_lang5error5Error17with_account_name17hd8aa2ea584b38cdcE")
    *donation_relay_source_proposal.donation_relay_source_proposal.3e8f165cd5c7a961-cgu.0.rcgu.o(".text._ZN11anchor_lang5error5Error17with_account_name17ha439dc449146f054E")
    *donation_relay_source_proposal.donation_relay_source_proposal.3e8f165cd5c7a961-cgu.0.rcgu.o(".text._ZN11anchor_lang8accounts12account_info93_$LT$impl$u20$anchor_lang..Accounts$LT$B$GT$$u20$for$u20$solana_account_info..AccountInfo$GT$12try_accounts17h0509767dd455319bE")
    *donation_relay_source_proposal.donation_relay_source_proposal.3e8f165cd5c7a961-cgu.0.rcgu.o(".text._ZN11anchor_lang8accounts17interface_account25InterfaceAccount$LT$T$GT$18try_from_unchecked17h82ef27015902d827E")
    *donation_relay_source_proposal.donation_relay_source_proposal.3e8f165cd5c7a961-cgu.0.rcgu.o(".text._ZN11anchor_lang8accounts17interface_account25InterfaceAccount$LT$T$GT$8try_from17h3f88a88585df56ceE")
    *donation_relay_source_proposal.donation_relay_source_proposal.3e8f165cd5c7a961-cgu.0.rcgu.o(".text._ZN11anchor_lang8accounts5boxed87_$LT$impl$u20$anchor_lang..Accounts$LT$B$GT$$u20$for$u20$alloc..boxed..Box$LT$T$GT$$GT$12try_accounts17hf7ba4496a34e0ae9E")
    *donation_relay_source_proposal.donation_relay_source_proposal.3e8f165cd5c7a961-cgu.0.rcgu.o(".text._ZN11anchor_lang8accounts5boxed87_$LT$impl$u20$anchor_lang..Accounts$LT$B$GT$$u20$for$u20$alloc..boxed..Box$LT$T$GT$$GT$12try_accounts17h4a09782e65bddc2cE")
    *donation_relay_source_proposal.donation_relay_source_proposal.3e8f165cd5c7a961-cgu.0.rcgu.o(".text._ZN11anchor_lang8accounts7account16Account$LT$T$GT$18try_from_unchecked17heddca5a4e4596607E")
    *donation_relay_source_proposal.donation_relay_source_proposal.3e8f165cd5c7a961-cgu.0.rcgu.o(".text._ZN11anchor_lang8accounts7account16Account$LT$T$GT$18try_from_unchecked17hb811cfb4be0b6fa3E")
    *donation_relay_source_proposal.donation_relay_source_proposal.3e8f165cd5c7a961-cgu.0.rcgu.o(".text._ZN11anchor_lang8accounts7account16Account$LT$T$GT$18try_from_unchecked17h28445837fbf499faE")
    *donation_relay_source_proposal.donation_relay_source_proposal.3e8f165cd5c7a961-cgu.0.rcgu.o(".text._ZN11anchor_lang8accounts7account16Account$LT$T$GT$18try_from_unchecked17he2e2ce3543a78150E")
    *donation_relay_source_proposal.donation_relay_source_proposal.3e8f165cd5c7a961-cgu.0.rcgu.o(".text._ZN11anchor_lang8accounts7account16Account$LT$T$GT$18try_from_unchecked17h46525ef62fcdcbe5E")
    *donation_relay_source_proposal.donation_relay_source_proposal.3e8f165cd5c7a961-cgu.0.rcgu.o(".text._ZN11anchor_lang8accounts7account16Account$LT$T$GT$18try_from_unchecked17h83dc0164f82d9609E")
    *donation_relay_source_proposal.donation_relay_source_proposal.3e8f165cd5c7a961-cgu.0.rcgu.o(".text._ZN11anchor_lang8accounts7account16Account$LT$T$GT$18try_from_unchecked17ha67070b5aedc9dffE")
    *donation_relay_source_proposal.donation_relay_source_proposal.3e8f165cd5c7a961-cgu.0.rcgu.o(".text._ZN11anchor_lang8accounts7account16Account$LT$T$GT$18try_from_unchecked17h8848a1a27b3e1015E")
    *donation_relay_source_proposal.donation_relay_source_proposal.3e8f165cd5c7a961-cgu.0.rcgu.o(".text._ZN11anchor_lang8accounts7account16Account$LT$T$GT$18try_from_unchecked17he05b5efbbbe38d6bE")
    *donation_relay_source_proposal.donation_relay_source_proposal.3e8f165cd5c7a961-cgu.0.rcgu.o(".text._ZN11anchor_lang8accounts7account16Account$LT$T$GT$6reload17h0eda7c6697a2df7aE")
    *donation_relay_source_proposal.donation_relay_source_proposal.3e8f165cd5c7a961-cgu.0.rcgu.o(".text._ZN11anchor_lang8accounts7account16Account$LT$T$GT$6reload17hbe86985e94fbc02bE")
    *donation_relay_source_proposal.donation_relay_source_proposal.3e8f165cd5c7a961-cgu.0.rcgu.o(".text._ZN11anchor_lang8accounts7account16Account$LT$T$GT$8try_from17h9b9a98f48e9013aeE")
    *donation_relay_source_proposal.donation_relay_source_proposal.3e8f165cd5c7a961-cgu.0.rcgu.o(".text._ZN11anchor_lang8accounts7account16Account$LT$T$GT$8try_from17h6d9ac9985db38c57E")
    *donation_relay_source_proposal.donation_relay_source_proposal.3e8f165cd5c7a961-cgu.0.rcgu.o(".text._ZN11anchor_lang8accounts7account16Account$LT$T$GT$8try_from17hb1fa5410a91bcf83E")
    *donation_relay_source_proposal.donation_relay_source_proposal.3e8f165cd5c7a961-cgu.0.rcgu.o(".text._ZN11anchor_lang8accounts7account16Account$LT$T$GT$8try_from17hf5d2fbfead638cf9E")
    *donation_relay_source_proposal.donation_relay_source_proposal.3e8f165cd5c7a961-cgu.0.rcgu.o(".text._ZN11anchor_lang8accounts7account16Account$LT$T$GT$8try_from17h98f95d5ba54b637fE")
    *donation_relay_source_proposal.donation_relay_source_proposal.3e8f165cd5c7a961-cgu.0.rcgu.o(".text._ZN11anchor_lang8accounts7account16Account$LT$T$GT$8try_from17h780ec5bb0ea91e23E")
    *donation_relay_source_proposal.donation_relay_source_proposal.3e8f165cd5c7a961-cgu.0.rcgu.o(".text._ZN11anchor_lang8accounts7account16Account$LT$T$GT$8try_from17h1f78c32d3d063d4dE")
    *donation_relay_source_proposal.donation_relay_source_proposal.3e8f165cd5c7a961-cgu.0.rcgu.o(".text._ZN11anchor_lang8accounts7account16Account$LT$T$GT$8try_from17h195603478a6ef1b3E")
    *donation_relay_source_proposal.donation_relay_source_proposal.3e8f165cd5c7a961-cgu.0.rcgu.o(".text._ZN139_$LT$anchor_lang..accounts..interface..Interface$LT$T$GT$$u20$as$u20$core..convert..TryFrom$LT$$RF$solana_account_info..AccountInfo$GT$$GT$8try_from17h273f04eeca55640bE")
    *donation_relay_source_proposal.donation_relay_source_proposal.3e8f165cd5c7a961-cgu.0.rcgu.o(".text._ZN14spl_token_20229extension13ExtensionType25try_calculate_account_len17h77e9ecd0315ed422E")
    *donation_relay_source_proposal.donation_relay_source_proposal.3e8f165cd5c7a961-cgu.0.rcgu.o(".text._ZN14spl_token_20229extension23BaseStateWithExtensions13get_extension17hedd0fe9aefc328e0E")
    *donation_relay_source_proposal.donation_relay_source_proposal.3e8f165cd5c7a961-cgu.0.rcgu.o(".text._ZN14spl_token_20229extension28StateWithExtensions$LT$S$GT$6unpack17h13d8dd10158296b9E")
    *donation_relay_source_proposal.donation_relay_source_proposal.3e8f165cd5c7a961-cgu.0.rcgu.o(".text._ZN42_$LT$$RF$T$u20$as$u20$core..fmt..Debug$GT$3fmt17h8b96eac7c9035c52E")
    *donation_relay_source_proposal.donation_relay_source_proposal.3e8f165cd5c7a961-cgu.0.rcgu.o(".text._ZN42_$LT$$RF$T$u20$as$u20$core..fmt..Debug$GT$3fmt17h2743237b3ddafeddE")
    *donation_relay_source_proposal.donation_relay_source_proposal.3e8f165cd5c7a961-cgu.0.rcgu.o(".text._ZN42_$LT$$RF$T$u20$as$u20$core..fmt..Debug$GT$3fmt17h74e912ccd078a89bE")
    *donation_relay_source_proposal.donation_relay_source_proposal.3e8f165cd5c7a961-cgu.0.rcgu.o(".text._ZN44_$LT$$RF$T$u20$as$u20$core..fmt..Display$GT$3fmt17h8124dc5ef0a019c2E")
    *donation_relay_source_proposal.donation_relay_source_proposal.3e8f165cd5c7a961-cgu.0.rcgu.o(".text._ZN49_$LT$T$u20$as$u20$alloc..string..SpecToString$GT$14spec_to_string17h426e9e2cf3f18f37E")
    *donation_relay_source_proposal.donation_relay_source_proposal.3e8f165cd5c7a961-cgu.0.rcgu.o(".text._ZN49_$LT$T$u20$as$u20$alloc..string..SpecToString$GT$14spec_to_string17h6ed720e1b0d0bd5cE")
    *donation_relay_source_proposal.donation_relay_source_proposal.3e8f165cd5c7a961-cgu.0.rcgu.o(".text._ZN4core3fmt3num49_$LT$impl$u20$core..fmt..Debug$u20$for$u20$u8$GT$3fmt17habfbb78acd9b5468E")
    *donation_relay_source_proposal.donation_relay_source_proposal.3e8f165cd5c7a961-cgu.0.rcgu.o(".text._ZN4core3fmt5Write9write_fmt17h014ecb1b6cfb4b11E")
    *donation_relay_source_proposal.donation_relay_source_proposal.3e8f165cd5c7a961-cgu.0.rcgu.o(".text._ZN4core3ptr118drop_in_place$LT$donation_relay_source_proposal..instructions..v1..relayer_only..distribute..just_swap..JustSwapV1$GT$17hf4eb159b56e8f273E")
    *donation_relay_source_proposal.donation_relay_source_proposal.3e8f165cd5c7a961-cgu.0.rcgu.o(".text._ZN4core3ptr139drop_in_place$LT$donation_relay_source_proposal..instructions..v1..relayer_only..distribute..swap_then_distribute..SwapThenDistributeV1$GT$17h24481f5b5db669b0E")
    *donation_relay_source_proposal.donation_relay_source_proposal.3e8f165cd5c7a961-cgu.0.rcgu.o(".text._ZN4core3ptr42drop_in_place$LT$alloc..string..String$GT$17h131ebaaf85f9dc6bE")
    *donation_relay_source_proposal.donation_relay_source_proposal.3e8f165cd5c7a961-cgu.0.rcgu.o(".text._ZN4core3ptr42drop_in_place$LT$std..io..error..Error$GT$17h59d5f71ab46ea851E")
    *donation_relay_source_proposal.donation_relay_source_proposal.3e8f165cd5c7a961-cgu.0.rcgu.o(".text._ZN4core3ptr53drop_in_place$LT$solana_account_info..AccountInfo$GT$17h6f5bc62c159c2deeE")
    *donation_relay_source_proposal.donation_relay_source_proposal.3e8f165cd5c7a961-cgu.0.rcgu.o(".text._ZN4core3ptr55drop_in_place$LT$solana_program_error..ProgramError$GT$17hd388a112457d1801E")
    *donation_relay_source_proposal.donation_relay_source_proposal.3e8f165cd5c7a961-cgu.0.rcgu.o(".text._ZN4core3ptr74drop_in_place$LT$$u5b$solana_account_info..AccountInfo$u3b$$u20$4$u5d$$GT$17h1d15672f519e7e9fE")
    *donation_relay_source_proposal.donation_relay_source_proposal.3e8f165cd5c7a961-cgu.0.rcgu.o(".text._ZN4core3ptr97drop_in_place$LT$donation_relay_source_proposal..tools..donate..shared..SignedDonationContext$GT$17he4a74fd281099687E")
    *donation_relay_source_proposal.donation_relay_source_proposal.3e8f165cd5c7a961-cgu.0.rcgu.o(".text._ZN4core3ptr90drop_in_place$LT$alloc..collections..btree..set..BTreeSet$LT$solana_pubkey..Pubkey$GT$$GT$17h7e185931571a2339E")
    *donation_relay_source_proposal.donation_relay_source_proposal.3e8f165cd5c7a961-cgu.0.rcgu.o(".text._ZN4core3ptr101drop_in_place$LT$donation_relay_source_proposal..tools..distribution..shared..DistributionContext$GT$17h408cfcd1d61ae336E")
    *donation_relay_source_proposal.donation_relay_source_proposal.3e8f165cd5c7a961-cgu.0.rcgu.o(".text._ZN4core3ptr98drop_in_place$LT$anchor_lang..context..CpiContext$LT$anchor_lang..system_program..Allocate$GT$$GT$17h04a4d8527e3565b7E")
    *donation_relay_source_proposal.donation_relay_source_proposal.3e8f165cd5c7a961-cgu.0.rcgu.o(".text._ZN4core5slice4sort6shared5pivot11median3_rec17hf2f0ec4bfc5498e5E")
    *donation_relay_source_proposal.donation_relay_source_proposal.3e8f165cd5c7a961-cgu.0.rcgu.o(".text._ZN4core5slice4sort6stable14driftsort_main17h05fc716acd7bb968E")
    *donation_relay_source_proposal.donation_relay_source_proposal.3e8f165cd5c7a961-cgu.0.rcgu.o(".text._ZN4core5slice4sort6stable5drift4sort17hea3635ed33a50f45E")
    *donation_relay_source_proposal.donation_relay_source_proposal.3e8f165cd5c7a961-cgu.0.rcgu.o(".text._ZN4core5slice4sort6stable9quicksort9quicksort17h8804441fb73df701E")
    *donation_relay_source_proposal.donation_relay_source_proposal.3e8f165cd5c7a961-cgu.0.rcgu.o(".text._ZN53_$LT$core..fmt..Error$u20$as$u20$core..fmt..Debug$GT$3fmt17haaa5bdc6ce3ebfafE")
    *donation_relay_source_proposal.donation_relay_source_proposal.3e8f165cd5c7a961-cgu.0.rcgu.o(".text._ZN58_$LT$alloc..string..String$u20$as$u20$core..fmt..Write$GT$10write_char17h6537f18e3aa683b6E")
    *donation_relay_source_proposal.donation_relay_source_proposal.3e8f165cd5c7a961-cgu.0.rcgu.o(".text._ZN58_$LT$alloc..string..String$u20$as$u20$core..fmt..Write$GT$9write_str17hca2d36081997e77fE")
    *donation_relay_source_proposal.donation_relay_source_proposal.3e8f165cd5c7a961-cgu.0.rcgu.o(".text.unlikely._ZN5alloc7raw_vec11finish_grow17ha367ab1530a14138E")
    *donation_relay_source_proposal.donation_relay_source_proposal.3e8f165cd5c7a961-cgu.0.rcgu.o(".text._ZN5alloc7raw_vec19RawVec$LT$T$C$A$GT$8grow_one17hce0757e0d9f3f973E")
    *donation_relay_source_proposal.donation_relay_source_proposal.3e8f165cd5c7a961-cgu.0.rcgu.o(".text._ZN5alloc7raw_vec19RawVec$LT$T$C$A$GT$8grow_one17h27cdf9a26cb42993E")
    *donation_relay_source_proposal.donation_relay_source_proposal.3e8f165cd5c7a961-cgu.0.rcgu.o(".text._ZN5alloc7raw_vec19RawVec$LT$T$C$A$GT$8grow_one17h8a8269c7f1d84353E")
    *donation_relay_source_proposal.donation_relay_source_proposal.3e8f165cd5c7a961-cgu.0.rcgu.o(".text._ZN5alloc7raw_vec19RawVec$LT$T$C$A$GT$8grow_one17h9fd95fbbf1326d61E")
    *donation_relay_source_proposal.donation_relay_source_proposal.3e8f165cd5c7a961-cgu.0.rcgu.o(".text._ZN5alloc7raw_vec19RawVec$LT$T$C$A$GT$8grow_one17h25acf3102ceed467E")
    *donation_relay_source_proposal.donation_relay_source_proposal.3e8f165cd5c7a961-cgu.0.rcgu.o(".text.unlikely._ZN5alloc7raw_vec20RawVecInner$LT$A$GT$7reserve21do_reserve_and_handle17hbaa216ba06f6e98dE")
    *donation_relay_source_proposal.donation_relay_source_proposal.3e8f165cd5c7a961-cgu.0.rcgu.o(".text._ZN63_$LT$solana_pubkey..PubkeyError$u20$as$u20$core..fmt..Debug$GT$3fmt17h742b9ec8696721d9E")
    *donation_relay_source_proposal.donation_relay_source_proposal.3e8f165cd5c7a961-cgu.0.rcgu.o(".text._ZN69_$LT$alloc..string..String$u20$as$u20$borsh..de..BorshDeserialize$GT$18deserialize_reader17h5bed7785f84672fcE")
    *donation_relay_source_proposal.donation_relay_source_proposal.3e8f165cd5c7a961-cgu.0.rcgu.o(".text._ZN70_$LT$core..num..error..TryFromIntError$u20$as$u20$core..fmt..Debug$GT$3fmt17hac919583bbb90a47E")
    *donation_relay_source_proposal.donation_relay_source_proposal.3e8f165cd5c7a961-cgu.0.rcgu.o(".text._ZN71_$LT$solana_account_info..AccountInfo$u20$as$u20$core..clone..Clone$GT$5clone17he65bc35c6bb49d98E")
    *donation_relay_source_proposal.donation_relay_source_proposal.3e8f165cd5c7a961-cgu.0.rcgu.o(".text._ZN71_$LT$solana_program_error..ProgramError$u20$as$u20$core..fmt..Debug$GT$3fmt17hecc5bf2b78c53038E")
    *donation_relay_source_proposal.donation_relay_source_proposal.3e8f165cd5c7a961-cgu.0.rcgu.o(".text._ZN72_$LT$alloc..vec..Vec$LT$T$GT$$u20$as$u20$borsh..de..BorshDeserialize$GT$18deserialize_reader17h751d6154487aa411E")
    *donation_relay_source_proposal.donation_relay_source_proposal.3e8f165cd5c7a961-cgu.0.rcgu.o(".text._ZN72_$LT$alloc..vec..Vec$LT$T$GT$$u20$as$u20$borsh..de..BorshDeserialize$GT$18deserialize_reader17hf48308e5d8e5105dE")
    *donation_relay_source_proposal.donation_relay_source_proposal.3e8f165cd5c7a961-cgu.0.rcgu.o(".text._ZN72_$LT$alloc..vec..Vec$LT$T$GT$$u20$as$u20$borsh..de..BorshDeserialize$GT$18deserialize_reader17he26aa5f9bea41319E")
    *donation_relay_source_proposal.donation_relay_source_proposal.3e8f165cd5c7a961-cgu.0.rcgu.o(".text._ZN72_$LT$alloc..vec..Vec$LT$T$GT$$u20$as$u20$borsh..de..BorshDeserialize$GT$18deserialize_reader17h4a20f9d01f612a6aE")
    *donation_relay_source_proposal.donation_relay_source_proposal.3e8f165cd5c7a961-cgu.0.rcgu.o(".text._ZN88_$LT$anchor_lang..accounts..signer..Signer$u20$as$u20$anchor_lang..Accounts$LT$B$GT$$GT$12try_accounts17h07e96cbd5649d570E")
    *donation_relay_source_proposal.donation_relay_source_proposal.3e8f165cd5c7a961-cgu.0.rcgu.o(".text._ZN88_$LT$anchor_lang..accounts..signer..Signer$u20$as$u20$anchor_lang..Accounts$LT$B$GT$$GT$12try_accounts17h0605056ebe5809e1E")
    *donation_relay_source_proposal.donation_relay_source_proposal.3e8f165cd5c7a961-cgu.0.rcgu.o(".text._ZN99_$LT$anchor_lang..accounts..account..Account$LT$T$GT$$u20$as$u20$anchor_lang..Accounts$LT$B$GT$$GT$12try_accounts17h719db84efc308ba8E")
    *donation_relay_source_proposal.donation_relay_source_proposal.3e8f165cd5c7a961-cgu.0.rcgu.o(".text._ZN99_$LT$anchor_lang..accounts..account..Account$LT$T$GT$$u20$as$u20$anchor_lang..Accounts$LT$B$GT$$GT$12try_accounts17h43f105a7885c7caaE")
    *donation_relay_source_proposal.donation_relay_source_proposal.3e8f165cd5c7a961-cgu.0.rcgu.o(".text._ZN99_$LT$anchor_lang..accounts..account..Account$LT$T$GT$$u20$as$u20$anchor_lang..Accounts$LT$B$GT$$GT$12try_accounts17h2977f3603d046000E")
    *donation_relay_source_proposal.donation_relay_source_proposal.3e8f165cd5c7a961-cgu.0.rcgu.o(".text._ZN99_$LT$anchor_lang..accounts..account..Account$LT$T$GT$$u20$as$u20$anchor_lang..Accounts$LT$B$GT$$GT$12try_accounts17h1ffcba3be17de007E")
    *donation_relay_source_proposal.donation_relay_source_proposal.3e8f165cd5c7a961-cgu.0.rcgu.o(".text._ZN99_$LT$anchor_lang..accounts..account..Account$LT$T$GT$$u20$as$u20$anchor_lang..Accounts$LT$B$GT$$GT$12try_accounts17h1929ef7f31705f02E")
    *donation_relay_source_proposal.donation_relay_source_proposal.3e8f165cd5c7a961-cgu.0.rcgu.o(".text._ZN99_$LT$anchor_lang..accounts..account..Account$LT$T$GT$$u20$as$u20$anchor_lang..Accounts$LT$B$GT$$GT$12try_accounts17h4df421c50c75dc4eE")
    *donation_relay_source_proposal.donation_relay_source_proposal.3e8f165cd5c7a961-cgu.0.rcgu.o(".text._ZN99_$LT$anchor_lang..accounts..account..Account$LT$T$GT$$u20$as$u20$anchor_lang..Accounts$LT$B$GT$$GT$12try_accounts17h2159bd6f0004bdd6E")
    *donation_relay_source_proposal.donation_relay_source_proposal.3e8f165cd5c7a961-cgu.0.rcgu.o(".text._ZN99_$LT$anchor_lang..accounts..account..Account$LT$T$GT$$u20$as$u20$anchor_lang..Accounts$LT$B$GT$$GT$12try_accounts17h6cd8ba91c8422223E")
    *donation_relay_source_proposal.donation_relay_source_proposal.3e8f165cd5c7a961-cgu.0.rcgu.o(".text._ZN99_$LT$anchor_lang..accounts..account..Account$LT$T$GT$$u20$as$u20$anchor_lang..Accounts$LT$B$GT$$GT$12try_accounts17h997024c9a5d2c276E")
    *donation_relay_source_proposal.donation_relay_source_proposal.3e8f165cd5c7a961-cgu.0.rcgu.o(".text._ZN99_$LT$anchor_lang..accounts..program..Program$LT$T$GT$$u20$as$u20$anchor_lang..Accounts$LT$B$GT$$GT$12try_accounts17h3087a0245b48dcadE")
    *donation_relay_source_proposal.donation_relay_source_proposal.3e8f165cd5c7a961-cgu.0.rcgu.o(".text._ZN99_$LT$anchor_lang..accounts..program..Program$LT$T$GT$$u20$as$u20$anchor_lang..Accounts$LT$B$GT$$GT$12try_accounts17h13d0d4b509f0e025E")
    *donation_relay_source_proposal.donation_relay_source_proposal.3e8f165cd5c7a961-cgu.0.rcgu.o(".text._ZN99_$LT$anchor_lang..accounts..program..Program$LT$T$GT$$u20$as$u20$anchor_lang..Accounts$LT$B$GT$$GT$12try_accounts17hdfa2652c736211e2E")
    *donation_relay_source_proposal.donation_relay_source_proposal.3e8f165cd5c7a961-cgu.0.rcgu.o(".text._ZN99_$LT$anchor_lang..accounts..program..Program$LT$T$GT$$u20$as$u20$anchor_lang..Accounts$LT$B$GT$$GT$12try_accounts17h78d3ea0e7f0d5720E")
    *donation_relay_source_proposal.donation_relay_source_proposal.3e8f165cd5c7a961-cgu.0.rcgu.o(".text._ZN30donation_relay_source_proposal3cpi7jupiter14invoke_jupiter17h97caa6979ee4bb9dE")
    *donation_relay_source_proposal.donation_relay_source_proposal.3e8f165cd5c7a961-cgu.0.rcgu.o(".text._ZN30donation_relay_source_proposal3cpi7jupiter13swap_observed17he8dc5484cdb75ef3E")
    *donation_relay_source_proposal.donation_relay_source_proposal.3e8f165cd5c7a961-cgu.0.rcgu.o(".text._ZN30donation_relay_source_proposal12instructions2v110public_api6donate6donate8DonateV117donate_v1_handler17he10f2dd27b4d2caeE")
    *donation_relay_source_proposal.donation_relay_source_proposal.3e8f165cd5c7a961-cgu.0.rcgu.o(".text._ZN30donation_relay_source_proposal12instructions2v110public_api6donate13donate_native14DonateNativeV124donate_native_v1_handler17h0aa118c885392ed1E")
    *donation_relay_source_proposal.donation_relay_source_proposal.3e8f165cd5c7a961-cgu.0.rcgu.o(".text._ZN30donation_relay_source_proposal12instructions2v110public_api6donate30donate_native_pubkey_config_id28DonateNativePubkeyConfigIdV141donate_native_pubkey_config_id_v1_handler17h8d539627cf0f04a9E")
    *donation_relay_source_proposal.donation_relay_source_proposal.3e8f165cd5c7a961-cgu.0.rcgu.o(".text._ZN30donation_relay_source_proposal12instructions2v110public_api6donate23donate_pubkey_config_id22DonatePubkeyConfigIdV134donate_pubkey_config_id_v1_handler17h490b18d4d911d503E")
    *donation_relay_source_proposal.donation_relay_source_proposal.3e8f165cd5c7a961-cgu.0.rcgu.o(".text._ZN30donation_relay_source_proposal12instructions2v110public_api6donate34donate_pubkey_config_id_with_payer31DonatePubkeyConfigIdWithPayerV145donate_pubkey_config_id_with_payer_v1_handler17h2b3063b0eec079bfE")
    *donation_relay_source_proposal.donation_relay_source_proposal.3e8f165cd5c7a961-cgu.0.rcgu.o(".text._ZN30donation_relay_source_proposal19settlement_handlers11close_epoch17hbcf6cf358b02d9eeE")
    *donation_relay_source_proposal.donation_relay_source_proposal.3e8f165cd5c7a961-cgu.0.rcgu.o(".text._ZN30donation_relay_source_proposal19settlement_handlers26distribute_after_prechecks17h4b50eb03c059c6f6E")
    *donation_relay_source_proposal.donation_relay_source_proposal.3e8f165cd5c7a961-cgu.0.rcgu.o(".text._ZN30donation_relay_source_proposal19settlement_handlers16distribute_after17h5eccf99392930fefE")
    *donation_relay_source_proposal.donation_relay_source_proposal.3e8f165cd5c7a961-cgu.0.rcgu.o(".text._ZN30donation_relay_source_proposal19settlement_handlers22distribute_exact_after17h70bde98c882e692dE")
    *donation_relay_source_proposal.donation_relay_source_proposal.3e8f165cd5c7a961-cgu.0.rcgu.o(".text._ZN30donation_relay_source_proposal19settlement_handlers23distribute_after_finish17h926a7ca541767b17E")
    *donation_relay_source_proposal.donation_relay_source_proposal.3e8f165cd5c7a961-cgu.0.rcgu.o(".text._ZN30donation_relay_source_proposal19settlement_handlers29distribute_non_swap_prechecks17h8377182ee7c0130dE")
    *donation_relay_source_proposal.donation_relay_source_proposal.3e8f165cd5c7a961-cgu.0.rcgu.o(".text._ZN30donation_relay_source_proposal19settlement_handlers19distribute_non_swap17hb3abad53215bf233E")
    *donation_relay_source_proposal.donation_relay_source_proposal.3e8f165cd5c7a961-cgu.0.rcgu.o(".text._ZN30donation_relay_source_proposal19settlement_handlers25distribute_exact_non_swap17h600fcc712ef77f6aE")
    *donation_relay_source_proposal.donation_relay_source_proposal.3e8f165cd5c7a961-cgu.0.rcgu.o(".text._ZN30donation_relay_source_proposal19settlement_handlers26distribute_non_swap_finish17hd3f2c5d5a30a36a9E")
    *donation_relay_source_proposal.donation_relay_source_proposal.3e8f165cd5c7a961-cgu.0.rcgu.o(".text._ZN30donation_relay_source_proposal19settlement_handlers9just_swap17h1b26b807fff45ebeE")
    *donation_relay_source_proposal.donation_relay_source_proposal.3e8f165cd5c7a961-cgu.0.rcgu.o(".text._ZN30donation_relay_source_proposal19settlement_handlers20swap_then_distribute17he09dbc02c5438bcbE")
    *donation_relay_source_proposal.donation_relay_source_proposal.3e8f165cd5c7a961-cgu.0.rcgu.o(".text._ZN30donation_relay_source_proposal12instructions2v112relayer_only21upsert_mint_whitelist16upsert_whitelist17hd10a2c8a64bdb30eE")
    *donation_relay_source_proposal.donation_relay_source_proposal.3e8f165cd5c7a961-cgu.0.rcgu.o(".text._ZN30donation_relay_source_proposal12instructions2v112relayer_only20admit_bridge_payment20admit_bridge_payment17h116b150361f323c9E")
    *donation_relay_source_proposal.donation_relay_source_proposal.3e8f165cd5c7a961-cgu.0.rcgu.o(".text._ZN30donation_relay_source_proposal12instructions2v122recover_bridge_payment22recover_bridge_payment17hec26a1795ed566e4E")
    *donation_relay_source_proposal.donation_relay_source_proposal.3e8f165cd5c7a961-cgu.0.rcgu.o(".text._ZN30donation_relay_source_proposal5tools6checks24native_program_supported17h95fc749980922015E")
    *donation_relay_source_proposal.donation_relay_source_proposal.3e8f165cd5c7a961-cgu.0.rcgu.o(".text._ZN30donation_relay_source_proposal5tools6checks23native_mint_for_program17hd64b47f0a7c06926E")
    *donation_relay_source_proposal.donation_relay_source_proposal.3e8f165cd5c7a961-cgu.0.rcgu.o(".text._ZN30donation_relay_source_proposal5tools6checks16native_mint_pair17h077887c5acb41956E")
    *donation_relay_source_proposal.donation_relay_source_proposal.3e8f165cd5c7a961-cgu.0.rcgu.o(".text._ZN30donation_relay_source_proposal5tools6checks13check_message17hd444ea4e2b5ea50bE")
    *donation_relay_source_proposal.donation_relay_source_proposal.3e8f165cd5c7a961-cgu.0.rcgu.o(".text._ZN30donation_relay_source_proposal5tools6checks13check_relayer17h06468f6f01103284E")
    *donation_relay_source_proposal.donation_relay_source_proposal.3e8f165cd5c7a961-cgu.0.rcgu.o(".text._ZN30donation_relay_source_proposal5tools6checks15typed_mint_safe17h1e1ef7d9c42c1daaE")
    *donation_relay_source_proposal.donation_relay_source_proposal.3e8f165cd5c7a961-cgu.0.rcgu.o(".text._ZN30donation_relay_source_proposal5tools6checks9check_bps17h2d18fe9d0dea3b26E")
    *donation_relay_source_proposal.donation_relay_source_proposal.3e8f165cd5c7a961-cgu.0.rcgu.o(".text._ZN30donation_relay_source_proposal5tools12distribution6shared10distribute17h276d679906c217d0E")
    *donation_relay_source_proposal.donation_relay_source_proposal.3e8f165cd5c7a961-cgu.0.rcgu.o(".text._ZN30donation_relay_source_proposal5tools12distribution6shared16distribute_exact17h923a846734baa629E")
    *donation_relay_source_proposal.donation_relay_source_proposal.3e8f165cd5c7a961-cgu.0.rcgu.o(".text._ZN30donation_relay_source_proposal5tools12distribution6shared15transfer_shares17h090e874fca9e747eE")
    *donation_relay_source_proposal.donation_relay_source_proposal.3e8f165cd5c7a961-cgu.0.rcgu.o(".text._ZN30donation_relay_source_proposal5tools12distribution6shared14transfer_exact17h897aba7e0d1b1180E")
    *donation_relay_source_proposal.donation_relay_source_proposal.3e8f165cd5c7a961-cgu.0.rcgu.o(".text._ZN30donation_relay_source_proposal5tools12distribution6shared14burn_and_close17hc84227a0d207fcc3E")
    *donation_relay_source_proposal.donation_relay_source_proposal.3e8f165cd5c7a961-cgu.0.rcgu.o(".text._ZN30donation_relay_source_proposal5tools6donate6shared25deserialize_token_account17h53182d2f9e61ac53E")
    *donation_relay_source_proposal.donation_relay_source_proposal.3e8f165cd5c7a961-cgu.0.rcgu.o(".text._ZN30donation_relay_source_proposal5tools6donate6shared16deserialize_mint17h9bcc0673d250e884E")
    *donation_relay_source_proposal.donation_relay_source_proposal.3e8f165cd5c7a961-cgu.0.rcgu.o(".text._ZN30donation_relay_source_proposal5tools6donate6shared13donate_shared17h48243fee4cc57244E")
    *donation_relay_source_proposal.donation_relay_source_proposal.3e8f165cd5c7a961-cgu.0.rcgu.o(".text._ZN30donation_relay_source_proposal5tools6donate6shared17donate_with_seeds17h0239be61aab4ba30E")
    *donation_relay_source_proposal.donation_relay_source_proposal.3e8f165cd5c7a961-cgu.0.rcgu.o(".text._ZN30donation_relay_source_proposal5tools17fair_distribution12fair_amounts17hf605990fd16a4333E")
    *donation_relay_source_proposal.donation_relay_source_proposal.3e8f165cd5c7a961-cgu.0.rcgu.o(".text._ZN30donation_relay_source_proposal20business_error_codes9ErrorCode4name17hd8b6c4310e6e2d8dE")
    *donation_relay_source_proposal.donation_relay_source_proposal.3e8f165cd5c7a961-cgu.0.rcgu.o(".text._ZN30donation_relay_source_proposal20business_error_codes146_$LT$impl$u20$core..convert..From$LT$donation_relay_source_proposal..business_error_codes..ErrorCode$GT$$u20$for$u20$anchor_lang..error..Error$GT$4from17h1fb1defec130b6f8E")
    *donation_relay_source_proposal.donation_relay_source_proposal.3e8f165cd5c7a961-cgu.0.rcgu.o(".text._ZN102_$LT$donation_relay_source_proposal..business_error_codes..ErrorCode$u20$as$u20$core..fmt..Display$GT$3fmt17hcfaefe4e2f7ee0d7E")
    *donation_relay_source_proposal.donation_relay_source_proposal.3e8f165cd5c7a961-cgu.0.rcgu.o(".text._ZN140_$LT$donation_relay_source_proposal..events..v1..donation_epoch_closed..DonationEpochClosedV1Event$u20$as$u20$borsh..ser..BorshSerialize$GT$9serialize17h1264aad65cfcc533E")
    *donation_relay_source_proposal.donation_relay_source_proposal.3e8f165cd5c7a961-cgu.0.rcgu.o(".text._ZN151_$LT$donation_relay_source_proposal..events..v1..donation_epoch_just_swapped..DonationEpochJustSwappedV1Event$u20$as$u20$borsh..ser..BorshSerialize$GT$9serialize17h0e9a534ae2d81d5cE")
    *donation_relay_source_proposal.donation_relay_source_proposal.3e8f165cd5c7a961-cgu.0.rcgu.o(".text._ZN146_$LT$donation_relay_source_proposal..events..v1..donation_epoch_processed..DonationEpochProcessedV1Event$u20$as$u20$borsh..ser..BorshSerialize$GT$9serialize17hac28b3c666003393E")
    *donation_relay_source_proposal.donation_relay_source_proposal.3e8f165cd5c7a961-cgu.0.rcgu.o(".text._ZN157_$LT$donation_relay_source_proposal..events..v1..donation_epoch_processed_exact..DonationEpochProcessedExactV1Event$u20$as$u20$borsh..ser..BorshSerialize$GT$9serialize17hbad5951e57878e51E")
    *donation_relay_source_proposal.donation_relay_source_proposal.3e8f165cd5c7a961-cgu.0.rcgu.o(".text._ZN125_$LT$donation_relay_source_proposal..events..v1..donation_made..DonationMadeV1Event$u20$as$u20$borsh..ser..BorshSerialize$GT$9serialize17h5482234a4528da01E")
    *donation_relay_source_proposal.donation_relay_source_proposal.3e8f165cd5c7a961-cgu.0.rcgu.o(".text._ZN146_$LT$donation_relay_source_proposal..events..v1..bridge_donation_admitted..BridgeDonationAdmittedV1Event$u20$as$u20$borsh..ser..BorshSerialize$GT$9serialize17h65a003149ab96890E")
    *donation_relay_source_proposal.donation_relay_source_proposal.3e8f165cd5c7a961-cgu.0.rcgu.o(".text._ZN146_$LT$donation_relay_source_proposal..events..v1..bridge_payment_recovered..BridgePaymentRecoveredV1Event$u20$as$u20$borsh..ser..BorshSerialize$GT$9serialize17hc3636543ecbbf55bE")
    *donation_relay_source_proposal.donation_relay_source_proposal.3e8f165cd5c7a961-cgu.0.rcgu.o(".text._ZN227_$LT$donation_relay_source_proposal..instructions..v1..public_api..donate..donate..DonateV1$u20$as$u20$anchor_lang..Accounts$LT$donation_relay_source_proposal..instructions..v1..public_api..donate..donate..DonateV1Bumps$GT$$GT$12try_accounts17h2bb32e650946dea4E")
    *donation_relay_source_proposal.donation_relay_source_proposal.3e8f165cd5c7a961-cgu.0.rcgu.o(".text._ZN227_$LT$donation_relay_source_proposal..instructions..v1..public_api..donate..donate..DonateV1$u20$as$u20$anchor_lang..Accounts$LT$donation_relay_source_proposal..instructions..v1..public_api..donate..donate..DonateV1Bumps$GT$$GT$12try_accounts28_$u7b$$u7b$closure$u7d$$u7d$17h70fadbb9a803a54dE")
    *donation_relay_source_proposal.donation_relay_source_proposal.3e8f165cd5c7a961-cgu.0.rcgu.o(".text._ZN227_$LT$donation_relay_source_proposal..instructions..v1..public_api..donate..donate..DonateV1$u20$as$u20$anchor_lang..Accounts$LT$donation_relay_source_proposal..instructions..v1..public_api..donate..donate..DonateV1Bumps$GT$$GT$12try_accounts28_$u7b$$u7b$closure$u7d$$u7d$17h795d0343e6d8c792E")
    *donation_relay_source_proposal.donation_relay_source_proposal.3e8f165cd5c7a961-cgu.0.rcgu.o(".text._ZN227_$LT$donation_relay_source_proposal..instructions..v1..public_api..donate..donate..DonateV1$u20$as$u20$anchor_lang..Accounts$LT$donation_relay_source_proposal..instructions..v1..public_api..donate..donate..DonateV1Bumps$GT$$GT$12try_accounts28_$u7b$$u7b$closure$u7d$$u7d$17h96b9b7646d6f91d6E")
    *donation_relay_source_proposal.donation_relay_source_proposal.3e8f165cd5c7a961-cgu.0.rcgu.o(".text._ZN132_$LT$donation_relay_source_proposal..instructions..v1..public_api..donate..donate..DonateV1$u20$as$u20$anchor_lang..AccountsExit$GT$4exit17h03be311e49a3d904E")
    *donation_relay_source_proposal.donation_relay_source_proposal.3e8f165cd5c7a961-cgu.0.rcgu.o(".text._ZN253_$LT$donation_relay_source_proposal..instructions..v1..public_api..donate..donate_native..DonateNativeV1$u20$as$u20$anchor_lang..Accounts$LT$donation_relay_source_proposal..instructions..v1..public_api..donate..donate_native..DonateNativeV1Bumps$GT$$GT$12try_accounts17he04037a80b111415E")
    *donation_relay_source_proposal.donation_relay_source_proposal.3e8f165cd5c7a961-cgu.0.rcgu.o(".text._ZN253_$LT$donation_relay_source_proposal..instructions..v1..public_api..donate..donate_native..DonateNativeV1$u20$as$u20$anchor_lang..Accounts$LT$donation_relay_source_proposal..instructions..v1..public_api..donate..donate_native..DonateNativeV1Bumps$GT$$GT$12try_accounts28_$u7b$$u7b$closure$u7d$$u7d$17h2dc587b332d7fd38E")
    *donation_relay_source_proposal.donation_relay_source_proposal.3e8f165cd5c7a961-cgu.0.rcgu.o(".text._ZN253_$LT$donation_relay_source_proposal..instructions..v1..public_api..donate..donate_native..DonateNativeV1$u20$as$u20$anchor_lang..Accounts$LT$donation_relay_source_proposal..instructions..v1..public_api..donate..donate_native..DonateNativeV1Bumps$GT$$GT$12try_accounts28_$u7b$$u7b$closure$u7d$$u7d$17hfc909752e5988649E")
    *donation_relay_source_proposal.donation_relay_source_proposal.3e8f165cd5c7a961-cgu.0.rcgu.o(".text._ZN253_$LT$donation_relay_source_proposal..instructions..v1..public_api..donate..donate_native..DonateNativeV1$u20$as$u20$anchor_lang..Accounts$LT$donation_relay_source_proposal..instructions..v1..public_api..donate..donate_native..DonateNativeV1Bumps$GT$$GT$12try_accounts28_$u7b$$u7b$closure$u7d$$u7d$17h9cfb5d23a24c343fE")
    *donation_relay_source_proposal.donation_relay_source_proposal.3e8f165cd5c7a961-cgu.0.rcgu.o(".text._ZN145_$LT$donation_relay_source_proposal..instructions..v1..public_api..donate..donate_native..DonateNativeV1$u20$as$u20$anchor_lang..AccountsExit$GT$4exit17hc936ad77a699acc6E")
    *donation_relay_source_proposal.donation_relay_source_proposal.3e8f165cd5c7a961-cgu.0.rcgu.o(".text._ZN315_$LT$donation_relay_source_proposal..instructions..v1..public_api..donate..donate_native_pubkey_config_id..DonateNativePubkeyConfigIdV1$u20$as$u20$anchor_lang..Accounts$LT$donation_relay_source_proposal..instructions..v1..public_api..donate..donate_native_pubkey_config_id..DonateNativePubkeyConfigIdV1Bumps$GT$$GT$12try_accounts17h17e26982e30fdb96E")
    *donation_relay_source_proposal.donation_relay_source_proposal.3e8f165cd5c7a961-cgu.0.rcgu.o(".text._ZN315_$LT$donation_relay_source_proposal..instructions..v1..public_api..donate..donate_native_pubkey_config_id..DonateNativePubkeyConfigIdV1$u20$as$u20$anchor_lang..Accounts$LT$donation_relay_source_proposal..instructions..v1..public_api..donate..donate_native_pubkey_config_id..DonateNativePubkeyConfigIdV1Bumps$GT$$GT$12try_accounts28_$u7b$$u7b$closure$u7d$$u7d$17hc3135e3e1eb18f52E")
    *donation_relay_source_proposal.donation_relay_source_proposal.3e8f165cd5c7a961-cgu.0.rcgu.o(".text._ZN315_$LT$donation_relay_source_proposal..instructions..v1..public_api..donate..donate_native_pubkey_config_id..DonateNativePubkeyConfigIdV1$u20$as$u20$anchor_lang..Accounts$LT$donation_relay_source_proposal..instructions..v1..public_api..donate..donate_native_pubkey_config_id..DonateNativePubkeyConfigIdV1Bumps$GT$$GT$12try_accounts28_$u7b$$u7b$closure$u7d$$u7d$17h821e184a6618266cE")
    *donation_relay_source_proposal.donation_relay_source_proposal.3e8f165cd5c7a961-cgu.0.rcgu.o(".text._ZN315_$LT$donation_relay_source_proposal..instructions..v1..public_api..donate..donate_native_pubkey_config_id..DonateNativePubkeyConfigIdV1$u20$as$u20$anchor_lang..Accounts$LT$donation_relay_source_proposal..instructions..v1..public_api..donate..donate_native_pubkey_config_id..DonateNativePubkeyConfigIdV1Bumps$GT$$GT$12try_accounts28_$u7b$$u7b$closure$u7d$$u7d$17h757dcd9b59d1905bE")
    *donation_relay_source_proposal.donation_relay_source_proposal.3e8f165cd5c7a961-cgu.0.rcgu.o(".text._ZN289_$LT$donation_relay_source_proposal..instructions..v1..public_api..donate..donate_pubkey_config_id..DonatePubkeyConfigIdV1$u20$as$u20$anchor_lang..Accounts$LT$donation_relay_source_proposal..instructions..v1..public_api..donate..donate_pubkey_config_id..DonatePubkeyConfigIdV1Bumps$GT$$GT$12try_accounts17hf881b1507cc7f0c2E")
    *donation_relay_source_proposal.donation_relay_source_proposal.3e8f165cd5c7a961-cgu.0.rcgu.o(".text._ZN289_$LT$donation_relay_source_proposal..instructions..v1..public_api..donate..donate_pubkey_config_id..DonatePubkeyConfigIdV1$u20$as$u20$anchor_lang..Accounts$LT$donation_relay_source_proposal..instructions..v1..public_api..donate..donate_pubkey_config_id..DonatePubkeyConfigIdV1Bumps$GT$$GT$12try_accounts28_$u7b$$u7b$closure$u7d$$u7d$17he1dd17eda8da0233E")
    *donation_relay_source_proposal.donation_relay_source_proposal.3e8f165cd5c7a961-cgu.0.rcgu.o(".text._ZN289_$LT$donation_relay_source_proposal..instructions..v1..public_api..donate..donate_pubkey_config_id..DonatePubkeyConfigIdV1$u20$as$u20$anchor_lang..Accounts$LT$donation_relay_source_proposal..instructions..v1..public_api..donate..donate_pubkey_config_id..DonatePubkeyConfigIdV1Bumps$GT$$GT$12try_accounts28_$u7b$$u7b$closure$u7d$$u7d$17h31443cbe035f5202E")
    *donation_relay_source_proposal.donation_relay_source_proposal.3e8f165cd5c7a961-cgu.0.rcgu.o(".text._ZN329_$LT$donation_relay_source_proposal..instructions..v1..public_api..donate..donate_pubkey_config_id_with_payer..DonatePubkeyConfigIdWithPayerV1$u20$as$u20$anchor_lang..Accounts$LT$donation_relay_source_proposal..instructions..v1..public_api..donate..donate_pubkey_config_id_with_payer..DonatePubkeyConfigIdWithPayerV1Bumps$GT$$GT$12try_accounts17hc58d514642fa7777E")
    *donation_relay_source_proposal.donation_relay_source_proposal.3e8f165cd5c7a961-cgu.0.rcgu.o(".text._ZN329_$LT$donation_relay_source_proposal..instructions..v1..public_api..donate..donate_pubkey_config_id_with_payer..DonatePubkeyConfigIdWithPayerV1$u20$as$u20$anchor_lang..Accounts$LT$donation_relay_source_proposal..instructions..v1..public_api..donate..donate_pubkey_config_id_with_payer..DonatePubkeyConfigIdWithPayerV1Bumps$GT$$GT$12try_accounts28_$u7b$$u7b$closure$u7d$$u7d$17haf202e5ca0ffef84E")
    *donation_relay_source_proposal.donation_relay_source_proposal.3e8f165cd5c7a961-cgu.0.rcgu.o(".text._ZN329_$LT$donation_relay_source_proposal..instructions..v1..public_api..donate..donate_pubkey_config_id_with_payer..DonatePubkeyConfigIdWithPayerV1$u20$as$u20$anchor_lang..Accounts$LT$donation_relay_source_proposal..instructions..v1..public_api..donate..donate_pubkey_config_id_with_payer..DonatePubkeyConfigIdWithPayerV1Bumps$GT$$GT$12try_accounts28_$u7b$$u7b$closure$u7d$$u7d$17h271db36025eeaa1aE")
    *donation_relay_source_proposal.donation_relay_source_proposal.3e8f165cd5c7a961-cgu.0.rcgu.o(".text._ZN183_$LT$donation_relay_source_proposal..instructions..v1..public_api..donate..donate_pubkey_config_id_with_payer..DonatePubkeyConfigIdWithPayerV1$u20$as$u20$anchor_lang..AccountsExit$GT$4exit17h8b745f9011337984E")
    *donation_relay_source_proposal.donation_relay_source_proposal.3e8f165cd5c7a961-cgu.0.rcgu.o(".text._ZN267_$LT$donation_relay_source_proposal..instructions..v1..relayer_only..close_donation_epoch..CloseDonationEpochV1$u20$as$u20$anchor_lang..Accounts$LT$donation_relay_source_proposal..instructions..v1..relayer_only..close_donation_epoch..CloseDonationEpochV1Bumps$GT$$GT$12try_accounts17hc31e1bc4b8bc3d5cE")
    *donation_relay_source_proposal.donation_relay_source_proposal.3e8f165cd5c7a961-cgu.0.rcgu.o(".text._ZN267_$LT$donation_relay_source_proposal..instructions..v1..relayer_only..close_donation_epoch..CloseDonationEpochV1$u20$as$u20$anchor_lang..Accounts$LT$donation_relay_source_proposal..instructions..v1..relayer_only..close_donation_epoch..CloseDonationEpochV1Bumps$GT$$GT$12try_accounts28_$u7b$$u7b$closure$u7d$$u7d$17hb38936bdaf1a8cd0E")
    *donation_relay_source_proposal.donation_relay_source_proposal.3e8f165cd5c7a961-cgu.0.rcgu.o(".text._ZN267_$LT$donation_relay_source_proposal..instructions..v1..relayer_only..close_donation_epoch..CloseDonationEpochV1$u20$as$u20$anchor_lang..Accounts$LT$donation_relay_source_proposal..instructions..v1..relayer_only..close_donation_epoch..CloseDonationEpochV1Bumps$GT$$GT$12try_accounts28_$u7b$$u7b$closure$u7d$$u7d$17hf4c17b26a5af9fdfE")
    *donation_relay_source_proposal.donation_relay_source_proposal.3e8f165cd5c7a961-cgu.0.rcgu.o(".text._ZN152_$LT$donation_relay_source_proposal..instructions..v1..relayer_only..close_donation_epoch..CloseDonationEpochV1$u20$as$u20$anchor_lang..AccountsExit$GT$4exit17h15855cf58586f98fE")
    *donation_relay_source_proposal.donation_relay_source_proposal.3e8f165cd5c7a961-cgu.0.rcgu.o(".text._ZN329_$LT$donation_relay_source_proposal..instructions..v1..relayer_only..distribute..distribute_after_just_swapping..DistributeAfterJustSwappingV1$u20$as$u20$anchor_lang..Accounts$LT$donation_relay_source_proposal..instructions..v1..relayer_only..distribute..distribute_after_just_swapping..DistributeAfterJustSwappingV1Bumps$GT$$GT$12try_accounts17ha2b005fe12bab9b6E")
    *donation_relay_source_proposal.donation_relay_source_proposal.3e8f165cd5c7a961-cgu.0.rcgu.o(".text._ZN183_$LT$donation_relay_source_proposal..instructions..v1..relayer_only..distribute..distribute_after_just_swapping..DistributeAfterJustSwappingV1$u20$as$u20$anchor_lang..AccountsExit$GT$4exit17hac4f8c05716ff446E")
    *donation_relay_source_proposal.donation_relay_source_proposal.3e8f165cd5c7a961-cgu.0.rcgu.o(".text._ZN331_$LT$donation_relay_source_proposal..instructions..v1..relayer_only..distribute..distribute_non_swap_output_mint..DistributeNonSwapOutputMintV1$u20$as$u20$anchor_lang..Accounts$LT$donation_relay_source_proposal..instructions..v1..relayer_only..distribute..distribute_non_swap_output_mint..DistributeNonSwapOutputMintV1Bumps$GT$$GT$12try_accounts17hf2e43008cee1d3ccE")
    *donation_relay_source_proposal.donation_relay_source_proposal.3e8f165cd5c7a961-cgu.0.rcgu.o(".text._ZN184_$LT$donation_relay_source_proposal..instructions..v1..relayer_only..distribute..distribute_non_swap_output_mint..DistributeNonSwapOutputMintV1$u20$as$u20$anchor_lang..AccountsExit$GT$4exit17h5ba038cc02c97b82E")
    *donation_relay_source_proposal.donation_relay_source_proposal.3e8f165cd5c7a961-cgu.0.rcgu.o(".text._ZN249_$LT$donation_relay_source_proposal..instructions..v1..relayer_only..distribute..just_swap..JustSwapV1$u20$as$u20$anchor_lang..Accounts$LT$donation_relay_source_proposal..instructions..v1..relayer_only..distribute..just_swap..JustSwapV1Bumps$GT$$GT$12try_accounts17h8616ed6169540606E")
    *donation_relay_source_proposal.donation_relay_source_proposal.3e8f165cd5c7a961-cgu.0.rcgu.o(".text._ZN249_$LT$donation_relay_source_proposal..instructions..v1..relayer_only..distribute..just_swap..JustSwapV1$u20$as$u20$anchor_lang..Accounts$LT$donation_relay_source_proposal..instructions..v1..relayer_only..distribute..just_swap..JustSwapV1Bumps$GT$$GT$12try_accounts28_$u7b$$u7b$closure$u7d$$u7d$17hd649aa1462649e05E")
    *donation_relay_source_proposal.donation_relay_source_proposal.3e8f165cd5c7a961-cgu.0.rcgu.o(".text._ZN249_$LT$donation_relay_source_proposal..instructions..v1..relayer_only..distribute..just_swap..JustSwapV1$u20$as$u20$anchor_lang..Accounts$LT$donation_relay_source_proposal..instructions..v1..relayer_only..distribute..just_swap..JustSwapV1Bumps$GT$$GT$12try_accounts28_$u7b$$u7b$closure$u7d$$u7d$17hd08e45defc0d15c6E")
    *donation_relay_source_proposal.donation_relay_source_proposal.3e8f165cd5c7a961-cgu.0.rcgu.o(".text._ZN143_$LT$donation_relay_source_proposal..instructions..v1..relayer_only..distribute..just_swap..JustSwapV1$u20$as$u20$anchor_lang..AccountsExit$GT$4exit17he6aafce217510361E")
    *donation_relay_source_proposal.donation_relay_source_proposal.3e8f165cd5c7a961-cgu.0.rcgu.o(".text._ZN291_$LT$donation_relay_source_proposal..instructions..v1..relayer_only..distribute..swap_then_distribute..SwapThenDistributeV1$u20$as$u20$anchor_lang..Accounts$LT$donation_relay_source_proposal..instructions..v1..relayer_only..distribute..swap_then_distribute..SwapThenDistributeV1Bumps$GT$$GT$12try_accounts17h3686bf29392a1a6fE")
    *donation_relay_source_proposal.donation_relay_source_proposal.3e8f165cd5c7a961-cgu.0.rcgu.o(".text._ZN164_$LT$donation_relay_source_proposal..instructions..v1..relayer_only..distribute..swap_then_distribute..SwapThenDistributeV1$u20$as$u20$anchor_lang..AccountsExit$GT$4exit17h6f898183d80b444eE")
    *donation_relay_source_proposal.donation_relay_source_proposal.3e8f165cd5c7a961-cgu.0.rcgu.o(".text._ZN271_$LT$donation_relay_source_proposal..instructions..v1..relayer_only..upsert_mint_whitelist..UpsertMintWhitelistV1$u20$as$u20$anchor_lang..Accounts$LT$donation_relay_source_proposal..instructions..v1..relayer_only..upsert_mint_whitelist..UpsertMintWhitelistV1Bumps$GT$$GT$12try_accounts17habf19cd8c1d43f8eE")
    *donation_relay_source_proposal.donation_relay_source_proposal.3e8f165cd5c7a961-cgu.0.rcgu.o(".text._ZN271_$LT$donation_relay_source_proposal..instructions..v1..relayer_only..upsert_mint_whitelist..UpsertMintWhitelistV1$u20$as$u20$anchor_lang..Accounts$LT$donation_relay_source_proposal..instructions..v1..relayer_only..upsert_mint_whitelist..UpsertMintWhitelistV1Bumps$GT$$GT$12try_accounts28_$u7b$$u7b$closure$u7d$$u7d$17h8a921ae23fe0537eE")
    *donation_relay_source_proposal.donation_relay_source_proposal.3e8f165cd5c7a961-cgu.0.rcgu.o(".text._ZN154_$LT$donation_relay_source_proposal..instructions..v1..relayer_only..upsert_mint_whitelist..UpsertMintWhitelistV1$u20$as$u20$anchor_lang..AccountsExit$GT$4exit17hefca62f16d310bf0E")
    *donation_relay_source_proposal.donation_relay_source_proposal.3e8f165cd5c7a961-cgu.0.rcgu.o(".text._ZN267_$LT$donation_relay_source_proposal..instructions..v1..relayer_only..admit_bridge_payment..AdmitBridgePaymentV1$u20$as$u20$anchor_lang..Accounts$LT$donation_relay_source_proposal..instructions..v1..relayer_only..admit_bridge_payment..AdmitBridgePaymentV1Bumps$GT$$GT$12try_accounts17hc01d22ae987f78daE")
    *donation_relay_source_proposal.donation_relay_source_proposal.3e8f165cd5c7a961-cgu.0.rcgu.o(".text._ZN267_$LT$donation_relay_source_proposal..instructions..v1..relayer_only..admit_bridge_payment..AdmitBridgePaymentV1$u20$as$u20$anchor_lang..Accounts$LT$donation_relay_source_proposal..instructions..v1..relayer_only..admit_bridge_payment..AdmitBridgePaymentV1Bumps$GT$$GT$12try_accounts28_$u7b$$u7b$closure$u7d$$u7d$17h1608642bbeddf800E")
    *donation_relay_source_proposal.donation_relay_source_proposal.3e8f165cd5c7a961-cgu.0.rcgu.o(".text._ZN267_$LT$donation_relay_source_proposal..instructions..v1..relayer_only..admit_bridge_payment..AdmitBridgePaymentV1$u20$as$u20$anchor_lang..Accounts$LT$donation_relay_source_proposal..instructions..v1..relayer_only..admit_bridge_payment..AdmitBridgePaymentV1Bumps$GT$$GT$12try_accounts28_$u7b$$u7b$closure$u7d$$u7d$17hec83629a76684dfcE")
    *donation_relay_source_proposal.donation_relay_source_proposal.3e8f165cd5c7a961-cgu.0.rcgu.o(".text._ZN267_$LT$donation_relay_source_proposal..instructions..v1..relayer_only..admit_bridge_payment..AdmitBridgePaymentV1$u20$as$u20$anchor_lang..Accounts$LT$donation_relay_source_proposal..instructions..v1..relayer_only..admit_bridge_payment..AdmitBridgePaymentV1Bumps$GT$$GT$12try_accounts28_$u7b$$u7b$closure$u7d$$u7d$17h37155cd6c3c26634E")
    *donation_relay_source_proposal.donation_relay_source_proposal.3e8f165cd5c7a961-cgu.0.rcgu.o(".text._ZN267_$LT$donation_relay_source_proposal..instructions..v1..relayer_only..admit_bridge_payment..AdmitBridgePaymentV1$u20$as$u20$anchor_lang..Accounts$LT$donation_relay_source_proposal..instructions..v1..relayer_only..admit_bridge_payment..AdmitBridgePaymentV1Bumps$GT$$GT$12try_accounts28_$u7b$$u7b$closure$u7d$$u7d$17h85bbcca21fbfce7aE")
    *donation_relay_source_proposal.donation_relay_source_proposal.3e8f165cd5c7a961-cgu.0.rcgu.o(".text._ZN267_$LT$donation_relay_source_proposal..instructions..v1..relayer_only..admit_bridge_payment..AdmitBridgePaymentV1$u20$as$u20$anchor_lang..Accounts$LT$donation_relay_source_proposal..instructions..v1..relayer_only..admit_bridge_payment..AdmitBridgePaymentV1Bumps$GT$$GT$12try_accounts28_$u7b$$u7b$closure$u7d$$u7d$17h5b830c31e8da4e79E")
    *donation_relay_source_proposal.donation_relay_source_proposal.3e8f165cd5c7a961-cgu.0.rcgu.o(".text._ZN152_$LT$donation_relay_source_proposal..instructions..v1..relayer_only..admit_bridge_payment..AdmitBridgePaymentV1$u20$as$u20$anchor_lang..AccountsExit$GT$4exit17h2f18ea8799299076E")
    *donation_relay_source_proposal.donation_relay_source_proposal.3e8f165cd5c7a961-cgu.0.rcgu.o(".text._ZN247_$LT$donation_relay_source_proposal..instructions..v1..recover_bridge_payment..RecoverBridgePaymentV1$u20$as$u20$anchor_lang..Accounts$LT$donation_relay_source_proposal..instructions..v1..recover_bridge_payment..RecoverBridgePaymentV1Bumps$GT$$GT$12try_accounts17h1ad5603a11594e70E")
    *donation_relay_source_proposal.donation_relay_source_proposal.3e8f165cd5c7a961-cgu.0.rcgu.o(".text._ZN247_$LT$donation_relay_source_proposal..instructions..v1..recover_bridge_payment..RecoverBridgePaymentV1$u20$as$u20$anchor_lang..Accounts$LT$donation_relay_source_proposal..instructions..v1..recover_bridge_payment..RecoverBridgePaymentV1Bumps$GT$$GT$12try_accounts28_$u7b$$u7b$closure$u7d$$u7d$17ha16bc4d32833eb9bE")
    *donation_relay_source_proposal.donation_relay_source_proposal.3e8f165cd5c7a961-cgu.0.rcgu.o(".text._ZN247_$LT$donation_relay_source_proposal..instructions..v1..recover_bridge_payment..RecoverBridgePaymentV1$u20$as$u20$anchor_lang..Accounts$LT$donation_relay_source_proposal..instructions..v1..recover_bridge_payment..RecoverBridgePaymentV1Bumps$GT$$GT$12try_accounts28_$u7b$$u7b$closure$u7d$$u7d$17hcb2d53c6b8636e65E")
    *donation_relay_source_proposal.donation_relay_source_proposal.3e8f165cd5c7a961-cgu.0.rcgu.o(".text._ZN142_$LT$donation_relay_source_proposal..instructions..v1..recover_bridge_payment..RecoverBridgePaymentV1$u20$as$u20$anchor_lang..AccountsExit$GT$4exit17h64d7171ff03e61fdE")
    *donation_relay_source_proposal.donation_relay_source_proposal.3e8f165cd5c7a961-cgu.0.rcgu.o(".text._ZN115_$LT$donation_relay_source_proposal..state..v1..debouncer..DebouncerV1$u20$as$u20$anchor_lang..AccountSerialize$GT$13try_serialize17h0bfb31bd1daa561dE")
    *donation_relay_source_proposal.donation_relay_source_proposal.3e8f165cd5c7a961-cgu.0.rcgu.o(".text._ZN117_$LT$donation_relay_source_proposal..state..v1..debouncer..DebouncerV1$u20$as$u20$anchor_lang..AccountDeserialize$GT$15try_deserialize17hd2a7b8dd4a42fa77E")
    *donation_relay_source_proposal.donation_relay_source_proposal.3e8f165cd5c7a961-cgu.0.rcgu.o(".text._ZN117_$LT$donation_relay_source_proposal..state..v1..debouncer..DebouncerV1$u20$as$u20$anchor_lang..AccountDeserialize$GT$25try_deserialize_unchecked17ha34c44c3088861e4E")
    *donation_relay_source_proposal.donation_relay_source_proposal.3e8f165cd5c7a961-cgu.0.rcgu.o(".text._ZN121_$LT$donation_relay_source_proposal..state..v1..distribution..DistributionV1$u20$as$u20$anchor_lang..AccountSerialize$GT$13try_serialize17h01b007cca4d8ef38E")
    *donation_relay_source_proposal.donation_relay_source_proposal.3e8f165cd5c7a961-cgu.0.rcgu.o(".text._ZN123_$LT$donation_relay_source_proposal..state..v1..distribution..DistributionV1$u20$as$u20$anchor_lang..AccountDeserialize$GT$15try_deserialize17hc85892cbe3f5c69eE")
    *donation_relay_source_proposal.donation_relay_source_proposal.3e8f165cd5c7a961-cgu.0.rcgu.o(".text._ZN123_$LT$donation_relay_source_proposal..state..v1..distribution..DistributionV1$u20$as$u20$anchor_lang..AccountDeserialize$GT$25try_deserialize_unchecked17ha1be56e3598293a3E")
    *donation_relay_source_proposal.donation_relay_source_proposal.3e8f165cd5c7a961-cgu.0.rcgu.o(".text._ZN122_$LT$donation_relay_source_proposal..state..v1..epoch_tracker..EpochTrackerV1$u20$as$u20$anchor_lang..AccountSerialize$GT$13try_serialize17hff4224b51883e505E")
    *donation_relay_source_proposal.donation_relay_source_proposal.3e8f165cd5c7a961-cgu.0.rcgu.o(".text._ZN124_$LT$donation_relay_source_proposal..state..v1..epoch_tracker..EpochTrackerV1$u20$as$u20$anchor_lang..AccountDeserialize$GT$15try_deserialize17h3815c2b8df430e3aE")
    *donation_relay_source_proposal.donation_relay_source_proposal.3e8f165cd5c7a961-cgu.0.rcgu.o(".text._ZN124_$LT$donation_relay_source_proposal..state..v1..epoch_tracker..EpochTrackerV1$u20$as$u20$anchor_lang..AccountDeserialize$GT$25try_deserialize_unchecked17hcd7fff11c5f71486E")
    *donation_relay_source_proposal.donation_relay_source_proposal.3e8f165cd5c7a961-cgu.0.rcgu.o(".text._ZN124_$LT$donation_relay_source_proposal..state..v1..mint_whitelist..MintWhitelistV1$u20$as$u20$anchor_lang..AccountSerialize$GT$13try_serialize17he75d28652129a7aaE")
    *donation_relay_source_proposal.donation_relay_source_proposal.3e8f165cd5c7a961-cgu.0.rcgu.o(".text._ZN126_$LT$donation_relay_source_proposal..state..v1..mint_whitelist..MintWhitelistV1$u20$as$u20$anchor_lang..AccountDeserialize$GT$15try_deserialize17h2c9052f82b3c5160E")
    *donation_relay_source_proposal.donation_relay_source_proposal.3e8f165cd5c7a961-cgu.0.rcgu.o(".text._ZN126_$LT$donation_relay_source_proposal..state..v1..mint_whitelist..MintWhitelistV1$u20$as$u20$anchor_lang..AccountDeserialize$GT$25try_deserialize_unchecked17h23d49fd753289c94E")
    *donation_relay_source_proposal.donation_relay_source_proposal.3e8f165cd5c7a961-cgu.0.rcgu.o(".text._ZN120_$LT$donation_relay_source_proposal..state..v1..swap_receipt..SwapReceiptV1$u20$as$u20$anchor_lang..AccountSerialize$GT$13try_serialize17h3fe116935507ed71E")
    *donation_relay_source_proposal.donation_relay_source_proposal.3e8f165cd5c7a961-cgu.0.rcgu.o(".text._ZN122_$LT$donation_relay_source_proposal..state..v1..swap_receipt..SwapReceiptV1$u20$as$u20$anchor_lang..AccountDeserialize$GT$15try_deserialize17hddb08ca0d5c0a5a6E")
    *donation_relay_source_proposal.donation_relay_source_proposal.3e8f165cd5c7a961-cgu.0.rcgu.o(".text._ZN122_$LT$donation_relay_source_proposal..state..v1..swap_receipt..SwapReceiptV1$u20$as$u20$anchor_lang..AccountDeserialize$GT$25try_deserialize_unchecked17h74027d43f5a9a40bE")
    *donation_relay_source_proposal.donation_relay_source_proposal.3e8f165cd5c7a961-cgu.0.rcgu.o(".text._ZN126_$LT$donation_relay_source_proposal..state..v1..bridge_membership..BridgeSourceV1$u20$as$u20$anchor_lang..AccountSerialize$GT$13try_serialize17h539ea4c37fb8afbeE")
    *donation_relay_source_proposal.donation_relay_source_proposal.3e8f165cd5c7a961-cgu.0.rcgu.o(".text._ZN127_$LT$donation_relay_source_proposal..state..v1..bridge_membership..BridgePaymentV1$u20$as$u20$anchor_lang..AccountSerialize$GT$13try_serialize17h94b916834febbeb5E")
    *donation_relay_source_proposal.donation_relay_source_proposal.3e8f165cd5c7a961-cgu.0.rcgu.o(".text._ZN30donation_relay_source_proposal16anchor_framework5entry17ha02c528181cd206dE")
    *donation_relay_source_proposal.donation_relay_source_proposal.3e8f165cd5c7a961-cgu.0.rcgu.o(".text._ZN30donation_relay_source_proposal16anchor_framework9__private5__idl14__idl_dispatch17h44bde425fb6c82deE")
    *donation_relay_source_proposal.donation_relay_source_proposal.3e8f165cd5c7a961-cgu.0.rcgu.o(".text._ZN30donation_relay_source_proposal16anchor_framework9__private5__idl20__idl_create_account17h06b29702a970d050E")
    *donation_relay_source_proposal.donation_relay_source_proposal.3e8f165cd5c7a961-cgu.0.rcgu.o(".text._ZN30donation_relay_source_proposal16anchor_framework9__private5__idl20__idl_resize_account17h6718866fd51ba349E")
    *donation_relay_source_proposal.donation_relay_source_proposal.3e8f165cd5c7a961-cgu.0.rcgu.o(".text._ZN30donation_relay_source_proposal16anchor_framework9__private5__idl19__idl_close_account17h1562a10d65e5044eE")
    *donation_relay_source_proposal.donation_relay_source_proposal.3e8f165cd5c7a961-cgu.0.rcgu.o(".text._ZN30donation_relay_source_proposal16anchor_framework9__private5__idl19__idl_create_buffer17h767e3ac566dbd199E")
    *donation_relay_source_proposal.donation_relay_source_proposal.3e8f165cd5c7a961-cgu.0.rcgu.o(".text._ZN30donation_relay_source_proposal16anchor_framework9__private5__idl11__idl_write17hf2a546499870f000E")
    *donation_relay_source_proposal.donation_relay_source_proposal.3e8f165cd5c7a961-cgu.0.rcgu.o(".text._ZN30donation_relay_source_proposal16anchor_framework9__private5__idl19__idl_set_authority17h94d357f0cf0c66f8E")
    *donation_relay_source_proposal.donation_relay_source_proposal.3e8f165cd5c7a961-cgu.0.rcgu.o(".text._ZN30donation_relay_source_proposal16anchor_framework9__private5__idl16__idl_set_buffer17hca92d6a593449467E")
    *donation_relay_source_proposal.donation_relay_source_proposal.3e8f165cd5c7a961-cgu.0.rcgu.o(".text._ZN30donation_relay_source_proposal16anchor_framework9__private8__global9donate_v117hbf700170d51ee9d2E")
    *donation_relay_source_proposal.donation_relay_source_proposal.3e8f165cd5c7a961-cgu.0.rcgu.o(".text._ZN30donation_relay_source_proposal16anchor_framework9__private8__global26donate_pubkey_config_id_v117h94500a6ed5fdbc74E")
    *donation_relay_source_proposal.donation_relay_source_proposal.3e8f165cd5c7a961-cgu.0.rcgu.o(".text._ZN30donation_relay_source_proposal16anchor_framework9__private8__global16donate_native_v117h49ad55d9dc32f696E")
    *donation_relay_source_proposal.donation_relay_source_proposal.3e8f165cd5c7a961-cgu.0.rcgu.o(".text._ZN30donation_relay_source_proposal16anchor_framework9__private8__global33donate_native_pubkey_config_id_v117he4c94bcfea355f83E")
    *donation_relay_source_proposal.donation_relay_source_proposal.3e8f165cd5c7a961-cgu.0.rcgu.o(".text._ZN30donation_relay_source_proposal16anchor_framework9__private8__global37donate_pubkey_config_id_with_payer_v117hf8b88406502e7889E")
    *donation_relay_source_proposal.donation_relay_source_proposal.3e8f165cd5c7a961-cgu.0.rcgu.o(".text._ZN30donation_relay_source_proposal16anchor_framework9__private8__global23admit_bridge_payment_v117h8dab7e9540cd1f34E")
    *donation_relay_source_proposal.donation_relay_source_proposal.3e8f165cd5c7a961-cgu.0.rcgu.o(".text._ZN30donation_relay_source_proposal16anchor_framework9__private8__global25recover_bridge_payment_v117h5e08f2b2a64a9ec8E")
    *donation_relay_source_proposal.donation_relay_source_proposal.3e8f165cd5c7a961-cgu.0.rcgu.o(".text._ZN30donation_relay_source_proposal16anchor_framework9__private8__global23close_donation_epoch_v117hae816a6cf0de4d7fE")
    *donation_relay_source_proposal.donation_relay_source_proposal.3e8f165cd5c7a961-cgu.0.rcgu.o(".text._ZN30donation_relay_source_proposal16anchor_framework9__private8__global23swap_then_distribute_v117h6d2ec10fe8bbbc47E")
    *donation_relay_source_proposal.donation_relay_source_proposal.3e8f165cd5c7a961-cgu.0.rcgu.o(".text._ZN30donation_relay_source_proposal16anchor_framework9__private8__global12just_swap_v117h5563ed6d1440947eE")
    *donation_relay_source_proposal.donation_relay_source_proposal.3e8f165cd5c7a961-cgu.0.rcgu.o(".text._ZN30donation_relay_source_proposal16anchor_framework9__private8__global33distribute_after_just_swapping_v117h3e6ca5a74fa1ed3cE")
    *donation_relay_source_proposal.donation_relay_source_proposal.3e8f165cd5c7a961-cgu.0.rcgu.o(".text._ZN30donation_relay_source_proposal16anchor_framework9__private8__global34distribute_non_swap_output_mint_v117hb397c330cf23a296E")
    *donation_relay_source_proposal.donation_relay_source_proposal.3e8f165cd5c7a961-cgu.0.rcgu.o(".text._ZN30donation_relay_source_proposal16anchor_framework9__private8__global40distribute_exact_non_swap_output_mint_v117hec0dc632a1963fc2E")
    *donation_relay_source_proposal.donation_relay_source_proposal.3e8f165cd5c7a961-cgu.0.rcgu.o(".text._ZN30donation_relay_source_proposal16anchor_framework9__private8__global39distribute_exact_after_just_swapping_v117h480b79ac9d4cb2e7E")
    *donation_relay_source_proposal.donation_relay_source_proposal.3e8f165cd5c7a961-cgu.0.rcgu.o(".text._ZN30donation_relay_source_proposal16anchor_framework9__private8__global24upsert_mint_whitelist_v117h05174ed6705e496cE")
    *donation_relay_source_proposal.donation_relay_source_proposal.3e8f165cd5c7a961-cgu.0.rcgu.o(".text._ZN30donation_relay_source_proposal16anchor_framework9__private8__events16__event_dispatch17h1ec1a69fa2308b44E")
    *donation_relay_source_proposal.donation_relay_source_proposal.3e8f165cd5c7a961-cgu.0.rcgu.o(".text._ZN30donation_relay_source_proposal16anchor_framework37relay_anchor_idl_reconstruction_probe9donate_v117h93f0f59ffd297856E")
    *donation_relay_source_proposal.donation_relay_source_proposal.3e8f165cd5c7a961-cgu.0.rcgu.o(".text._ZN30donation_relay_source_proposal16anchor_framework37relay_anchor_idl_reconstruction_probe26donate_pubkey_config_id_v117hd4f6248be385e5acE")
    *donation_relay_source_proposal.donation_relay_source_proposal.3e8f165cd5c7a961-cgu.0.rcgu.o(".text._ZN30donation_relay_source_proposal16anchor_framework37relay_anchor_idl_reconstruction_probe16donate_native_v117habaf895ac7724f8bE")
    *donation_relay_source_proposal.donation_relay_source_proposal.3e8f165cd5c7a961-cgu.0.rcgu.o(".text._ZN30donation_relay_source_proposal16anchor_framework37relay_anchor_idl_reconstruction_probe33donate_native_pubkey_config_id_v117h76dc423bf78bc0a7E")
    *donation_relay_source_proposal.donation_relay_source_proposal.3e8f165cd5c7a961-cgu.0.rcgu.o(".text._ZN30donation_relay_source_proposal16anchor_framework37relay_anchor_idl_reconstruction_probe37donate_pubkey_config_id_with_payer_v117hae149e17b3ec7227E")
    *donation_relay_source_proposal.donation_relay_source_proposal.3e8f165cd5c7a961-cgu.0.rcgu.o(".text._ZN30donation_relay_source_proposal16anchor_framework37relay_anchor_idl_reconstruction_probe25recover_bridge_payment_v117h44d1a24ed9602e8fE")
    *donation_relay_source_proposal.donation_relay_source_proposal.3e8f165cd5c7a961-cgu.0.rcgu.o(".text.entrypoint")
    *donation_relay_source_proposal.donation_relay_source_proposal.3e8f165cd5c7a961-cgu.0.rcgu.o(".text._RNvCscR3e5J6VSLN_7___rustc12___rust_alloc")
    *donation_relay_source_proposal.donation_relay_source_proposal.3e8f165cd5c7a961-cgu.0.rcgu.o(".text._RNvCscR3e5J6VSLN_7___rustc14___rust_dealloc")
    *donation_relay_source_proposal.donation_relay_source_proposal.3e8f165cd5c7a961-cgu.0.rcgu.o(".text._RNvCscR3e5J6VSLN_7___rustc14___rust_realloc")
    *donation_relay_source_proposal.donation_relay_source_proposal.3e8f165cd5c7a961-cgu.0.rcgu.o(".text._RNvCscR3e5J6VSLN_7___rustc19___rust_alloc_zeroed")
    *donation_relay_source_proposal.donation_relay_source_proposal.3e8f165cd5c7a961-cgu.0.rcgu.o(".text.custom_panic")
    *donation_relay_source_proposal.donation_relay_source_proposal.3e8f165cd5c7a961-cgu.0.rcgu.o(".text._ZN30donation_relay_source_proposal16anchor_framework37relay_anchor_idl_reconstruction_probe39distribute_exact_after_just_swapping_v117ha3511511a408ce3fE")
    *donation_relay_source_proposal.donation_relay_source_proposal.3e8f165cd5c7a961-cgu.0.rcgu.o(".text._ZN30donation_relay_source_proposal16anchor_framework37relay_anchor_idl_reconstruction_probe40distribute_exact_non_swap_output_mint_v117hfe1d5f873dbba38eE")
    *donation_relay_source_proposal.donation_relay_source_proposal.3e8f165cd5c7a961-cgu.0.rcgu.o(".text._ZN30donation_relay_source_proposal16anchor_framework37relay_anchor_idl_reconstruction_probe34distribute_non_swap_output_mint_v117hc7d18dd4415cc7c3E")
    *donation_relay_source_proposal.donation_relay_source_proposal.3e8f165cd5c7a961-cgu.0.rcgu.o(".text._ZN30donation_relay_source_proposal16anchor_framework37relay_anchor_idl_reconstruction_probe33distribute_after_just_swapping_v117hf1c4982466b77dffE")
    *donation_relay_source_proposal.donation_relay_source_proposal.3e8f165cd5c7a961-cgu.0.rcgu.o(".text._ZN30donation_relay_source_proposal16anchor_framework37relay_anchor_idl_reconstruction_probe12just_swap_v117h4a7d591456fd1a58E")
    *donation_relay_source_proposal.donation_relay_source_proposal.3e8f165cd5c7a961-cgu.0.rcgu.o(".text._ZN30donation_relay_source_proposal16anchor_framework37relay_anchor_idl_reconstruction_probe23swap_then_distribute_v117hd406df4474fc2da8E")
    *donation_relay_source_proposal.donation_relay_source_proposal.3e8f165cd5c7a961-cgu.0.rcgu.o(".text._ZN30donation_relay_source_proposal16anchor_framework37relay_anchor_idl_reconstruction_probe23close_donation_epoch_v117h6124abdda7937ebaE")
    *donation_relay_source_proposal.donation_relay_source_proposal.3e8f165cd5c7a961-cgu.0.rcgu.o(".text._ZN30donation_relay_source_proposal16anchor_framework37relay_anchor_idl_reconstruction_probe23admit_bridge_payment_v117h62996fe8c94e9495E")
    *donation_relay_source_proposal.donation_relay_source_proposal.3e8f165cd5c7a961-cgu.0.rcgu.o(".text._ZN221_$LT$donation_relay_source_proposal..anchor_framework..__private..__idl..IdlCloseAccount$u20$as$u20$anchor_lang..Accounts$LT$donation_relay_source_proposal..anchor_framework..__private..__idl..IdlCloseAccountBumps$GT$$GT$12try_accounts17hff91313b436d4a34E")
    *donation_relay_source_proposal.donation_relay_source_proposal.3e8f165cd5c7a961-cgu.0.rcgu.o(".text._ZN129_$LT$donation_relay_source_proposal..anchor_framework..__private..__idl..IdlCloseAccount$u20$as$u20$anchor_lang..AccountsExit$GT$4exit17h65cd6ce432356d55E")
    *donation_relay_source_proposal.donation_relay_source_proposal.3e8f165cd5c7a961-cgu.0.rcgu.o(".text._ZN215_$LT$donation_relay_source_proposal..anchor_framework..__private..__idl..IdlSetBuffer$u20$as$u20$anchor_lang..Accounts$LT$donation_relay_source_proposal..anchor_framework..__private..__idl..IdlSetBufferBumps$GT$$GT$12try_accounts17h3dda94b3f598cd0bE")
    *donation_relay_source_proposal.donation_relay_source_proposal.3e8f165cd5c7a961-cgu.0.rcgu.o(".text._ZN126_$LT$donation_relay_source_proposal..anchor_framework..__private..__idl..IdlSetBuffer$u20$as$u20$anchor_lang..AccountsExit$GT$4exit17h1f95f758db922561E")
    *donation_relay_source_proposal.donation_relay_source_proposal.3e8f165cd5c7a961-cgu.0.rcgu.o(".text._ZN221_$LT$donation_relay_source_proposal..anchor_framework..__private..__idl..IdlCreateBuffer$u20$as$u20$anchor_lang..Accounts$LT$donation_relay_source_proposal..anchor_framework..__private..__idl..IdlCreateBufferBumps$GT$$GT$12try_accounts17hc826d09b62562df8E")
    *donation_relay_source_proposal.donation_relay_source_proposal.3e8f165cd5c7a961-cgu.0.rcgu.o(".text._ZN129_$LT$donation_relay_source_proposal..anchor_framework..__private..__idl..IdlCreateBuffer$u20$as$u20$anchor_lang..AccountsExit$GT$4exit17haf5997119346b09dE")
    *donation_relay_source_proposal.donation_relay_source_proposal.3e8f165cd5c7a961-cgu.0.rcgu.o(".text._ZN223_$LT$donation_relay_source_proposal..anchor_framework..__private..__idl..IdlResizeAccount$u20$as$u20$anchor_lang..Accounts$LT$donation_relay_source_proposal..anchor_framework..__private..__idl..IdlResizeAccountBumps$GT$$GT$12try_accounts17hea1ccd8426431b9dE")
    *donation_relay_source_proposal.donation_relay_source_proposal.3e8f165cd5c7a961-cgu.0.rcgu.o(".text._ZN130_$LT$donation_relay_source_proposal..anchor_framework..__private..__idl..IdlResizeAccount$u20$as$u20$anchor_lang..AccountsExit$GT$4exit17h27e18e41f2a83ad6E")
    *donation_relay_source_proposal.donation_relay_source_proposal.3e8f165cd5c7a961-cgu.0.rcgu.o(".text._ZN213_$LT$donation_relay_source_proposal..anchor_framework..__private..__idl..IdlAccounts$u20$as$u20$anchor_lang..Accounts$LT$donation_relay_source_proposal..anchor_framework..__private..__idl..IdlAccountsBumps$GT$$GT$12try_accounts17h9a604992b641583dE")
    *donation_relay_source_proposal.donation_relay_source_proposal.3e8f165cd5c7a961-cgu.0.rcgu.o(".text._ZN125_$LT$donation_relay_source_proposal..anchor_framework..__private..__idl..IdlAccounts$u20$as$u20$anchor_lang..AccountsExit$GT$4exit17h80399b1f5e19b87cE")
    *donation_relay_source_proposal.donation_relay_source_proposal.3e8f165cd5c7a961-cgu.0.rcgu.o(".text._ZN225_$LT$donation_relay_source_proposal..anchor_framework..__private..__idl..IdlCreateAccounts$u20$as$u20$anchor_lang..Accounts$LT$donation_relay_source_proposal..anchor_framework..__private..__idl..IdlCreateAccountsBumps$GT$$GT$12try_accounts17hfcb3c12d24235849E")
    *donation_relay_source_proposal.donation_relay_source_proposal.3e8f165cd5c7a961-cgu.0.rcgu.o(".text._ZN128_$LT$donation_relay_source_proposal..anchor_framework..__private..__idl..IdlAccount$u20$as$u20$anchor_lang..AccountSerialize$GT$13try_serialize17hadae624b2600bcf7E")
    *donation_relay_source_proposal.donation_relay_source_proposal.3e8f165cd5c7a961-cgu.0.rcgu.o(".text._ZN128_$LT$donation_relay_source_proposal..anchor_framework..__private..__idl..IdlAccount$u20$as$u20$anchor_lang..AccountSerialize$GT$13try_serialize17hdf1bb92678753698E")
    *donation_relay_source_proposal.donation_relay_source_proposal.3e8f165cd5c7a961-cgu.0.rcgu.o(".text._ZN130_$LT$donation_relay_source_proposal..anchor_framework..__private..__idl..IdlAccount$u20$as$u20$anchor_lang..AccountDeserialize$GT$15try_deserialize17h2c761e951d305e1aE")
    *donation_relay_source_proposal.donation_relay_source_proposal.3e8f165cd5c7a961-cgu.0.rcgu.o(".text._ZN130_$LT$donation_relay_source_proposal..anchor_framework..__private..__idl..IdlAccount$u20$as$u20$anchor_lang..AccountDeserialize$GT$25try_deserialize_unchecked17h0cd63d978ff2cfedE")
    *donation_relay_source_proposal.edovq8q3mqrzjnbk6mcy40g16.rcgu.o(".text._RNvCscR3e5J6VSLN_7___rustc26___rust_alloc_error_handler")
    *donation_relay_source_proposal.edovq8q3mqrzjnbk6mcy40g16.rcgu.o(".text._RNvCscR3e5J6VSLN_7___rustc35___rust_no_alloc_shim_is_unstable_v2")
    *libanchor_spl-af99f249a539a4e2.rlib:anchor_spl-af99f249a539a4e2.anchor_spl.e700bdef23f07cf5-cgu.0.rcgu.o(".text._ZN4core3ptr74drop_in_place$LT$$u5b$solana_account_info..AccountInfo$u3b$$u20$3$u5d$$GT$17h7ab1f1c5a2577efeE")
    *libanchor_spl-af99f249a539a4e2.rlib:anchor_spl-af99f249a539a4e2.anchor_spl.e700bdef23f07cf5-cgu.0.rcgu.o(".text._ZN4core3ptr74drop_in_place$LT$$u5b$solana_account_info..AccountInfo$u3b$$u20$4$u5d$$GT$17he968cd179561003aE")
    *libanchor_spl-af99f249a539a4e2.rlib:anchor_spl-af99f249a539a4e2.anchor_spl.e700bdef23f07cf5-cgu.0.rcgu.o(".text._ZN4core3ptr74drop_in_place$LT$$u5b$solana_account_info..AccountInfo$u3b$$u20$6$u5d$$GT$17h667956e9cbc8ddceE")
    *libanchor_spl-af99f249a539a4e2.rlib:anchor_spl-af99f249a539a4e2.anchor_spl.e700bdef23f07cf5-cgu.0.rcgu.o(".text._ZN10anchor_spl16associated_token6create17h7c0c40f660f133b2E")
    *libanchor_spl-af99f249a539a4e2.rlib:anchor_spl-af99f249a539a4e2.anchor_spl.e700bdef23f07cf5-cgu.0.rcgu.o(".text._ZN10anchor_spl5token16transfer_checked17h7045be8fa01af3fcE")
    *libanchor_spl-af99f249a539a4e2.rlib:anchor_spl-af99f249a539a4e2.anchor_spl.e700bdef23f07cf5-cgu.0.rcgu.o(".text._ZN83_$LT$anchor_spl..token..TokenAccount$u20$as$u20$anchor_lang..AccountDeserialize$GT$25try_deserialize_unchecked17hf11f8d73e47d2bccE")
    *libanchor_spl-af99f249a539a4e2.rlib:anchor_spl-af99f249a539a4e2.anchor_spl.e700bdef23f07cf5-cgu.0.rcgu.o(".text._ZN75_$LT$anchor_spl..token..Mint$u20$as$u20$anchor_lang..AccountDeserialize$GT$25try_deserialize_unchecked17h5c1e4ea27f91e760E")
    *libanchor_spl-af99f249a539a4e2.rlib:anchor_spl-af99f249a539a4e2.anchor_spl.e700bdef23f07cf5-cgu.0.rcgu.o(".text._ZN10anchor_spl10token_202216transfer_checked17h1aff13b4e45a484dE")
    *libanchor_spl-af99f249a539a4e2.rlib:anchor_spl-af99f249a539a4e2.anchor_spl.e700bdef23f07cf5-cgu.0.rcgu.o(".text._ZN10anchor_spl10token_20224burn17h8ceaa0f5060b3ab8E")
    *libanchor_spl-af99f249a539a4e2.rlib:anchor_spl-af99f249a539a4e2.anchor_spl.e700bdef23f07cf5-cgu.0.rcgu.o(".text._ZN10anchor_spl10token_202219initialize_account317h41aca9036d530e54E")
    *libanchor_spl-af99f249a539a4e2.rlib:anchor_spl-af99f249a539a4e2.anchor_spl.e700bdef23f07cf5-cgu.0.rcgu.o(".text._ZN10anchor_spl10token_202213close_account17h5991b3f06c4be69bE")
    *libanchor_spl-af99f249a539a4e2.rlib:anchor_spl-af99f249a539a4e2.anchor_spl.e700bdef23f07cf5-cgu.0.rcgu.o(".text._ZN10anchor_spl10token_202211sync_native17h663685227798e67eE")
    *libanchor_spl-af99f249a539a4e2.rlib:anchor_spl-af99f249a539a4e2.anchor_spl.e700bdef23f07cf5-cgu.0.rcgu.o(".text._ZN93_$LT$anchor_spl..token_interface..TokenAccount$u20$as$u20$anchor_lang..AccountDeserialize$GT$25try_deserialize_unchecked17h14fa951415bb5a81E")
    *libanchor_spl-af99f249a539a4e2.rlib:anchor_spl-af99f249a539a4e2.anchor_spl.e700bdef23f07cf5-cgu.0.rcgu.o(".text._ZN85_$LT$anchor_spl..token_interface..Mint$u20$as$u20$anchor_lang..AccountDeserialize$GT$25try_deserialize_unchecked17h7db691a79d07dbe7E")
    *libspl_token_2022-67295bfc29c93a98.rlib:spl_token_2022-67295bfc29c93a98.spl_token_2022.ece5f01bacbdc219-cgu.0.rcgu.o(".text.unlikely._ZN5alloc7raw_vec11finish_grow17hfbd16c2c270ed4beE")
    *libspl_token_2022-67295bfc29c93a98.rlib:spl_token_2022-67295bfc29c93a98.spl_token_2022.ece5f01bacbdc219-cgu.0.rcgu.o(".text._ZN5alloc7raw_vec19RawVec$LT$T$C$A$GT$8grow_one17h39d3f05c55438f52E")
    *libspl_token_2022-67295bfc29c93a98.rlib:spl_token_2022-67295bfc29c93a98.spl_token_2022.ece5f01bacbdc219-cgu.0.rcgu.o(".text._ZN5alloc7raw_vec19RawVec$LT$T$C$A$GT$8grow_one17hc682f6ca2df65914E")
    *libspl_token_2022-67295bfc29c93a98.rlib:spl_token_2022-67295bfc29c93a98.spl_token_2022.ece5f01bacbdc219-cgu.0.rcgu.o(".text.unlikely._ZN5alloc7raw_vec20RawVecInner$LT$A$GT$7reserve21do_reserve_and_handle17h43c5d09954c97539E")
    *libspl_token_2022-67295bfc29c93a98.rlib:spl_token_2022-67295bfc29c93a98.spl_token_2022.ece5f01bacbdc219-cgu.0.rcgu.o(".text._ZN14spl_token_20229extension15get_tlv_indices17h109d63263c4788b2E")
    *libspl_token_2022-67295bfc29c93a98.rlib:spl_token_2022-67295bfc29c93a98.spl_token_2022.ece5f01bacbdc219-cgu.0.rcgu.o(".text._ZN14spl_token_20229extension23adjust_len_for_multisig17h6d546d18d2ebad69E")
    *libspl_token_2022-67295bfc29c93a98.rlib:spl_token_2022-67295bfc29c93a98.spl_token_2022.ece5f01bacbdc219-cgu.0.rcgu.o(".text._ZN14spl_token_20229extension17get_tlv_data_info17hfbe43d216975a638E")
    *libspl_token_2022-67295bfc29c93a98.rlib:spl_token_2022-67295bfc29c93a98.spl_token_2022.ece5f01bacbdc219-cgu.0.rcgu.o(".text._ZN107_$LT$spl_token_2022..extension..ExtensionType$u20$as$u20$core..convert..TryFrom$LT$$RF$$u5b$u8$u5d$$GT$$GT$8try_from17hfdf4bf9e576e2452E")
    *libspl_token_2022-67295bfc29c93a98.rlib:spl_token_2022-67295bfc29c93a98.spl_token_2022.ece5f01bacbdc219-cgu.0.rcgu.o(".text._ZN14spl_token_20229extension13ExtensionType21try_get_total_tlv_len17h6dcd97ad4819cba1E")
    *libspl_token_2022-67295bfc29c93a98.rlib:spl_token_2022-67295bfc29c93a98.spl_token_2022.ece5f01bacbdc219-cgu.0.rcgu.o(".text._ZN14spl_token_20229extension13ExtensionType36get_required_init_account_extensions17h636ca2cd8a002521E")
    *libspl_token_2022-67295bfc29c93a98.rlib:spl_token_2022-67295bfc29c93a98.spl_token_2022.ece5f01bacbdc219-cgu.0.rcgu.o(".text._ZN14spl_token_202211instruction16TokenInstruction4pack17h205dbfcb4a2b5851E")
    *libspl_token_2022-67295bfc29c93a98.rlib:spl_token_2022-67295bfc29c93a98.spl_token_2022.ece5f01bacbdc219-cgu.0.rcgu.o(".text._ZN14spl_token_202211instruction19initialize_account317h352b76453754945aE")
    *libspl_token_2022-67295bfc29c93a98.rlib:spl_token_2022-67295bfc29c93a98.spl_token_2022.ece5f01bacbdc219-cgu.0.rcgu.o(".text._ZN14spl_token_202211instruction4burn17hb0e1adb633b5a810E")
    *libspl_token_2022-67295bfc29c93a98.rlib:spl_token_2022-67295bfc29c93a98.spl_token_2022.ece5f01bacbdc219-cgu.0.rcgu.o(".text._ZN14spl_token_202211instruction13close_account17hf177bc11d09ae551E")
    *libspl_token_2022-67295bfc29c93a98.rlib:spl_token_2022-67295bfc29c93a98.spl_token_2022.ece5f01bacbdc219-cgu.0.rcgu.o(".text._ZN14spl_token_202211instruction16transfer_checked17h90cc21dfa2711d47E")
    *libspl_token_2022-67295bfc29c93a98.rlib:spl_token_2022-67295bfc29c93a98.spl_token_2022.ece5f01bacbdc219-cgu.0.rcgu.o(".text._ZN14spl_token_202211instruction11sync_native17h5d959f41674fb820E")
    *libspl_token_2022-67295bfc29c93a98.rlib:spl_token_2022-67295bfc29c93a98.spl_token_2022.ece5f01bacbdc219-cgu.0.rcgu.o(".text._ZN73_$LT$spl_token_2022..state..Mint$u20$as$u20$solana_program_pack..Pack$GT$17unpack_from_slice17h9c9333cb28a58ff7E")
    *libspl_token_2022-67295bfc29c93a98.rlib:spl_token_2022-67295bfc29c93a98.spl_token_2022.ece5f01bacbdc219-cgu.0.rcgu.o(".text._ZN76_$LT$spl_token_2022..state..Account$u20$as$u20$solana_program_pack..Pack$GT$17unpack_from_slice17he8ff0b70f067ab3cE")
    *libspl_token-6f1aee9f4d11611e.rlib:spl_token-6f1aee9f4d11611e.spl_token.ee235efdef73172d-cgu.0.rcgu.o(".text.unlikely._ZN5alloc7raw_vec11finish_grow17h5cca25a0680b6704E")
    *libspl_token-6f1aee9f4d11611e.rlib:spl_token-6f1aee9f4d11611e.spl_token.ee235efdef73172d-cgu.0.rcgu.o(".text.unlikely._ZN5alloc7raw_vec20RawVecInner$LT$A$GT$7reserve21do_reserve_and_handle17hf200613548b41407E")
    *libspl_token-6f1aee9f4d11611e.rlib:spl_token-6f1aee9f4d11611e.spl_token.ee235efdef73172d-cgu.0.rcgu.o(".text._ZN9spl_token11instruction16TokenInstruction4pack17h1d062274626321b8E")
    *libspl_token-6f1aee9f4d11611e.rlib:spl_token-6f1aee9f4d11611e.spl_token.ee235efdef73172d-cgu.0.rcgu.o(".text._ZN9spl_token11instruction16transfer_checked17hdf74a6892de15017E")
    *libspl_token-6f1aee9f4d11611e.rlib:spl_token-6f1aee9f4d11611e.spl_token.ee235efdef73172d-cgu.0.rcgu.o(".text._ZN68_$LT$spl_token..state..Mint$u20$as$u20$solana_program_pack..Pack$GT$17unpack_from_slice17h8dd8546a35c4a6d3E")
    *libspl_token-6f1aee9f4d11611e.rlib:spl_token-6f1aee9f4d11611e.spl_token.ee235efdef73172d-cgu.0.rcgu.o(".text._ZN71_$LT$spl_token..state..Account$u20$as$u20$solana_program_pack..Pack$GT$17unpack_from_slice17hc5ac6522c618b015E")
    *libsolana_instructions_sysvar-b83cdb79ee1563f0.rlib:solana_instructions_sysvar-b83cdb79ee1563f0.solana_instructions_sysvar.8ae500328413518-cgu.0.rcgu.o(".text.unlikely._ZN5alloc7raw_vec11finish_grow17hf78639722db1a72fE")
    *libsolana_instructions_sysvar-b83cdb79ee1563f0.rlib:solana_instructions_sysvar-b83cdb79ee1563f0.solana_instructions_sysvar.8ae500328413518-cgu.0.rcgu.o(".text._ZN5alloc7raw_vec19RawVec$LT$T$C$A$GT$8grow_one17h55ea55bc7afd0cb0E")
    *libspl_elgamal_registry-952de972d5349bbb.rlib:spl_elgamal_registry-952de972d5349bbb.spl_elgamal_registry.2ca50c6aa94771cc-cgu.0.rcgu.o(".text._ZN5alloc2rc15Rc$LT$T$C$A$GT$9drop_slow17hd14065337e045708E")
    *libspl_elgamal_registry-952de972d5349bbb.rlib:spl_elgamal_registry-952de972d5349bbb.spl_elgamal_registry.2ca50c6aa94771cc-cgu.0.rcgu.o(".text._ZN5alloc2rc15Rc$LT$T$C$A$GT$9drop_slow17hafc7377a3db695f5E")
    *libspl_token_metadata_interface-b4d8b4fc0c84e137.rlib:spl_token_metadata_interface-b4d8b4fc0c84e137.spl_token_metadata_interface.abe004d7ece6b04b-cgu.0.rcgu.o(".text._ZN3std2io5error5Error3new17h09fa75834f9815afE")
    *libspl_token_metadata_interface-b4d8b4fc0c84e137.rlib:spl_token_metadata_interface-b4d8b4fc0c84e137.spl_token_metadata_interface.abe004d7ece6b04b-cgu.0.rcgu.o(".text._ZN4core3ptr238drop_in_place$LT$alloc..boxed..convert..$LT$impl$u20$core..convert..From$LT$alloc..string..String$GT$$u20$for$u20$alloc..boxed..Box$LT$dyn$u20$core..error..Error$u2b$core..marker..Sync$u2b$core..marker..Send$GT$$GT$..from..StringError$GT$17h26fe1c403b3de3abE")
    *libspl_token_metadata_interface-b4d8b4fc0c84e137.rlib:spl_token_metadata_interface-b4d8b4fc0c84e137.spl_token_metadata_interface.abe004d7ece6b04b-cgu.0.rcgu.o(".text._ZN4core5error5Error5cause17h1ec9d9c29d44e049E")
    *libspl_token_metadata_interface-b4d8b4fc0c84e137.rlib:spl_token_metadata_interface-b4d8b4fc0c84e137.spl_token_metadata_interface.abe004d7ece6b04b-cgu.0.rcgu.o(".text._ZN4core5error5Error7provide17h750684b42c00c776E")
    *libspl_token_metadata_interface-b4d8b4fc0c84e137.rlib:spl_token_metadata_interface-b4d8b4fc0c84e137.spl_token_metadata_interface.abe004d7ece6b04b-cgu.0.rcgu.o(".text._ZN4core5error5Error7type_id17h3a9492c64897fd2dE")
    *libspl_pod-1fe8066c4b739967.rlib:spl_pod-1fe8066c4b739967.spl_pod.b8251def906ded05-cgu.0.rcgu.o(".text._ZN7spl_pod13optional_keys152_$LT$impl$u20$core..convert..From$LT$spl_pod..optional_keys..OptionalNonZeroPubkey$GT$$u20$for$u20$core..option..Option$LT$solana_pubkey..Pubkey$GT$$GT$4from17h573e4fd683038fceE")
    *libspl_associated_token_account_client-5ae0ce326240b65c.rlib:spl_associated_token_account_client-5ae0ce326240b65c.spl_associated_token_account_client.2636b97cdbaf322-cgu.0.rcgu.o(".text._ZN35spl_associated_token_account_client7address44get_associated_token_address_with_program_id17ha0a630c1ffe30edbE")
    *libspl_associated_token_account_client-5ae0ce326240b65c.rlib:spl_associated_token_account_client-5ae0ce326240b65c.spl_associated_token_account_client.2636b97cdbaf322-cgu.0.rcgu.o(".text._ZN35spl_associated_token_account_client11instruction42build_associated_token_account_instruction17hdfd9b2b098928d8cE")
    *libspl_associated_token_account_client-5ae0ce326240b65c.rlib:spl_associated_token_account_client-5ae0ce326240b65c.spl_associated_token_account_client.2636b97cdbaf322-cgu.0.rcgu.o(".text._ZN35spl_associated_token_account_client11instruction31create_associated_token_account17h1529fa12ec25d688E")
    *libanchor_lang-78d33cf81316db05.rlib:anchor_lang-78d33cf81316db05.anchor_lang.d736203cd9443351-cgu.0.rcgu.o(".text.unlikely._ZN10serde_core2de5Error13invalid_value17h90b7027d61ed392cE")
    *libanchor_lang-78d33cf81316db05.rlib:anchor_lang-78d33cf81316db05.anchor_lang.d736203cd9443351-cgu.0.rcgu.o(".text.unlikely._ZN10serde_core2de5Error14invalid_length17h341443b06d3b067dE")
    *libanchor_lang-78d33cf81316db05.rlib:anchor_lang-78d33cf81316db05.anchor_lang.d736203cd9443351-cgu.0.rcgu.o(".text._ZN10serde_core2de9SeqAccess12next_element17h96383611f0fd2edaE")
    *libanchor_lang-78d33cf81316db05.rlib:anchor_lang-78d33cf81316db05.anchor_lang.d736203cd9443351-cgu.0.rcgu.o(".text._ZN13solana_pubkey1_79_$LT$impl$u20$serde_core..de..Deserialize$u20$for$u20$solana_pubkey..Pubkey$GT$11deserialize17h74cdbe85da336bd6E")
    *libanchor_lang-78d33cf81316db05.rlib:anchor_lang-78d33cf81316db05.anchor_lang.d736203cd9443351-cgu.0.rcgu.o(".text._ZN42_$LT$$RF$T$u20$as$u20$core..fmt..Debug$GT$3fmt17h0e53b3269f71df1bE")
    *libanchor_lang-78d33cf81316db05.rlib:anchor_lang-78d33cf81316db05.anchor_lang.d736203cd9443351-cgu.0.rcgu.o(".text._ZN42_$LT$$RF$T$u20$as$u20$core..fmt..Debug$GT$3fmt17he66471de0b497bd0E")
    *libanchor_lang-78d33cf81316db05.rlib:anchor_lang-78d33cf81316db05.anchor_lang.d736203cd9443351-cgu.0.rcgu.o(".text._ZN44_$LT$$RF$T$u20$as$u20$core..fmt..Display$GT$3fmt17hdcfd7444e79c7dedE")
    *libanchor_lang-78d33cf81316db05.rlib:anchor_lang-78d33cf81316db05.anchor_lang.d736203cd9443351-cgu.0.rcgu.o(".text._ZN44_$LT$$RF$T$u20$as$u20$core..fmt..Display$GT$3fmt17ha6ae23acbad73043E")
    *libanchor_lang-78d33cf81316db05.rlib:anchor_lang-78d33cf81316db05.anchor_lang.d736203cd9443351-cgu.0.rcgu.o(".text._ZN44_$LT$$RF$T$u20$as$u20$core..fmt..Display$GT$3fmt17hf81fb1f97c4f8582E")
    *libanchor_lang-78d33cf81316db05.rlib:anchor_lang-78d33cf81316db05.anchor_lang.d736203cd9443351-cgu.0.rcgu.o(".text._ZN46_$LT$T$u20$as$u20$serde_core..de..Expected$GT$3fmt17hac8a3d473099f13eE")
    *libanchor_lang-78d33cf81316db05.rlib:anchor_lang-78d33cf81316db05.anchor_lang.d736203cd9443351-cgu.0.rcgu.o(".text._ZN4core3fmt5Write9write_fmt17h202f5f89bf6bf54eE")
    *libanchor_lang-78d33cf81316db05.rlib:anchor_lang-78d33cf81316db05.anchor_lang.d736203cd9443351-cgu.0.rcgu.o(".text._ZN4core3fmt9Formatter9write_fmt17h3f6b819a15b06d5bE")
    *libanchor_lang-78d33cf81316db05.rlib:anchor_lang-78d33cf81316db05.anchor_lang.d736203cd9443351-cgu.0.rcgu.o(".text._ZN4core3ptr42drop_in_place$LT$alloc..string..String$GT$17hcddccd0a3b2766ffE")
    *libanchor_lang-78d33cf81316db05.rlib:anchor_lang-78d33cf81316db05.anchor_lang.d736203cd9443351-cgu.0.rcgu.o(".text._ZN53_$LT$core..fmt..Error$u20$as$u20$core..fmt..Debug$GT$3fmt17haaa5bdc6ce3ebfafE")
    *libanchor_lang-78d33cf81316db05.rlib:anchor_lang-78d33cf81316db05.anchor_lang.d736203cd9443351-cgu.0.rcgu.o(".text._ZN58_$LT$alloc..string..String$u20$as$u20$core..fmt..Write$GT$10write_char17h6537f18e3aa683b6E")
    *libanchor_lang-78d33cf81316db05.rlib:anchor_lang-78d33cf81316db05.anchor_lang.d736203cd9443351-cgu.0.rcgu.o(".text._ZN58_$LT$alloc..string..String$u20$as$u20$core..fmt..Write$GT$9write_str17hca2d36081997e77fE")
    *libanchor_lang-78d33cf81316db05.rlib:anchor_lang-78d33cf81316db05.anchor_lang.d736203cd9443351-cgu.0.rcgu.o(".text._ZN5alloc2rc15Rc$LT$T$C$A$GT$9drop_slow17he2af4c852654b315E")
    *libanchor_lang-78d33cf81316db05.rlib:anchor_lang-78d33cf81316db05.anchor_lang.d736203cd9443351-cgu.0.rcgu.o(".text._ZN5alloc2rc15Rc$LT$T$C$A$GT$9drop_slow17h49aafe2b19b49b3eE")
    *libanchor_lang-78d33cf81316db05.rlib:anchor_lang-78d33cf81316db05.anchor_lang.d736203cd9443351-cgu.0.rcgu.o(".text.unlikely._ZN5alloc7raw_vec11finish_grow17hae7aed83a327c9c7E")
    *libanchor_lang-78d33cf81316db05.rlib:anchor_lang-78d33cf81316db05.anchor_lang.d736203cd9443351-cgu.0.rcgu.o(".text.unlikely._ZN5alloc7raw_vec20RawVecInner$LT$A$GT$7reserve21do_reserve_and_handle17hd07d1f1db35c099cE")
    *libanchor_lang-78d33cf81316db05.rlib:anchor_lang-78d33cf81316db05.anchor_lang.d736203cd9443351-cgu.0.rcgu.o(".text._ZN60_$LT$alloc..string..String$u20$as$u20$core..fmt..Display$GT$3fmt17h0abfe8bb398b04f9E")
    *libanchor_lang-78d33cf81316db05.rlib:anchor_lang-78d33cf81316db05.anchor_lang.d736203cd9443351-cgu.0.rcgu.o(".text._ZN71_$LT$solana_program_error..ProgramError$u20$as$u20$core..fmt..Debug$GT$3fmt17hecc5bf2b78c53038E")
    *libanchor_lang-78d33cf81316db05.rlib:anchor_lang-78d33cf81316db05.anchor_lang.d736203cd9443351-cgu.0.rcgu.o(".text._ZN73_$LT$solana_program_error..ProgramError$u20$as$u20$core..clone..Clone$GT$5clone17hb6994f623ce16cd8E")
    *libanchor_lang-78d33cf81316db05.rlib:anchor_lang-78d33cf81316db05.anchor_lang.d736203cd9443351-cgu.0.rcgu.o(".text._ZN7bincode5error102_$LT$impl$u20$serde_core..de..Error$u20$for$u20$alloc..boxed..Box$LT$bincode..error..ErrorKind$GT$$GT$6custom17hbda34d710e09ad88E")
    *libanchor_lang-78d33cf81316db05.rlib:anchor_lang-78d33cf81316db05.anchor_lang.d736203cd9443351-cgu.0.rcgu.o(".text._ZN87_$LT$T$u20$as$u20$alloc..slice..$LT$impl$u20$$u5b$T$u5d$$GT$..to_vec_in..ConvertVec$GT$6to_vec17h037df6352fab65d4E")
    *libanchor_lang-78d33cf81316db05.rlib:anchor_lang-78d33cf81316db05.anchor_lang.d736203cd9443351-cgu.0.rcgu.o(".text._ZN11anchor_lang8accounts6signer6Signer8try_from17h24312269bc536d99E")
    *libanchor_lang-78d33cf81316db05.rlib:anchor_lang-78d33cf81316db05.anchor_lang.d736203cd9443351-cgu.0.rcgu.o(".text._ZN99_$LT$anchor_lang..bpf_upgradeable_state..ProgramData$u20$as$u20$anchor_lang..AccountDeserialize$GT$15try_deserialize17h183aaa63a68ca01dE")
    *libanchor_lang-78d33cf81316db05.rlib:anchor_lang-78d33cf81316db05.anchor_lang.d736203cd9443351-cgu.0.rcgu.o(".text._ZN99_$LT$anchor_lang..bpf_upgradeable_state..ProgramData$u20$as$u20$anchor_lang..AccountDeserialize$GT$25try_deserialize_unchecked17hf777bf76a70fef8eE")
    *libanchor_lang-78d33cf81316db05.rlib:anchor_lang-78d33cf81316db05.anchor_lang.d736203cd9443351-cgu.0.rcgu.o(".text._ZN11anchor_lang21bpf_upgradeable_state119_$LT$impl$u20$anchor_lang..AccountDeserialize$u20$for$u20$solana_loader_v3_interface..state..UpgradeableLoaderState$GT$25try_deserialize_unchecked17h3843164df12a184cE")
    *libanchor_lang-78d33cf81316db05.rlib:anchor_lang-78d33cf81316db05.anchor_lang.d736203cd9443351-cgu.0.rcgu.o(".text._ZN101_$LT$anchor_lang..bpf_writer..BpfWriter$LT$$RF$mut$u20$$u5b$u8$u5d$$GT$$u20$as$u20$std..io..Write$GT$9write_all17h608a83d8be462786E")
    *libanchor_lang-78d33cf81316db05.rlib:anchor_lang-78d33cf81316db05.anchor_lang.d736203cd9443351-cgu.0.rcgu.o(".text._ZN11anchor_lang6common5close17hb359b40e6f08f1f8E")
    *libanchor_lang-78d33cf81316db05.rlib:anchor_lang-78d33cf81316db05.anchor_lang.d736203cd9443351-cgu.0.rcgu.o(".text._ZN11anchor_lang6common9is_closed17hf269d69be95b9544E")
    *libanchor_lang-78d33cf81316db05.rlib:anchor_lang-78d33cf81316db05.anchor_lang.d736203cd9443351-cgu.0.rcgu.o(".text._ZN104_$LT$anchor_lang..error..Error$u20$as$u20$core..convert..From$LT$anchor_lang..error..AnchorError$GT$$GT$4from17ha65dea8daef282a1E")
    *libanchor_lang-78d33cf81316db05.rlib:anchor_lang-78d33cf81316db05.anchor_lang.d736203cd9443351-cgu.0.rcgu.o(".text._ZN107_$LT$anchor_lang..error..Error$u20$as$u20$core..convert..From$LT$solana_program_error..ProgramError$GT$$GT$4from17h9297e8e2ef8c6707E")
    *libanchor_lang-78d33cf81316db05.rlib:anchor_lang-78d33cf81316db05.anchor_lang.d736203cd9443351-cgu.0.rcgu.o(".text._ZN11anchor_lang5error5Error3log17h46ae0ccdef2f8230E")
    *libanchor_lang-78d33cf81316db05.rlib:anchor_lang-78d33cf81316db05.anchor_lang.d736203cd9443351-cgu.0.rcgu.o(".text._ZN11anchor_lang5error5Error12with_pubkeys17hc2b6215eab2ab735E")
    *libanchor_lang-78d33cf81316db05.rlib:anchor_lang-78d33cf81316db05.anchor_lang.d736203cd9443351-cgu.0.rcgu.o(".text._ZN11anchor_lang5error22ProgramErrorWithOrigin3log17haa0c008f9968f54cE")
    *libanchor_lang-78d33cf81316db05.rlib:anchor_lang-78d33cf81316db05.anchor_lang.d736203cd9443351-cgu.0.rcgu.o(".text._ZN11anchor_lang5error11AnchorError3log17h34b815ed0baf97cfE")
    *libanchor_lang-78d33cf81316db05.rlib:anchor_lang-78d33cf81316db05.anchor_lang.d736203cd9443351-cgu.0.rcgu.o(".text._ZN11anchor_lang5error117_$LT$impl$u20$core..convert..From$LT$anchor_lang..error..Error$GT$$u20$for$u20$solana_program_error..ProgramError$GT$4from17h035969255be97322E")
    *libanchor_lang-78d33cf81316db05.rlib:anchor_lang-78d33cf81316db05.anchor_lang.d736203cd9443351-cgu.0.rcgu.o(".text._ZN11anchor_lang14system_program8allocate17h9195be6e9daa628fE")
    *libanchor_lang-78d33cf81316db05.rlib:anchor_lang-78d33cf81316db05.anchor_lang.d736203cd9443351-cgu.0.rcgu.o(".text._ZN11anchor_lang14system_program6assign17h3572990d121f580eE")
    *libanchor_lang-78d33cf81316db05.rlib:anchor_lang-78d33cf81316db05.anchor_lang.d736203cd9443351-cgu.0.rcgu.o(".text._ZN11anchor_lang14system_program14create_account17h6e86901d8ba53ae8E")
    *libanchor_lang-78d33cf81316db05.rlib:anchor_lang-78d33cf81316db05.anchor_lang.d736203cd9443351-cgu.0.rcgu.o(".text._ZN11anchor_lang14system_program8transfer17ha315b65423958247E")
    *libanchor_lang-78d33cf81316db05.rlib:anchor_lang-78d33cf81316db05.anchor_lang.d736203cd9443351-cgu.0.rcgu.o(".text._ZN11anchor_lang14solana_program3log12sol_log_data17hcee211ab63fdb6c0E")
    *libanchor_lang-78d33cf81316db05.rlib:anchor_lang-78d33cf81316db05.anchor_lang.d736203cd9443351-cgu.0.rcgu.o(".text._ZN11anchor_lang5error9ErrorCode4name17h5059c915877890c5E")
    *libanchor_lang-78d33cf81316db05.rlib:anchor_lang-78d33cf81316db05.anchor_lang.d736203cd9443351-cgu.0.rcgu.o(".text._ZN102_$LT$anchor_lang..error..Error$u20$as$u20$core..convert..From$LT$anchor_lang..error..ErrorCode$GT$$GT$4from17ha7c2eadb220dc9d5E")
    *libanchor_lang-78d33cf81316db05.rlib:anchor_lang-78d33cf81316db05.anchor_lang.d736203cd9443351-cgu.0.rcgu.o(".text._ZN68_$LT$anchor_lang..error..ErrorCode$u20$as$u20$core..fmt..Display$GT$3fmt17h1efb022fd74de43fE")
    *libsolana_invoke-0a816efa287ca883.rlib:solana_invoke-0a816efa287ca883.solana_invoke.70e449b1739dd0-cgu.0.rcgu.o(".text._ZN13solana_invoke6invoke17hcf96f160b23fe9bbE")
    *libsolana_invoke-0a816efa287ca883.rlib:solana_invoke-0a816efa287ca883.solana_invoke.70e449b1739dd0-cgu.0.rcgu.o(".text._ZN13solana_invoke13invoke_signed17h383ccdabbbda443fE")
    *libsolana_sysvar-befca3053203f5a2.rlib:solana_sysvar-befca3053203f5a2.solana_sysvar.16cd9ec2b0d99b45-cgu.0.rcgu.o(".text._ZN13solana_sysvar4rent69_$LT$impl$u20$solana_sysvar..Sysvar$u20$for$u20$solana_rent..Rent$GT$3get17hc63218ef6e28d8efE")
    *libsolana_stake_interface-566f37717a32a244.rlib:solana_stake_interface-566f37717a32a244.solana_stake_interface.b7f789929b2f4c1e-cgu.0.rcgu.o(".text.unlikely._ZN5alloc7raw_vec11finish_grow17h5db1de91bb0a4590E")
    *libsolana_stake_interface-566f37717a32a244.rlib:solana_stake_interface-566f37717a32a244.solana_stake_interface.b7f789929b2f4c1e-cgu.0.rcgu.o(".text._ZN5alloc7raw_vec19RawVec$LT$T$C$A$GT$8grow_one17h0756fac82d614777E")
    *libsolana_cpi-902d6af12fa4ab97.rlib:solana_cpi-902d6af12fa4ab97.solana_cpi.50603afa83ceb5dc-cgu.0.rcgu.o(".text._ZN10solana_cpi15set_return_data17hd21b45b61a0d63c1E")
    *libsolana_program_entrypoint-6b81558d809868c8.rlib:solana_program_entrypoint-6b81558d809868c8.solana_program_entrypoint.b8c961b358c0b9c1-cgu.0.rcgu.o(".text.unlikely._ZN5alloc7raw_vec11finish_grow17hcb0f4defd940cc0dE")
    *libsolana_program_entrypoint-6b81558d809868c8.rlib:solana_program_entrypoint-6b81558d809868c8.solana_program_entrypoint.b8c961b358c0b9c1-cgu.0.rcgu.o(".text._ZN5alloc7raw_vec19RawVec$LT$T$C$A$GT$8grow_one17h404c04596581146aE")
    *libsolana_program_entrypoint-6b81558d809868c8.rlib:solana_program_entrypoint-6b81558d809868c8.solana_program_entrypoint.b8c961b358c0b9c1-cgu.0.rcgu.o(".text._ZN25solana_program_entrypoint11deserialize17h5cac08ecf20498ecE")
    *libsolana_system_interface-a2cdec82d16123c7.rlib:solana_system_interface-a2cdec82d16123c7.solana_system_interface.d3dbf3ed922ce756-cgu.0.rcgu.o(".text._ZN13solana_pubkey1_78_$LT$impl$u20$serde_core..ser..Serialize$u20$for$u20$solana_pubkey..Pubkey$GT$9serialize17h1ed743a4e90eae95E")
    *libsolana_system_interface-a2cdec82d16123c7.rlib:solana_system_interface-a2cdec82d16123c7.solana_system_interface.d3dbf3ed922ce756-cgu.0.rcgu.o(".text._ZN18solana_instruction11Instruction16new_with_bincode17h603a9b70374afea2E")
    *libsolana_system_interface-a2cdec82d16123c7.rlib:solana_system_interface-a2cdec82d16123c7.solana_system_interface.d3dbf3ed922ce756-cgu.0.rcgu.o(".text._ZN42_$LT$$RF$T$u20$as$u20$core..fmt..Debug$GT$3fmt17h7e88aa590a6eb33dE")
    *libsolana_system_interface-a2cdec82d16123c7.rlib:solana_system_interface-a2cdec82d16123c7.solana_system_interface.d3dbf3ed922ce756-cgu.0.rcgu.o(".text._ZN42_$LT$$RF$T$u20$as$u20$core..fmt..Debug$GT$3fmt17h0973572b6a7011c2E")
    *libsolana_system_interface-a2cdec82d16123c7.rlib:solana_system_interface-a2cdec82d16123c7.solana_system_interface.d3dbf3ed922ce756-cgu.0.rcgu.o(".text._ZN42_$LT$$RF$T$u20$as$u20$core..fmt..Debug$GT$3fmt17ha502c5de66dc4f6aE")
    *libsolana_system_interface-a2cdec82d16123c7.rlib:solana_system_interface-a2cdec82d16123c7.solana_system_interface.d3dbf3ed922ce756-cgu.0.rcgu.o(".text._ZN42_$LT$$RF$T$u20$as$u20$core..fmt..Debug$GT$3fmt17hd38e80696dee2f31E")
    *libsolana_system_interface-a2cdec82d16123c7.rlib:solana_system_interface-a2cdec82d16123c7.solana_system_interface.d3dbf3ed922ce756-cgu.0.rcgu.o(".text._ZN42_$LT$$RF$T$u20$as$u20$core..fmt..Debug$GT$3fmt17h43c6fcc80fdfe637E")
    *libsolana_system_interface-a2cdec82d16123c7.rlib:solana_system_interface-a2cdec82d16123c7.solana_system_interface.d3dbf3ed922ce756-cgu.0.rcgu.o(".text._ZN42_$LT$$RF$T$u20$as$u20$core..fmt..Debug$GT$3fmt17h599a9d2428a1dba8E")
    *libsolana_system_interface-a2cdec82d16123c7.rlib:solana_system_interface-a2cdec82d16123c7.solana_system_interface.d3dbf3ed922ce756-cgu.0.rcgu.o(".text._ZN4core3fmt3num52_$LT$impl$u20$core..fmt..Debug$u20$for$u20$usize$GT$3fmt17hdb1e4730d25472aaE")
    *libsolana_system_interface-a2cdec82d16123c7.rlib:solana_system_interface-a2cdec82d16123c7.solana_system_interface.d3dbf3ed922ce756-cgu.0.rcgu.o(".text._ZN4core3ptr71drop_in_place$LT$alloc..boxed..Box$LT$bincode..error..ErrorKind$GT$$GT$17h1c3e2962f4002633E")
    *libsolana_system_interface-a2cdec82d16123c7.rlib:solana_system_interface-a2cdec82d16123c7.solana_system_interface.d3dbf3ed922ce756-cgu.0.rcgu.o(".text.unlikely._ZN5alloc7raw_vec11finish_grow17ha6ca140e6d951f77E")
    *libsolana_system_interface-a2cdec82d16123c7.rlib:solana_system_interface-a2cdec82d16123c7.solana_system_interface.d3dbf3ed922ce756-cgu.0.rcgu.o(".text.unlikely._ZN5alloc7raw_vec20RawVecInner$LT$A$GT$7reserve21do_reserve_and_handle17hf7255a680e92f029E")
    *libsolana_system_interface-a2cdec82d16123c7.rlib:solana_system_interface-a2cdec82d16123c7.solana_system_interface.d3dbf3ed922ce756-cgu.0.rcgu.o(".text._ZN67_$LT$alloc..boxed..Box$LT$T$C$A$GT$$u20$as$u20$core..fmt..Debug$GT$3fmt17hff1f985f527a1211E")
    *libsolana_system_interface-a2cdec82d16123c7.rlib:solana_system_interface-a2cdec82d16123c7.solana_system_interface.d3dbf3ed922ce756-cgu.0.rcgu.o(".text._ZN23solana_system_interface11instruction14create_account17hed6c0c9c516ccdc9E")
    *libsolana_system_interface-a2cdec82d16123c7.rlib:solana_system_interface-a2cdec82d16123c7.solana_system_interface.d3dbf3ed922ce756-cgu.0.rcgu.o(".text._ZN23solana_system_interface11instruction24create_account_with_seed17hcdf118ac0afee728E")
    *libsolana_system_interface-a2cdec82d16123c7.rlib:solana_system_interface-a2cdec82d16123c7.solana_system_interface.d3dbf3ed922ce756-cgu.0.rcgu.o(".text._ZN23solana_system_interface11instruction6assign17h47ee524244fcd943E")
    *libsolana_system_interface-a2cdec82d16123c7.rlib:solana_system_interface-a2cdec82d16123c7.solana_system_interface.d3dbf3ed922ce756-cgu.0.rcgu.o(".text._ZN23solana_system_interface11instruction8transfer17hc35cfd2ff6b98600E")
    *libsolana_system_interface-a2cdec82d16123c7.rlib:solana_system_interface-a2cdec82d16123c7.solana_system_interface.d3dbf3ed922ce756-cgu.0.rcgu.o(".text._ZN23solana_system_interface11instruction8allocate17hf16c8debb3f5f603E")
    *libsolana_rent-77789060edc5a318.rlib:solana_rent-77789060edc5a318.solana_rent.6520e2e60806bdf6-cgu.0.rcgu.o(".text._ZN11solana_rent4Rent15minimum_balance17h734ba1327ee2786eE")
    *libsolana_rent-77789060edc5a318.rlib:solana_rent-77789060edc5a318.solana_rent.6520e2e60806bdf6-cgu.0.rcgu.o(".text._ZN11solana_rent4Rent9is_exempt17h845cf7f2f41f7454E")
    *libsolana_account_info-744b2bb5dd79d11b.rlib:solana_account_info-744b2bb5dd79d11b.solana_account_info.bd7ee74d542ed84e-cgu.0.rcgu.o(".text._ZN19solana_account_info11AccountInfo8lamports17hd1d9a694002e5f56E")
    *libsolana_account_info-744b2bb5dd79d11b.rlib:solana_account_info-744b2bb5dd79d11b.solana_account_info.bd7ee74d542ed84e-cgu.0.rcgu.o(".text._ZN19solana_account_info11AccountInfo8data_len17h75ffe1ec79bd788dE")
    *libsolana_account_info-744b2bb5dd79d11b.rlib:solana_account_info-744b2bb5dd79d11b.solana_account_info.bd7ee74d542ed84e-cgu.0.rcgu.o(".text._ZN19solana_account_info11AccountInfo12try_data_len17h7f85bb40600c54dbE")
    *libsolana_account_info-744b2bb5dd79d11b.rlib:solana_account_info-744b2bb5dd79d11b.solana_account_info.bd7ee74d542ed84e-cgu.0.rcgu.o(".text._ZN19solana_account_info11AccountInfo13data_is_empty17hd1909615206447c4E")
    *libsolana_account_info-744b2bb5dd79d11b.rlib:solana_account_info-744b2bb5dd79d11b.solana_account_info.bd7ee74d542ed84e-cgu.0.rcgu.o(".text._ZN19solana_account_info11AccountInfo6resize17h683132d78932c4c0E")
    *libsolana_account_info-744b2bb5dd79d11b.rlib:solana_account_info-744b2bb5dd79d11b.solana_account_info.bd7ee74d542ed84e-cgu.0.rcgu.o(".text._ZN19solana_account_info11AccountInfo6assign17hfa1f2a51f53bf8adE")
    *libsolana_program_error-f129c579f1973256.rlib:solana_program_error-f129c579f1973256.solana_program_error.a9148d0c1be7ed35-cgu.0.rcgu.o(".text._ZN44_$LT$$RF$T$u20$as$u20$core..fmt..Display$GT$3fmt17h6fac9bbbd5abd435E")
    *libsolana_program_error-f129c579f1973256.rlib:solana_program_error-f129c579f1973256.solana_program_error.a9148d0c1be7ed35-cgu.0.rcgu.o(".text._ZN45_$LT$$RF$T$u20$as$u20$core..fmt..LowerHex$GT$3fmt17h7e46c899f9898a5eE")
    *libsolana_program_error-f129c579f1973256.rlib:solana_program_error-f129c579f1973256.solana_program_error.a9148d0c1be7ed35-cgu.0.rcgu.o(".text._ZN73_$LT$solana_program_error..ProgramError$u20$as$u20$core..fmt..Display$GT$3fmt17h3aed9cd3af7c790eE")
    *libsolana_program_error-f129c579f1973256.rlib:solana_program_error-f129c579f1973256.solana_program_error.a9148d0c1be7ed35-cgu.0.rcgu.o(".text._ZN20solana_program_error95_$LT$impl$u20$core..convert..From$LT$solana_program_error..ProgramError$GT$$u20$for$u20$u64$GT$4from17hbe8d10e7adfcfe82E")
    *libsolana_program_error-f129c579f1973256.rlib:solana_program_error-f129c579f1973256.solana_program_error.a9148d0c1be7ed35-cgu.0.rcgu.o(".text._ZN85_$LT$solana_program_error..ProgramError$u20$as$u20$core..convert..From$LT$u64$GT$$GT$4from17h58651e19a461105cE")
    *libsolana_instruction-a6eff7dc0a6ebbcb.rlib:solana_instruction-a6eff7dc0a6ebbcb.solana_instruction.b207aef485dc7890-cgu.0.rcgu.o(".text._ZN18solana_instruction11Instruction14new_with_bytes17hc258ca4e2cfe45faE")
    *libbincode-9e05fc17a49eacc9.rlib:bincode-9e05fc17a49eacc9.bincode.390a1df82bcb54f3-cgu.0.rcgu.o(".text._ZN7bincode5error129_$LT$impl$u20$core..convert..From$LT$std..io..error..Error$GT$$u20$for$u20$alloc..boxed..Box$LT$bincode..error..ErrorKind$GT$$GT$4from17he369dec305eede71E")
    *libsolana_pubkey-002dcf36749df838.rlib:solana_pubkey-002dcf36749df838.solana_pubkey.98fe165c57e1bf5f-cgu.0.rcgu.o(".text._ZN13solana_pubkey6Pubkey16create_with_seed17h9581845152f995a8E")
    *libsolana_pubkey-002dcf36749df838.rlib:solana_pubkey-002dcf36749df838.solana_pubkey.98fe165c57e1bf5f-cgu.0.rcgu.o(".text._ZN13solana_pubkey6Pubkey20find_program_address17h49a33a82892d8375E")
    *libsolana_pubkey-002dcf36749df838.rlib:solana_pubkey-002dcf36749df838.solana_pubkey.98fe165c57e1bf5f-cgu.0.rcgu.o(".text._ZN13solana_pubkey6Pubkey22create_program_address17he74e017c2e75ff8cE")
    *libsolana_pubkey-002dcf36749df838.rlib:solana_pubkey-002dcf36749df838.solana_pubkey.98fe165c57e1bf5f-cgu.0.rcgu.o(".text._ZN13solana_pubkey6Pubkey3log17hfa9a7c9731e13a99E")
    *libsolana_pubkey-002dcf36749df838.rlib:solana_pubkey-002dcf36749df838.solana_pubkey.98fe165c57e1bf5f-cgu.0.rcgu.o(".text._ZN13solana_pubkey15write_as_base5817hc49499ea43282642E")
    *libsolana_pubkey-002dcf36749df838.rlib:solana_pubkey-002dcf36749df838.solana_pubkey.98fe165c57e1bf5f-cgu.0.rcgu.o(".text._ZN58_$LT$solana_pubkey..Pubkey$u20$as$u20$core..fmt..Debug$GT$3fmt17h38ed13ef250888f6E")
    *libborsh-64d840cb755f7021.rlib:borsh-64d840cb755f7021.borsh.ad0828a51eaa5e99-cgu.0.rcgu.o(".text._ZN5borsh2de44unexpected_eof_to_unexpected_length_of_input17h3c755096e4d39833E")
    *libsolana_sha256_hasher-3a5025ed97eb3429.rlib:solana_sha256_hasher-3a5025ed97eb3429.solana_sha256_hasher.f54f7ad3988b707c-cgu.0.rcgu.o(".text._ZN20solana_sha256_hasher5hashv17h52c9a5a37c9506ccE")
    *libserde_core-b7eccaaa0c011ffd.rlib:serde_core-b7eccaaa0c011ffd.serde_core.34f26d3bde854e3b-cgu.0.rcgu.o(".text._ZN42_$LT$$RF$T$u20$as$u20$core..fmt..Debug$GT$3fmt17h18cf7596e1f8f6baE")
    *libserde_core-b7eccaaa0c011ffd.rlib:serde_core-b7eccaaa0c011ffd.serde_core.34f26d3bde854e3b-cgu.0.rcgu.o(".text._ZN4core3fmt5Write9write_fmt17h5a9868ca4257d4c2E")
    *libserde_core-b7eccaaa0c011ffd.rlib:serde_core-b7eccaaa0c011ffd.serde_core.34f26d3bde854e3b-cgu.0.rcgu.o(".text._ZN65_$LT$serde_core..de..Unexpected$u20$as$u20$core..fmt..Display$GT$3fmt17h2e4aa67f14d340ebE")
    *libserde_core-b7eccaaa0c011ffd.rlib:serde_core-b7eccaaa0c011ffd.serde_core.34f26d3bde854e3b-cgu.0.rcgu.o(".text._ZN52_$LT$$RF$str$u20$as$u20$serde_core..de..Expected$GT$3fmt17h23d333a66b19d644E")
    *libserde_core-b7eccaaa0c011ffd.rlib:serde_core-b7eccaaa0c011ffd.serde_core.34f26d3bde854e3b-cgu.0.rcgu.o(".text._ZN71_$LT$dyn$u20$serde_core..de..Expected$u20$as$u20$core..fmt..Display$GT$3fmt17he0e61ee6f69c70cdE")
    *libserde_core-b7eccaaa0c011ffd.rlib:serde_core-b7eccaaa0c011ffd.serde_core.34f26d3bde854e3b-cgu.0.rcgu.o(".text._ZN71_$LT$serde_core..de..WithDecimalPoint$u20$as$u20$core..fmt..Display$GT$3fmt17h438c54516b199dbeE")
    *libserde_core-b7eccaaa0c011ffd.rlib:serde_core-b7eccaaa0c011ffd.serde_core.34f26d3bde854e3b-cgu.0.rcgu.o(".text._ZN133_$LT$$LT$serde_core..de..WithDecimalPoint$u20$as$u20$core..fmt..Display$GT$..fmt..LookForDecimalPoint$u20$as$u20$core..fmt..Write$GT$9write_str17hc03e84b0d72c4b26E")
    *libserde_core-b7eccaaa0c011ffd.rlib:serde_core-b7eccaaa0c011ffd.serde_core.34f26d3bde854e3b-cgu.0.rcgu.o(".text._ZN133_$LT$$LT$serde_core..de..WithDecimalPoint$u20$as$u20$core..fmt..Display$GT$..fmt..LookForDecimalPoint$u20$as$u20$core..fmt..Write$GT$10write_char17h7cd39cad9d448c43E")
    *libstd-30a182e154ee17f6.rlib:std-30a182e154ee17f6.std.27cd147212409ffc-cgu.0.rcgu.o(".text._ZN42_$LT$$RF$T$u20$as$u20$core..fmt..Debug$GT$3fmt17h26aee6fb7680932bE")
    *libstd-30a182e154ee17f6.rlib:std-30a182e154ee17f6.std.27cd147212409ffc-cgu.0.rcgu.o(".text._ZN42_$LT$$RF$T$u20$as$u20$core..fmt..Debug$GT$3fmt17hda68c1c7f1c5726fE")
    *libstd-30a182e154ee17f6.rlib:std-30a182e154ee17f6.std.27cd147212409ffc-cgu.0.rcgu.o(".text._ZN4core3fmt3num50_$LT$impl$u20$core..fmt..Debug$u20$for$u20$i32$GT$3fmt17hca1ee99b9602d046E")
    *libstd-30a182e154ee17f6.rlib:std-30a182e154ee17f6.std.27cd147212409ffc-cgu.0.rcgu.o(".text._ZN4core3ptr238drop_in_place$LT$alloc..boxed..convert..$LT$impl$u20$core..convert..From$LT$alloc..string..String$GT$$u20$for$u20$alloc..boxed..Box$LT$dyn$u20$core..error..Error$u2b$core..marker..Sync$u2b$core..marker..Send$GT$$GT$..from..StringError$GT$17h8316abae74cf92b4E")
    *libstd-30a182e154ee17f6.rlib:std-30a182e154ee17f6.std.27cd147212409ffc-cgu.0.rcgu.o(".text._ZN4core3ptr42drop_in_place$LT$alloc..string..String$GT$17h2cc6d5c97f8ca76fE")
    *libstd-30a182e154ee17f6.rlib:std-30a182e154ee17f6.std.27cd147212409ffc-cgu.0.rcgu.o(".text._ZN4core5error5Error5cause17hb0eb8cc32d3b0cc7E")
    *libstd-30a182e154ee17f6.rlib:std-30a182e154ee17f6.std.27cd147212409ffc-cgu.0.rcgu.o(".text._ZN4core5error5Error7provide17h80575cc6999f5459E")
    *libstd-30a182e154ee17f6.rlib:std-30a182e154ee17f6.std.27cd147212409ffc-cgu.0.rcgu.o(".text._ZN4core5error5Error7type_id17h9b5908a8d5c815c6E")
    *libstd-30a182e154ee17f6.rlib:std-30a182e154ee17f6.std.27cd147212409ffc-cgu.0.rcgu.o(".text._ZN58_$LT$alloc..string..String$u20$as$u20$core..fmt..Debug$GT$3fmt17hf720a149603ffe39E")
    *libstd-30a182e154ee17f6.rlib:std-30a182e154ee17f6.std.27cd147212409ffc-cgu.0.rcgu.o(".text._ZN58_$LT$std..io..error..Error$u20$as$u20$core..fmt..Debug$GT$3fmt17h10f07c55682c7dbdE")
    *libstd-30a182e154ee17f6.rlib:std-30a182e154ee17f6.std.27cd147212409ffc-cgu.0.rcgu.o(".text._ZN3std2io5error5Error3new17h11149d8495b68af6E")
    *libstd-30a182e154ee17f6.rlib:std-30a182e154ee17f6.std.27cd147212409ffc-cgu.0.rcgu.o(".text._ZN3std2io5error5Error4_new17hf437cdaea4dfb409E")
    *libstd-30a182e154ee17f6.rlib:std-30a182e154ee17f6.std.27cd147212409ffc-cgu.0.rcgu.o(".text._ZN3std2io5error83_$LT$impl$u20$core..fmt..Debug$u20$for$u20$std..io..error..repr_bitpacked..Repr$GT$3fmt17h9de5ded71ec5b85cE")
    *libstd-30a182e154ee17f6.rlib:std-30a182e154ee17f6.std.27cd147212409ffc-cgu.0.rcgu.o(".text.unlikely._ZN3std7process5abort17hb785e15ccb55d64fE")
    *libstd-30a182e154ee17f6.rlib:std-30a182e154ee17f6.std.27cd147212409ffc-cgu.0.rcgu.o(".text.unlikely._RNvCscR3e5J6VSLN_7___rustc17rust_begin_unwind")
    *libstd-30a182e154ee17f6.rlib:std-30a182e154ee17f6.std.27cd147212409ffc-cgu.0.rcgu.o(".text._ZN62_$LT$std..io..error..ErrorKind$u20$as$u20$core..fmt..Debug$GT$3fmt17hf18d8e634ec28c8dE")
    *libstd-30a182e154ee17f6.rlib:std-30a182e154ee17f6.std.27cd147212409ffc-cgu.0.rcgu.o(".text._ZN3std3sys3pal3sbf7sol_log17h46ed93fe6cb4860cE")
    *libstd-30a182e154ee17f6.rlib:std-30a182e154ee17f6.std.27cd147212409ffc-cgu.0.rcgu.o(".text.unlikely._ZN3std3sys3pal3sbf5panic17h5e030c92e3e5e13aE")
    *libstd-30a182e154ee17f6.rlib:std-30a182e154ee17f6.std.27cd147212409ffc-cgu.0.rcgu.o(".text.unlikely._ZN3std3sys3pal3sbf14abort_internal17h189f9bb5936a955cE")
    *libstd-30a182e154ee17f6.rlib:std-30a182e154ee17f6.std.27cd147212409ffc-cgu.0.rcgu.o(".text.unlikely._ZN3std5alloc8rust_oom17h1a558e7cdbaf7cc1E")
    *libstd-30a182e154ee17f6.rlib:std-30a182e154ee17f6.std.27cd147212409ffc-cgu.0.rcgu.o(".text.unlikely._RNvCscR3e5J6VSLN_7___rustc8___rg_oom")
    *liballoc-91c82d13bc4939af.rlib:alloc-91c82d13bc4939af.alloc.555e7509368aade7-cgu.0.rcgu.o(".text._ZN4core3fmt5Write9write_fmt17hb93e2ea2789364caE")
    *liballoc-91c82d13bc4939af.rlib:alloc-91c82d13bc4939af.alloc.555e7509368aade7-cgu.0.rcgu.o(".text._ZN4core3ptr42drop_in_place$LT$alloc..string..String$GT$17h6cc142a95ab821b1E")
    *liballoc-91c82d13bc4939af.rlib:alloc-91c82d13bc4939af.alloc.555e7509368aade7-cgu.0.rcgu.o(".text._ZN53_$LT$core..fmt..Error$u20$as$u20$core..fmt..Debug$GT$3fmt17haaa5bdc6ce3ebfafE")
    *liballoc-91c82d13bc4939af.rlib:alloc-91c82d13bc4939af.alloc.555e7509368aade7-cgu.0.rcgu.o(".text.unlikely._ZN5alloc7raw_vec17capacity_overflow17hb35234d8fde76484E")
    *liballoc-91c82d13bc4939af.rlib:alloc-91c82d13bc4939af.alloc.555e7509368aade7-cgu.0.rcgu.o(".text._ZN5alloc7raw_vec19RawVec$LT$T$C$A$GT$8grow_one17hb1239bbd272beed0E")
    *liballoc-91c82d13bc4939af.rlib:alloc-91c82d13bc4939af.alloc.555e7509368aade7-cgu.0.rcgu.o(".text.unlikely._ZN5alloc7raw_vec20RawVecInner$LT$A$GT$7reserve21do_reserve_and_handle17h723c6e260acabf7cE")
    *liballoc-91c82d13bc4939af.rlib:alloc-91c82d13bc4939af.alloc.555e7509368aade7-cgu.0.rcgu.o(".text.unlikely._ZN5alloc7raw_vec11finish_grow17h726e8a9d8127cc67E")
    *liballoc-91c82d13bc4939af.rlib:alloc-91c82d13bc4939af.alloc.555e7509368aade7-cgu.0.rcgu.o(".text.unlikely._ZN5alloc7raw_vec12handle_error17h49931f096d3db69aE")
    *liballoc-91c82d13bc4939af.rlib:alloc-91c82d13bc4939af.alloc.555e7509368aade7-cgu.0.rcgu.o(".text.unlikely._ZN5alloc5alloc18handle_alloc_error17hdecd2d8ca4c9b5bbE")
    *liballoc-91c82d13bc4939af.rlib:alloc-91c82d13bc4939af.alloc.555e7509368aade7-cgu.0.rcgu.o(".text._ZN256_$LT$alloc..boxed..convert..$LT$impl$u20$core..convert..From$LT$alloc..string..String$GT$$u20$for$u20$alloc..boxed..Box$LT$dyn$u20$core..error..Error$u2b$core..marker..Sync$u2b$core..marker..Send$GT$$GT$..from..StringError$u20$as$u20$core..error..Error$GT$11description17h4f1e64f34513d1a7E")
    *liballoc-91c82d13bc4939af.rlib:alloc-91c82d13bc4939af.alloc.555e7509368aade7-cgu.0.rcgu.o(".text._ZN256_$LT$alloc..boxed..convert..$LT$impl$u20$core..convert..From$LT$alloc..string..String$GT$$u20$for$u20$alloc..boxed..Box$LT$dyn$u20$core..error..Error$u2b$core..marker..Sync$u2b$core..marker..Send$GT$$GT$..from..StringError$u20$as$u20$core..fmt..Display$GT$3fmt17hb11f259b86c7ce07E")
    *liballoc-91c82d13bc4939af.rlib:alloc-91c82d13bc4939af.alloc.555e7509368aade7-cgu.0.rcgu.o(".text._ZN254_$LT$alloc..boxed..convert..$LT$impl$u20$core..convert..From$LT$alloc..string..String$GT$$u20$for$u20$alloc..boxed..Box$LT$dyn$u20$core..error..Error$u2b$core..marker..Sync$u2b$core..marker..Send$GT$$GT$..from..StringError$u20$as$u20$core..fmt..Debug$GT$3fmt17hc16cdd4affb20139E")
    *liballoc-91c82d13bc4939af.rlib:alloc-91c82d13bc4939af.alloc.555e7509368aade7-cgu.0.rcgu.o(".text._ZN5alloc3fmt6format12format_inner17h36b493547a55b45dE")
    *liballoc-91c82d13bc4939af.rlib:alloc-91c82d13bc4939af.alloc.555e7509368aade7-cgu.0.rcgu.o(".text._ZN67_$LT$alloc..string..FromUtf8Error$u20$as$u20$core..fmt..Display$GT$3fmt17h9b1ae9cd68670399E")
    *liballoc-91c82d13bc4939af.rlib:alloc-91c82d13bc4939af.alloc.555e7509368aade7-cgu.0.rcgu.o(".text._ZN60_$LT$alloc..string..String$u20$as$u20$core..clone..Clone$GT$5clone17h13865437a00da20fE")
    *liballoc-91c82d13bc4939af.rlib:alloc-91c82d13bc4939af.alloc.555e7509368aade7-cgu.0.rcgu.o(".text._ZN58_$LT$alloc..string..String$u20$as$u20$core..fmt..Write$GT$9write_str17hca2d36081997e77fE")
    *liballoc-91c82d13bc4939af.rlib:alloc-91c82d13bc4939af.alloc.555e7509368aade7-cgu.0.rcgu.o(".text._ZN58_$LT$alloc..string..String$u20$as$u20$core..fmt..Write$GT$10write_char17h6537f18e3aa683b6E")
    *libcore-673053c840437f62.rlib:core-673053c840437f62.core.e65e0c7e339ea620-cgu.0.rcgu.o(".text._ZN4core3num7flt2dec8strategy6dragon9mul_pow1017hd22baee8acbd9e19E")
    *libcore-673053c840437f62.rlib:core-673053c840437f62.core.e65e0c7e339ea620-cgu.0.rcgu.o(".text._ZN4core3num7flt2dec8strategy6dragon15format_shortest17had09284f0852138fE")
    *libcore-673053c840437f62.rlib:core-673053c840437f62.core.e65e0c7e339ea620-cgu.0.rcgu.o(".text._ZN4core3num7flt2dec8strategy6dragon12format_exact17hae4c0717209039c2E")
    *libcore-673053c840437f62.rlib:core-673053c840437f62.core.e65e0c7e339ea620-cgu.0.rcgu.o(".text._ZN4core3num7flt2dec8strategy5grisu19format_shortest_opt17hc5cf78ffcec8fd10E")
    *libcore-673053c840437f62.rlib:core-673053c840437f62.core.e65e0c7e339ea620-cgu.0.rcgu.o(".text._ZN4core3num7flt2dec8strategy5grisu16format_exact_opt17h6ac5a3522dbbb56dE")
    *libcore-673053c840437f62.rlib:core-673053c840437f62.core.e65e0c7e339ea620-cgu.0.rcgu.o(".text._ZN4core3num7flt2dec8strategy5grisu16format_exact_opt14possibly_round17h73c6cc53be2443fdE")
    *libcore-673053c840437f62.rlib:core-673053c840437f62.core.e65e0c7e339ea620-cgu.0.rcgu.o(".text._ZN4core3num7flt2dec17digits_to_dec_str17h3ce35267527a9cc5E")
    *libcore-673053c840437f62.rlib:core-673053c840437f62.core.e65e0c7e339ea620-cgu.0.rcgu.o(".text._ZN71_$LT$core..ops..range..Range$LT$Idx$GT$$u20$as$u20$core..fmt..Debug$GT$3fmt17hc74cdea0260d66aeE")
    *libcore-673053c840437f62.rlib:core-673053c840437f62.core.e65e0c7e339ea620-cgu.0.rcgu.o(".text._ZN62_$LT$core..cell..BorrowError$u20$as$u20$core..fmt..Display$GT$3fmt17h3a77ba6c4ee4b0aaE")
    *libcore-673053c840437f62.rlib:core-673053c840437f62.core.e65e0c7e339ea620-cgu.0.rcgu.o(".text._ZN65_$LT$core..cell..BorrowMutError$u20$as$u20$core..fmt..Display$GT$3fmt17h48528f82214e0327E")
    *libcore-673053c840437f62.rlib:core-673053c840437f62.core.e65e0c7e339ea620-cgu.0.rcgu.o(".text.unlikely._ZN4core4cell22panic_already_borrowed17h18db994c1a6ebc37E")
    *libcore-673053c840437f62.rlib:core-673053c840437f62.core.e65e0c7e339ea620-cgu.0.rcgu.o(".text.unlikely._ZN4core4cell30panic_already_mutably_borrowed17h3f8a590091336958E")
    *libcore-673053c840437f62.rlib:core-673053c840437f62.core.e65e0c7e339ea620-cgu.0.rcgu.o(".text._ZN4core4char7methods22_$LT$impl$u20$char$GT$16escape_debug_ext17h8e39e5bdc678cbf9E")
    *libcore-673053c840437f62.rlib:core-673053c840437f62.core.e65e0c7e339ea620-cgu.0.rcgu.o(".text.unlikely._ZN4core6option13unwrap_failed17h2d9b86860954c5aeE")
    *libcore-673053c840437f62.rlib:core-673053c840437f62.core.e65e0c7e339ea620-cgu.0.rcgu.o(".text.unlikely._ZN4core6option13expect_failed17haf4db82eb2bf65ebE")
    *libcore-673053c840437f62.rlib:core-673053c840437f62.core.e65e0c7e339ea620-cgu.0.rcgu.o(".text._ZN73_$LT$core..panic..panic_info..PanicInfo$u20$as$u20$core..fmt..Display$GT$3fmt17h5134014163b2cd40E")
    *libcore-673053c840437f62.rlib:core-673053c840437f62.core.e65e0c7e339ea620-cgu.0.rcgu.o(".text.unlikely._ZN4core9panicking9panic_fmt17hd057c6f753903b3bE")
    *libcore-673053c840437f62.rlib:core-673053c840437f62.core.e65e0c7e339ea620-cgu.0.rcgu.o(".text.unlikely._ZN4core9panicking5panic17h9e86d515c1725fb5E")
    *libcore-673053c840437f62.rlib:core-673053c840437f62.core.e65e0c7e339ea620-cgu.0.rcgu.o(".text.unlikely._ZN4core9panicking18panic_bounds_check17hf0c02a9253951be5E")
    *libcore-673053c840437f62.rlib:core-673053c840437f62.core.e65e0c7e339ea620-cgu.0.rcgu.o(".text.unlikely._ZN4core9panicking13assert_failed17h15fff98d62cd7628E")
    *libcore-673053c840437f62.rlib:core-673053c840437f62.core.e65e0c7e339ea620-cgu.0.rcgu.o(".text.unlikely._ZN4core9panicking19assert_failed_inner17h020b8d57b0df004bE")
    *libcore-673053c840437f62.rlib:core-673053c840437f62.core.e65e0c7e339ea620-cgu.0.rcgu.o(".text.unlikely._ZN4core6result13unwrap_failed17h5a0595231043dbf9E")
    *libcore-673053c840437f62.rlib:core-673053c840437f62.core.e65e0c7e339ea620-cgu.0.rcgu.o(".text._ZN68_$LT$core..fmt..builders..PadAdapter$u20$as$u20$core..fmt..Write$GT$9write_str17h07b1cfaa048142fbE")
    *libcore-673053c840437f62.rlib:core-673053c840437f62.core.e65e0c7e339ea620-cgu.0.rcgu.o(".text._ZN68_$LT$core..fmt..builders..PadAdapter$u20$as$u20$core..fmt..Write$GT$10write_char17he754e8861ee9982cE")
    *libcore-673053c840437f62.rlib:core-673053c840437f62.core.e65e0c7e339ea620-cgu.0.rcgu.o(".text._ZN4core3fmt8builders11DebugStruct5field17h7c3cf5643de20b65E")
    *libcore-673053c840437f62.rlib:core-673053c840437f62.core.e65e0c7e339ea620-cgu.0.rcgu.o(".text._ZN4core3fmt8builders11DebugStruct6finish17h4efe41d9b850ea80E")
    *libcore-673053c840437f62.rlib:core-673053c840437f62.core.e65e0c7e339ea620-cgu.0.rcgu.o(".text._ZN4core3fmt8builders10DebugTuple5field17h07f284e029b65ac5E")
    *libcore-673053c840437f62.rlib:core-673053c840437f62.core.e65e0c7e339ea620-cgu.0.rcgu.o(".text._ZN4core3fmt8builders10DebugTuple6finish17h20638c02b3cc7b82E")
    *libcore-673053c840437f62.rlib:core-673053c840437f62.core.e65e0c7e339ea620-cgu.0.rcgu.o(".text._ZN4core3fmt5float29float_to_decimal_common_exact17h702a60b10e6e2974E")
    *libcore-673053c840437f62.rlib:core-673053c840437f62.core.e65e0c7e339ea620-cgu.0.rcgu.o(".text._ZN4core3fmt5float32float_to_decimal_common_shortest17hb76fe93a022f1aebE")
    *libcore-673053c840437f62.rlib:core-673053c840437f62.core.e65e0c7e339ea620-cgu.0.rcgu.o(".text._ZN4core3fmt5Write9write_fmt17h085a20d0e6cb78c5E")
    *libcore-673053c840437f62.rlib:core-673053c840437f62.core.e65e0c7e339ea620-cgu.0.rcgu.o(".text._ZN59_$LT$core..fmt..Arguments$u20$as$u20$core..fmt..Display$GT$3fmt17hdebd1bdeb4953795E")
    *libcore-673053c840437f62.rlib:core-673053c840437f62.core.e65e0c7e339ea620-cgu.0.rcgu.o(".text._ZN4core3fmt5write17h6598dd1fd9735818E")
    *libcore-673053c840437f62.rlib:core-673053c840437f62.core.e65e0c7e339ea620-cgu.0.rcgu.o(".text._ZN4core3fmt9Formatter12pad_integral17h5db7dcc7186aa7b9E")
    *libcore-673053c840437f62.rlib:core-673053c840437f62.core.e65e0c7e339ea620-cgu.0.rcgu.o(".text._ZN4core3fmt9Formatter12pad_integral12write_prefix17h8540d140f3ea9e8aE")
    *libcore-673053c840437f62.rlib:core-673053c840437f62.core.e65e0c7e339ea620-cgu.0.rcgu.o(".text._ZN4core3fmt9Formatter3pad17h9fe7d713aebd4bf2E")
    *libcore-673053c840437f62.rlib:core-673053c840437f62.core.e65e0c7e339ea620-cgu.0.rcgu.o(".text._ZN4core3fmt9Formatter19pad_formatted_parts17hf401ccf34eef044fE")
    *libcore-673053c840437f62.rlib:core-673053c840437f62.core.e65e0c7e339ea620-cgu.0.rcgu.o(".text._ZN4core3fmt9Formatter21write_formatted_parts17hc34111138dab5d7bE")
    *libcore-673053c840437f62.rlib:core-673053c840437f62.core.e65e0c7e339ea620-cgu.0.rcgu.o(".text._ZN4core3fmt9Formatter9write_str17h969f1c036f9c0313E")
    *libcore-673053c840437f62.rlib:core-673053c840437f62.core.e65e0c7e339ea620-cgu.0.rcgu.o(".text._ZN4core3fmt9Formatter12debug_struct17h3703beb303cfa4c5E")
    *libcore-673053c840437f62.rlib:core-673053c840437f62.core.e65e0c7e339ea620-cgu.0.rcgu.o(".text._ZN4core3fmt9Formatter26debug_struct_field2_finish17h115cad4bd41b5c4dE")
    *libcore-673053c840437f62.rlib:core-673053c840437f62.core.e65e0c7e339ea620-cgu.0.rcgu.o(".text._ZN4core3fmt9Formatter11debug_tuple17h92a3ad57be6ee082E")
    *libcore-673053c840437f62.rlib:core-673053c840437f62.core.e65e0c7e339ea620-cgu.0.rcgu.o(".text._ZN4core3fmt9Formatter25debug_tuple_field1_finish17ha04ac01d5860eb24E")
    *libcore-673053c840437f62.rlib:core-673053c840437f62.core.e65e0c7e339ea620-cgu.0.rcgu.o(".text._ZN57_$LT$core..fmt..Formatter$u20$as$u20$core..fmt..Write$GT$10write_char17h25131a20d68baf6cE")
    *libcore-673053c840437f62.rlib:core-673053c840437f62.core.e65e0c7e339ea620-cgu.0.rcgu.o(".text._ZN43_$LT$bool$u20$as$u20$core..fmt..Display$GT$3fmt17hbc032c825f49a520E")
    *libcore-673053c840437f62.rlib:core-673053c840437f62.core.e65e0c7e339ea620-cgu.0.rcgu.o(".text._ZN40_$LT$str$u20$as$u20$core..fmt..Debug$GT$3fmt17h90c958a145934ae7E")
    *libcore-673053c840437f62.rlib:core-673053c840437f62.core.e65e0c7e339ea620-cgu.0.rcgu.o(".text._ZN42_$LT$str$u20$as$u20$core..fmt..Display$GT$3fmt17haf5cf6b179ff776eE")
    *libcore-673053c840437f62.rlib:core-673053c840437f62.core.e65e0c7e339ea620-cgu.0.rcgu.o(".text._ZN41_$LT$char$u20$as$u20$core..fmt..Debug$GT$3fmt17h085a8c0784802dc0E")
    *libcore-673053c840437f62.rlib:core-673053c840437f62.core.e65e0c7e339ea620-cgu.0.rcgu.o(".text._ZN43_$LT$char$u20$as$u20$core..fmt..Display$GT$3fmt17ha188b172ece10cc3E")
    *libcore-673053c840437f62.rlib:core-673053c840437f62.core.e65e0c7e339ea620-cgu.0.rcgu.o(".text._ZN4core5slice6memchr14memchr_aligned17hd43cc19c072e4477E")
    *libcore-673053c840437f62.rlib:core-673053c840437f62.core.e65e0c7e339ea620-cgu.0.rcgu.o(".text._ZN4core5slice4sort6stable5drift11sqrt_approx17hd6ea17828ab8c3deE")
    *libcore-673053c840437f62.rlib:core-673053c840437f62.core.e65e0c7e339ea620-cgu.0.rcgu.o(".text.unlikely._ZN4core5slice4sort6shared9smallsort22panic_on_ord_violation17h9eab2a4c1fc39ffeE")
    *libcore-673053c840437f62.rlib:core-673053c840437f62.core.e65e0c7e339ea620-cgu.0.rcgu.o(".text.unlikely._ZN4core5slice5index26slice_start_index_len_fail17h67830a8602ab6cd3E")
    *libcore-673053c840437f62.rlib:core-673053c840437f62.core.e65e0c7e339ea620-cgu.0.rcgu.o(".text.unlikely._ZN4core5slice5index24slice_end_index_len_fail17h1f4e9e019b5e2314E")
    *libcore-673053c840437f62.rlib:core-673053c840437f62.core.e65e0c7e339ea620-cgu.0.rcgu.o(".text.unlikely._ZN4core5slice5index22slice_index_order_fail17h80817da18ae50333E")
    *libcore-673053c840437f62.rlib:core-673053c840437f62.core.e65e0c7e339ea620-cgu.0.rcgu.o(".text._ZN4core3str8converts9from_utf817h09de876fc3ce4fe7E")
    *libcore-673053c840437f62.rlib:core-673053c840437f62.core.e65e0c7e339ea620-cgu.0.rcgu.o(".text._ZN4core3str5count14do_count_chars17h5edf8ed4356233f2E")
    *libcore-673053c840437f62.rlib:core-673053c840437f62.core.e65e0c7e339ea620-cgu.0.rcgu.o(".text._ZN66_$LT$core..str..error..Utf8Error$u20$as$u20$core..fmt..Display$GT$3fmt17hbe882fb1c04f1fc8E")
    *libcore-673053c840437f62.rlib:core-673053c840437f62.core.e65e0c7e339ea620-cgu.0.rcgu.o(".text.unlikely._ZN4core3str16slice_error_fail17h758cfb41ee03f598E")
    *libcore-673053c840437f62.rlib:core-673053c840437f62.core.e65e0c7e339ea620-cgu.0.rcgu.o(".text._ZN4core3str19slice_error_fail_rt17hc7045508a0dabd71E")
    *libcore-673053c840437f62.rlib:core-673053c840437f62.core.e65e0c7e339ea620-cgu.0.rcgu.o(".text._ZN4core7unicode9printable5check17h23d5580a309014c9E")
    *libcore-673053c840437f62.rlib:core-673053c840437f62.core.e65e0c7e339ea620-cgu.0.rcgu.o(".text._ZN4core7unicode9printable12is_printable17h77c2525936026c86E")
    *libcore-673053c840437f62.rlib:core-673053c840437f62.core.e65e0c7e339ea620-cgu.0.rcgu.o(".text._ZN4core3num6bignum8Big32x408mul_pow217h428b86f8a9a6a8c0E")
    *libcore-673053c840437f62.rlib:core-673053c840437f62.core.e65e0c7e339ea620-cgu.0.rcgu.o(".text._ZN4core3num6bignum8Big32x4010mul_digits17heea58a77473ee613E")
    *libcore-673053c840437f62.rlib:core-673053c840437f62.core.e65e0c7e339ea620-cgu.0.rcgu.o(".text.unlikely._ZN4core9panicking11panic_const24panic_const_add_overflow17h3493e0c6194f31d7E")
    *libcore-673053c840437f62.rlib:core-673053c840437f62.core.e65e0c7e339ea620-cgu.0.rcgu.o(".text.unlikely._ZN4core9panicking11panic_const24panic_const_sub_overflow17h73105958df4c0d1cE")
    *libcore-673053c840437f62.rlib:core-673053c840437f62.core.e65e0c7e339ea620-cgu.0.rcgu.o(".text.unlikely._ZN4core9panicking11panic_const24panic_const_mul_overflow17h7c8001528ea4174dE")
    *libcore-673053c840437f62.rlib:core-673053c840437f62.core.e65e0c7e339ea620-cgu.0.rcgu.o(".text.unlikely._ZN4core9panicking11panic_const23panic_const_div_by_zero17h79d407179eb3033fE")
    *libcore-673053c840437f62.rlib:core-673053c840437f62.core.e65e0c7e339ea620-cgu.0.rcgu.o(".text._ZN4core3fmt5float52_$LT$impl$u20$core..fmt..Display$u20$for$u20$f64$GT$3fmt17h3a1ce7f5007f7523E")
    *libcore-673053c840437f62.rlib:core-673053c840437f62.core.e65e0c7e339ea620-cgu.0.rcgu.o(".text._ZN4core3fmt3num52_$LT$impl$u20$core..fmt..LowerHex$u20$for$u20$i8$GT$3fmt17haa6262e9f1b514dfE")
    *libcore-673053c840437f62.rlib:core-673053c840437f62.core.e65e0c7e339ea620-cgu.0.rcgu.o(".text._ZN4core3fmt3num52_$LT$impl$u20$core..fmt..UpperHex$u20$for$u20$i8$GT$3fmt17h865719d394404866E")
    *libcore-673053c840437f62.rlib:core-673053c840437f62.core.e65e0c7e339ea620-cgu.0.rcgu.o(".text._ZN4core3fmt3num53_$LT$impl$u20$core..fmt..LowerHex$u20$for$u20$i32$GT$3fmt17hd6b591b3de4bff16E")
    *libcore-673053c840437f62.rlib:core-673053c840437f62.core.e65e0c7e339ea620-cgu.0.rcgu.o(".text._ZN4core3fmt3num53_$LT$impl$u20$core..fmt..UpperHex$u20$for$u20$i32$GT$3fmt17h26f1f2b9a04d48abE")
    *libcore-673053c840437f62.rlib:core-673053c840437f62.core.e65e0c7e339ea620-cgu.0.rcgu.o(".text._ZN4core3fmt3num53_$LT$impl$u20$core..fmt..LowerHex$u20$for$u20$i64$GT$3fmt17h152865ae223db4b8E")
    *libcore-673053c840437f62.rlib:core-673053c840437f62.core.e65e0c7e339ea620-cgu.0.rcgu.o(".text._ZN4core3fmt3num53_$LT$impl$u20$core..fmt..UpperHex$u20$for$u20$i64$GT$3fmt17hbb1080c240f8d273E")
    *libcore-673053c840437f62.rlib:core-673053c840437f62.core.e65e0c7e339ea620-cgu.0.rcgu.o(".text._ZN4core3fmt3num50_$LT$impl$u20$core..fmt..Debug$u20$for$u20$u64$GT$3fmt17h958889f80703c2a4E")
    *libcore-673053c840437f62.rlib:core-673053c840437f62.core.e65e0c7e339ea620-cgu.0.rcgu.o(".text._ZN4core3fmt3num52_$LT$impl$u20$core..fmt..Debug$u20$for$u20$usize$GT$3fmt17hdb1e4730d25472aaE")
    *libcore-673053c840437f62.rlib:core-673053c840437f62.core.e65e0c7e339ea620-cgu.0.rcgu.o(".text._ZN4core3fmt3num3imp51_$LT$impl$u20$core..fmt..Display$u20$for$u20$u8$GT$3fmt17h54c5bebdfae9905eE")
    *libcore-673053c840437f62.rlib:core-673053c840437f62.core.e65e0c7e339ea620-cgu.0.rcgu.o(".text._ZN4core3fmt3num3imp52_$LT$impl$u20$core..fmt..Display$u20$for$u20$u32$GT$3fmt17h4914e23be7844e54E")
    *libcore-673053c840437f62.rlib:core-673053c840437f62.core.e65e0c7e339ea620-cgu.0.rcgu.o(".text._ZN4core3fmt3num3imp52_$LT$impl$u20$core..fmt..Display$u20$for$u20$i32$GT$3fmt17h6111f563f46b6dc2E")
    *libcore-673053c840437f62.rlib:core-673053c840437f62.core.e65e0c7e339ea620-cgu.0.rcgu.o(".text._ZN4core3fmt3num3imp21_$LT$impl$u20$u32$GT$4_fmt17h92f5710b9e1a67e8E")
    *libcore-673053c840437f62.rlib:core-673053c840437f62.core.e65e0c7e339ea620-cgu.0.rcgu.o(".text._ZN4core3fmt3num3imp52_$LT$impl$u20$core..fmt..Display$u20$for$u20$u64$GT$3fmt17hb4b04baeaa01359fE")
    *libcore-673053c840437f62.rlib:core-673053c840437f62.core.e65e0c7e339ea620-cgu.0.rcgu.o(".text._ZN4core3fmt3num3imp52_$LT$impl$u20$core..fmt..Display$u20$for$u20$i64$GT$3fmt17hd21774e8a2059b1eE")
    *libcore-673053c840437f62.rlib:core-673053c840437f62.core.e65e0c7e339ea620-cgu.0.rcgu.o(".text._ZN4core3fmt3num3imp21_$LT$impl$u20$u64$GT$4_fmt17h25fce7c7a9cb3ccfE")
    *libcore-673053c840437f62.rlib:core-673053c840437f62.core.e65e0c7e339ea620-cgu.0.rcgu.o(".text._ZN42_$LT$$RF$T$u20$as$u20$core..fmt..Debug$GT$3fmt17h0c058cd771a6cfd7E")
    *libcore-673053c840437f62.rlib:core-673053c840437f62.core.e65e0c7e339ea620-cgu.0.rcgu.o(".text._ZN42_$LT$$RF$T$u20$as$u20$core..fmt..Debug$GT$3fmt17hddcf66e8190420f6E")
    *libcore-673053c840437f62.rlib:core-673053c840437f62.core.e65e0c7e339ea620-cgu.0.rcgu.o(".text._ZN44_$LT$$RF$T$u20$as$u20$core..fmt..Display$GT$3fmt17hf98bacc17f6ab5f4E")
    *libcore-673053c840437f62.rlib:core-673053c840437f62.core.e65e0c7e339ea620-cgu.0.rcgu.o(".text.unlikely._ZN4core5slice5index26slice_start_index_len_fail8do_panic7runtime17hbfc67de29d3cd273E")
    *libcore-673053c840437f62.rlib:core-673053c840437f62.core.e65e0c7e339ea620-cgu.0.rcgu.o(".text.unlikely._ZN4core5slice5index24slice_end_index_len_fail8do_panic7runtime17h2c6c50df44ce9817E")
    *libcore-673053c840437f62.rlib:core-673053c840437f62.core.e65e0c7e339ea620-cgu.0.rcgu.o(".text.unlikely._ZN4core5slice5index22slice_index_order_fail8do_panic7runtime17hab9d550cdf90aa9cE")
    *libcore-673053c840437f62.rlib:core-673053c840437f62.core.e65e0c7e339ea620-cgu.0.rcgu.o(".text._ZN4core7unicode12unicode_data15grapheme_extend11lookup_slow17h3de7df68a4b16d65E")
    *libcompiler_builtins-3449fbafc948693e.rlib:compiler_builtins-3449fbafc948693e.compiler_builtins.6ccb59b2cefd2cdd-cgu.114.rcgu.o(".text.memcpy")
    *libcompiler_builtins-3449fbafc948693e.rlib:compiler_builtins-3449fbafc948693e.compiler_builtins.6ccb59b2cefd2cdd-cgu.114.rcgu.o(".text.memset")
    *libcompiler_builtins-3449fbafc948693e.rlib:compiler_builtins-3449fbafc948693e.compiler_builtins.6ccb59b2cefd2cdd-cgu.114.rcgu.o(".text.memcmp")
    *libcompiler_builtins-3449fbafc948693e.rlib:compiler_builtins-3449fbafc948693e.compiler_builtins.6ccb59b2cefd2cdd-cgu.148.rcgu.o(".text.__udivti3")
    *libcompiler_builtins-3449fbafc948693e.rlib:compiler_builtins-3449fbafc948693e.compiler_builtins.6ccb59b2cefd2cdd-cgu.012.rcgu.o(".text._ZN17compiler_builtins3int19specialized_div_rem12u128_div_rem17h79f8b203ef37c50bE")
    *libcompiler_builtins-3449fbafc948693e.rlib:compiler_builtins-3449fbafc948693e.compiler_builtins.6ccb59b2cefd2cdd-cgu.012.rcgu.o(".text._ZN17compiler_builtins3int19specialized_div_rem11u64_div_rem17hc3d6722c5dc09592E")
    *libcompiler_builtins-3449fbafc948693e.rlib:compiler_builtins-3449fbafc948693e.compiler_builtins.6ccb59b2cefd2cdd-cgu.153.rcgu.o(".text.__floatundidf")
    *libcompiler_builtins-3449fbafc948693e.rlib:compiler_builtins-3449fbafc948693e.compiler_builtins.6ccb59b2cefd2cdd-cgu.158.rcgu.o(".text.__gedf2")
    *libcompiler_builtins-3449fbafc948693e.rlib:compiler_builtins-3449fbafc948693e.compiler_builtins.6ccb59b2cefd2cdd-cgu.172.rcgu.o(".text.__muldf3")
    *libcompiler_builtins-3449fbafc948693e.rlib:compiler_builtins-3449fbafc948693e.compiler_builtins.6ccb59b2cefd2cdd-cgu.004.rcgu.o(".text._ZN17compiler_builtins5float3mul8__muldf317h541a3f2bd4b92bbdE")
    *libcompiler_builtins-3449fbafc948693e.rlib:compiler_builtins-3449fbafc948693e.compiler_builtins.6ccb59b2cefd2cdd-cgu.228.rcgu.o(".text.__fixunsdfdi")
    *libcompiler_builtins-3449fbafc948693e.rlib:compiler_builtins-3449fbafc948693e.compiler_builtins.6ccb59b2cefd2cdd-cgu.244.rcgu.o(".text.__ashlti3")
    *libcompiler_builtins-3449fbafc948693e.rlib:compiler_builtins-3449fbafc948693e.compiler_builtins.6ccb59b2cefd2cdd-cgu.269.rcgu.o(".text.__lshrti3")
    *libcompiler_builtins-3449fbafc948693e.rlib:compiler_builtins-3449fbafc948693e.compiler_builtins.6ccb59b2cefd2cdd-cgu.304.rcgu.o(".text.__multi3")
    *libcompiler_builtins-3449fbafc948693e.rlib:compiler_builtins-3449fbafc948693e.compiler_builtins.6ccb59b2cefd2cdd-cgu.315.rcgu.o(".text.__gtdf2")
    *libcompiler_builtins-3449fbafc948693e.rlib:compiler_builtins-3449fbafc948693e.compiler_builtins.6ccb59b2cefd2cdd-cgu.347.rcgu.o(".text.__divdi3")
    *(.text*)
  } :text
  .rodata : { *(.rodata*) } :rodata
  .data.rel.ro : { *(.data.rel.ro*) } :rodata
  .dynamic : { *(.dynamic) } :dynamic
  .dynsym : { *(.dynsym) } :data
  .dynstr : { *(.dynstr) } :data
  .rel.dyn : { *(.rel.dyn) } :data
  /DISCARD/ : {
      *(.eh_frame*)
      *(.gnu.hash*)
      *(.hash*)
    }
}
