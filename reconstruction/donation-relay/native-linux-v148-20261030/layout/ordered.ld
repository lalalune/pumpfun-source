
PHDRS
{
  text PT_LOAD ;
  rodata PT_LOAD ;
  data PT_LOAD ;
  dynamic PT_DYNAMIC ;
}

SECTIONS
{
  . = SIZEOF_HEADERS;
  .text : {
    *donation_relay_source_proposal.donation_relay_source_proposal.5235393d683737bf-cgu.0.rcgu.o(".text._ZN103_$LT$anchor_lang..accounts..interface..Interface$LT$T$GT$$u20$as$u20$anchor_lang..Accounts$LT$B$GT$$GT$12try_accounts17h00e2c5daec698150E")
    *donation_relay_source_proposal.donation_relay_source_proposal.5235393d683737bf-cgu.0.rcgu.o(".text._ZN118_$LT$anchor_lang..accounts..interface_account..InterfaceAccount$LT$T$GT$$u20$as$u20$anchor_lang..Accounts$LT$B$GT$$GT$12try_accounts17h0d48c879085c4d64E")
    *donation_relay_source_proposal.donation_relay_source_proposal.5235393d683737bf-cgu.0.rcgu.o(".text._ZN118_$LT$anchor_lang..accounts..interface_account..InterfaceAccount$LT$T$GT$$u20$as$u20$anchor_lang..Accounts$LT$B$GT$$GT$12try_accounts17h09e8a1b53b66c654E")
    *donation_relay_source_proposal.donation_relay_source_proposal.5235393d683737bf-cgu.0.rcgu.o(".text._ZN11anchor_lang5error5Error11with_values17h6f456e983780854dE")
    *donation_relay_source_proposal.donation_relay_source_proposal.5235393d683737bf-cgu.0.rcgu.o(".text._ZN11anchor_lang5error5Error11with_values17hd07d071deab4494dE")
    *donation_relay_source_proposal.donation_relay_source_proposal.5235393d683737bf-cgu.0.rcgu.o(".text._ZN11anchor_lang5error5Error17with_account_name17h3b58ec768e9b87daE")
    *donation_relay_source_proposal.donation_relay_source_proposal.5235393d683737bf-cgu.0.rcgu.o(".text._ZN11anchor_lang5error5Error17with_account_name17h4c29ea6cf75af645E")
    *donation_relay_source_proposal.donation_relay_source_proposal.5235393d683737bf-cgu.0.rcgu.o(".text._ZN11anchor_lang8accounts12account_info93_$LT$impl$u20$anchor_lang..Accounts$LT$B$GT$$u20$for$u20$solana_account_info..AccountInfo$GT$12try_accounts17h001839077b4e8c86E")
    *donation_relay_source_proposal.donation_relay_source_proposal.5235393d683737bf-cgu.0.rcgu.o(".text._ZN11anchor_lang8accounts17interface_account25InterfaceAccount$LT$T$GT$18try_from_unchecked17h8b8c07a8b71ea800E")
    *donation_relay_source_proposal.donation_relay_source_proposal.5235393d683737bf-cgu.0.rcgu.o(".text._ZN11anchor_lang8accounts17interface_account25InterfaceAccount$LT$T$GT$8try_from17h2bcfc0479ccd3835E")
    *donation_relay_source_proposal.donation_relay_source_proposal.5235393d683737bf-cgu.0.rcgu.o(".text._ZN11anchor_lang8accounts5boxed87_$LT$impl$u20$anchor_lang..Accounts$LT$B$GT$$u20$for$u20$alloc..boxed..Box$LT$T$GT$$GT$12try_accounts17h1ddeb0b0f005087fE")
    *donation_relay_source_proposal.donation_relay_source_proposal.5235393d683737bf-cgu.0.rcgu.o(".text._ZN11anchor_lang8accounts7account16Account$LT$T$GT$18try_from_unchecked17hb21560a4975da0a5E")
    *donation_relay_source_proposal.donation_relay_source_proposal.5235393d683737bf-cgu.0.rcgu.o(".text._ZN11anchor_lang8accounts7account16Account$LT$T$GT$18try_from_unchecked17h38104e75a663ceafE")
    *donation_relay_source_proposal.donation_relay_source_proposal.5235393d683737bf-cgu.0.rcgu.o(".text._ZN11anchor_lang8accounts7account16Account$LT$T$GT$18try_from_unchecked17h24ed1f85d875b0c9E")
    *donation_relay_source_proposal.donation_relay_source_proposal.5235393d683737bf-cgu.0.rcgu.o(".text._ZN11anchor_lang8accounts7account16Account$LT$T$GT$18try_from_unchecked17h4049864e0f5d549eE")
    *donation_relay_source_proposal.donation_relay_source_proposal.5235393d683737bf-cgu.0.rcgu.o(".text._ZN11anchor_lang8accounts7account16Account$LT$T$GT$18try_from_unchecked17h2e4315ea3a288627E")
    *donation_relay_source_proposal.donation_relay_source_proposal.5235393d683737bf-cgu.0.rcgu.o(".text._ZN11anchor_lang8accounts7account16Account$LT$T$GT$18try_from_unchecked17h7476e1954b95efcbE")
    *donation_relay_source_proposal.donation_relay_source_proposal.5235393d683737bf-cgu.0.rcgu.o(".text._ZN11anchor_lang8accounts7account16Account$LT$T$GT$24exit_with_expected_owner17h3e798b84b4806eccE")
    *donation_relay_source_proposal.donation_relay_source_proposal.5235393d683737bf-cgu.0.rcgu.o(".text._ZN11anchor_lang8accounts7account16Account$LT$T$GT$24exit_with_expected_owner17h4f182a1b56471a86E")
    *donation_relay_source_proposal.donation_relay_source_proposal.5235393d683737bf-cgu.0.rcgu.o(".text._ZN11anchor_lang8accounts7account16Account$LT$T$GT$24exit_with_expected_owner17h88b59049f898d692E")
    *donation_relay_source_proposal.donation_relay_source_proposal.5235393d683737bf-cgu.0.rcgu.o(".text._ZN11anchor_lang8accounts7account16Account$LT$T$GT$24exit_with_expected_owner17h580d7f8e3b578e90E")
    *donation_relay_source_proposal.donation_relay_source_proposal.5235393d683737bf-cgu.0.rcgu.o(".text._ZN11anchor_lang8accounts7account16Account$LT$T$GT$6reload17h8abbefb7db809697E")
    *donation_relay_source_proposal.donation_relay_source_proposal.5235393d683737bf-cgu.0.rcgu.o(".text._ZN11anchor_lang8accounts7account16Account$LT$T$GT$8try_from17hdd76f504e9dd71bcE")
    *donation_relay_source_proposal.donation_relay_source_proposal.5235393d683737bf-cgu.0.rcgu.o(".text._ZN11anchor_lang8accounts7account16Account$LT$T$GT$8try_from17h1936d8b8885d302cE")
    *donation_relay_source_proposal.donation_relay_source_proposal.5235393d683737bf-cgu.0.rcgu.o(".text._ZN11anchor_lang8accounts7account16Account$LT$T$GT$8try_from17h2b550cf115eea4baE")
    *donation_relay_source_proposal.donation_relay_source_proposal.5235393d683737bf-cgu.0.rcgu.o(".text._ZN11anchor_lang8accounts7account16Account$LT$T$GT$8try_from17h092ee480813b7e18E")
    *donation_relay_source_proposal.donation_relay_source_proposal.5235393d683737bf-cgu.0.rcgu.o(".text._ZN11anchor_lang8accounts7account16Account$LT$T$GT$8try_from17h00deae84f01580a8E")
    *donation_relay_source_proposal.donation_relay_source_proposal.5235393d683737bf-cgu.0.rcgu.o(".text._ZN11anchor_lang8accounts7account16Account$LT$T$GT$8try_from17h56d3941ed990d795E")
    *donation_relay_source_proposal.donation_relay_source_proposal.5235393d683737bf-cgu.0.rcgu.o(".text._ZN139_$LT$anchor_lang..accounts..interface..Interface$LT$T$GT$$u20$as$u20$core..convert..TryFrom$LT$$RF$solana_account_info..AccountInfo$GT$$GT$8try_from17h522c0dca142bd7feE")
    *donation_relay_source_proposal.donation_relay_source_proposal.5235393d683737bf-cgu.0.rcgu.o(".text._ZN14spl_token_20229extension13ExtensionType25try_calculate_account_len17h573615efcce4a67eE")
    *donation_relay_source_proposal.donation_relay_source_proposal.5235393d683737bf-cgu.0.rcgu.o(".text._ZN14spl_token_20229extension23BaseStateWithExtensions13get_extension17h18269f6c91e6e219E")
    *donation_relay_source_proposal.donation_relay_source_proposal.5235393d683737bf-cgu.0.rcgu.o(".text._ZN14spl_token_20229extension23BaseStateWithExtensions13get_extension17h4c6e0d1ea731df31E")
    *donation_relay_source_proposal.donation_relay_source_proposal.5235393d683737bf-cgu.0.rcgu.o(".text._ZN14spl_token_20229extension23BaseStateWithExtensions13get_extension17h36b95a1540b2a21bE")
    *donation_relay_source_proposal.donation_relay_source_proposal.5235393d683737bf-cgu.0.rcgu.o(".text._ZN14spl_token_20229extension28StateWithExtensions$LT$S$GT$6unpack17hf45546d804c8d8a8E")
    *donation_relay_source_proposal.donation_relay_source_proposal.5235393d683737bf-cgu.0.rcgu.o(".text._ZN3std2io5error5Error3new17hbaa44c8047d64b41E")
    *donation_relay_source_proposal.donation_relay_source_proposal.5235393d683737bf-cgu.0.rcgu.o(".text._ZN3std2io5error5Error3new17hf96ec37c640f184cE")
    *donation_relay_source_proposal.donation_relay_source_proposal.5235393d683737bf-cgu.0.rcgu.o(".text._ZN42_$LT$$RF$T$u20$as$u20$core..fmt..Debug$GT$3fmt17h11412dc55696c978E")
    *donation_relay_source_proposal.donation_relay_source_proposal.5235393d683737bf-cgu.0.rcgu.o(".text._ZN42_$LT$$RF$T$u20$as$u20$core..fmt..Debug$GT$3fmt17h6932e85bbfbbc283E")
    *donation_relay_source_proposal.donation_relay_source_proposal.5235393d683737bf-cgu.0.rcgu.o(".text._ZN42_$LT$$RF$T$u20$as$u20$core..fmt..Debug$GT$3fmt17h75beddcadcb0d66aE")
    *donation_relay_source_proposal.donation_relay_source_proposal.5235393d683737bf-cgu.0.rcgu.o(".text._ZN44_$LT$$RF$T$u20$as$u20$core..fmt..Display$GT$3fmt17he225d4210cdeec45E")
    *donation_relay_source_proposal.donation_relay_source_proposal.5235393d683737bf-cgu.0.rcgu.o(".text._ZN48_$LT$T$u20$as$u20$anchor_lang..ToAccountInfo$GT$15to_account_info17h2d6a3bca07652f06E")
    *donation_relay_source_proposal.donation_relay_source_proposal.5235393d683737bf-cgu.0.rcgu.o(".text._ZN4core3fmt3num49_$LT$impl$u20$core..fmt..Debug$u20$for$u20$u8$GT$3fmt17h2bc5b81c504e2f50E")
    *donation_relay_source_proposal.donation_relay_source_proposal.5235393d683737bf-cgu.0.rcgu.o(".text._ZN4core3fmt5Write9write_fmt17h485b8aaeaa561e42E")
    *donation_relay_source_proposal.donation_relay_source_proposal.5235393d683737bf-cgu.0.rcgu.o(".text._ZN4core3ptr118drop_in_place$LT$donation_relay_source_proposal..instructions..v1..relayer_only..distribute..just_swap..JustSwapV1$GT$17he2901e987d97a56dE")
    *donation_relay_source_proposal.donation_relay_source_proposal.5235393d683737bf-cgu.0.rcgu.o(".text._ZN4core3ptr139drop_in_place$LT$donation_relay_source_proposal..instructions..v1..relayer_only..distribute..swap_then_distribute..SwapThenDistributeV1$GT$17h2c599452b8350562E")
    *donation_relay_source_proposal.donation_relay_source_proposal.5235393d683737bf-cgu.0.rcgu.o(".text._ZN4core3ptr238drop_in_place$LT$alloc..boxed..convert..$LT$impl$u20$core..convert..From$LT$alloc..string..String$GT$$u20$for$u20$alloc..boxed..Box$LT$dyn$u20$core..error..Error$u2b$core..marker..Sync$u2b$core..marker..Send$GT$$GT$..from..StringError$GT$17hb2644f44a608cf17E")
    *donation_relay_source_proposal.donation_relay_source_proposal.5235393d683737bf-cgu.0.rcgu.o(".text._ZN4core3ptr42drop_in_place$LT$alloc..string..String$GT$17h5f9345e35382a8ddE")
    *donation_relay_source_proposal.donation_relay_source_proposal.5235393d683737bf-cgu.0.rcgu.o(".text._ZN4core3ptr42drop_in_place$LT$std..io..error..Error$GT$17h9196b5705cae1f84E")
    *donation_relay_source_proposal.donation_relay_source_proposal.5235393d683737bf-cgu.0.rcgu.o(".text._ZN4core3ptr53drop_in_place$LT$solana_account_info..AccountInfo$GT$17hbd2279afbbf4be37E")
    *donation_relay_source_proposal.donation_relay_source_proposal.5235393d683737bf-cgu.0.rcgu.o(".text._ZN4core3ptr55drop_in_place$LT$solana_program_error..ProgramError$GT$17hd96058a1380fde84E")
    *donation_relay_source_proposal.donation_relay_source_proposal.5235393d683737bf-cgu.0.rcgu.o(".text._ZN4core3ptr74drop_in_place$LT$$u5b$solana_account_info..AccountInfo$u3b$$u20$4$u5d$$GT$17hb8fc04f4d420a199E")
    *donation_relay_source_proposal.donation_relay_source_proposal.5235393d683737bf-cgu.0.rcgu.o(".text._ZN4core3ptr91drop_in_place$LT$donation_relay_source_proposal..tools..donate..shared..DonationContext$GT$17he2309198ca0c8ee4E")
    *donation_relay_source_proposal.donation_relay_source_proposal.5235393d683737bf-cgu.0.rcgu.o(".text._ZN4core3ptr90drop_in_place$LT$alloc..collections..btree..set..BTreeSet$LT$solana_pubkey..Pubkey$GT$$GT$17h170b2c037d5f074bE")
    *donation_relay_source_proposal.donation_relay_source_proposal.5235393d683737bf-cgu.0.rcgu.o(".text._ZN4core3ptr98drop_in_place$LT$anchor_lang..context..CpiContext$LT$anchor_lang..system_program..Allocate$GT$$GT$17ha423bbcb65f7446eE")
    *donation_relay_source_proposal.donation_relay_source_proposal.5235393d683737bf-cgu.0.rcgu.o(".text._ZN4core5error5Error5cause17ha0a757a92591ee49E")
    *donation_relay_source_proposal.donation_relay_source_proposal.5235393d683737bf-cgu.0.rcgu.o(".text._ZN4core5error5Error7provide17h35c2e05e7682ecc1E")
    *donation_relay_source_proposal.donation_relay_source_proposal.5235393d683737bf-cgu.0.rcgu.o(".text._ZN4core5error5Error7type_id17he2f789b23e5a5633E")
    *donation_relay_source_proposal.donation_relay_source_proposal.5235393d683737bf-cgu.0.rcgu.o(".text._ZN4core5slice4sort6shared5pivot11median3_rec17hd7b6f76162961645E")
    *donation_relay_source_proposal.donation_relay_source_proposal.5235393d683737bf-cgu.0.rcgu.o(".text._ZN4core5slice4sort6shared9smallsort25insertion_sort_shift_left17h27d040f9ed89ebedE")
    *donation_relay_source_proposal.donation_relay_source_proposal.5235393d683737bf-cgu.0.rcgu.o(".text._ZN4core5slice4sort6stable14driftsort_main17h734e730ebc839da7E")
    *donation_relay_source_proposal.donation_relay_source_proposal.5235393d683737bf-cgu.0.rcgu.o(".text._ZN4core5slice4sort6stable5drift4sort17hd68fd8e9e3625e17E")
    *donation_relay_source_proposal.donation_relay_source_proposal.5235393d683737bf-cgu.0.rcgu.o(".text._ZN4core5slice4sort6stable9quicksort9quicksort17he8a905580439eb26E")
    *donation_relay_source_proposal.donation_relay_source_proposal.5235393d683737bf-cgu.0.rcgu.o(".text._ZN53_$LT$core..fmt..Error$u20$as$u20$core..fmt..Debug$GT$3fmt17hde1f1ab10afbbf92E")
    *donation_relay_source_proposal.donation_relay_source_proposal.5235393d683737bf-cgu.0.rcgu.o(".text._ZN58_$LT$alloc..string..String$u20$as$u20$core..fmt..Write$GT$10write_char17hbf1d9fc611d850b0E")
    *donation_relay_source_proposal.donation_relay_source_proposal.5235393d683737bf-cgu.0.rcgu.o(".text._ZN58_$LT$alloc..string..String$u20$as$u20$core..fmt..Write$GT$9write_str17h5448a1b581b20374E")
    *donation_relay_source_proposal.donation_relay_source_proposal.5235393d683737bf-cgu.0.rcgu.o(".text._ZN5alloc2rc15Rc$LT$T$C$A$GT$9drop_slow17hc91a4fd2112ce51dE")
    *donation_relay_source_proposal.donation_relay_source_proposal.5235393d683737bf-cgu.0.rcgu.o(".text._ZN5alloc7raw_vec11finish_grow17h66cfb5fca2858e1eE")
    *donation_relay_source_proposal.donation_relay_source_proposal.5235393d683737bf-cgu.0.rcgu.o(".text._ZN5alloc7raw_vec19RawVec$LT$T$C$A$GT$8grow_one17h69dd453ac1cdbfe8E")
    *donation_relay_source_proposal.donation_relay_source_proposal.5235393d683737bf-cgu.0.rcgu.o(".text._ZN5alloc7raw_vec19RawVec$LT$T$C$A$GT$8grow_one17h631075750d99ef8eE")
    *donation_relay_source_proposal.donation_relay_source_proposal.5235393d683737bf-cgu.0.rcgu.o(".text._ZN5alloc7raw_vec19RawVec$LT$T$C$A$GT$8grow_one17h06f82fb1e213650dE")
    *donation_relay_source_proposal.donation_relay_source_proposal.5235393d683737bf-cgu.0.rcgu.o(".text._ZN5alloc7raw_vec19RawVec$LT$T$C$A$GT$8grow_one17h3550edb55b432fd0E")
    *donation_relay_source_proposal.donation_relay_source_proposal.5235393d683737bf-cgu.0.rcgu.o(".text._ZN5alloc7raw_vec19RawVec$LT$T$C$A$GT$8grow_one17h72242fd291adce7eE")
    *donation_relay_source_proposal.donation_relay_source_proposal.5235393d683737bf-cgu.0.rcgu.o(".text.unlikely._ZN5alloc7raw_vec20RawVecInner$LT$A$GT$7reserve21do_reserve_and_handle17h46d9ef10cd5c3589E")
    *donation_relay_source_proposal.donation_relay_source_proposal.5235393d683737bf-cgu.0.rcgu.o(".text._ZN63_$LT$solana_pubkey..PubkeyError$u20$as$u20$core..fmt..Debug$GT$3fmt17h8538990327b4535aE")
    *donation_relay_source_proposal.donation_relay_source_proposal.5235393d683737bf-cgu.0.rcgu.o(".text._ZN69_$LT$alloc..string..String$u20$as$u20$borsh..de..BorshDeserialize$GT$18deserialize_reader17h82cc4b8fd08b8494E")
    *donation_relay_source_proposal.donation_relay_source_proposal.5235393d683737bf-cgu.0.rcgu.o(".text._ZN70_$LT$core..num..error..TryFromIntError$u20$as$u20$core..fmt..Debug$GT$3fmt17h6e1599ea2c69665fE")
    *donation_relay_source_proposal.donation_relay_source_proposal.5235393d683737bf-cgu.0.rcgu.o(".text._ZN71_$LT$solana_program_error..ProgramError$u20$as$u20$core..fmt..Debug$GT$3fmt17h6aeb965aaa1f17daE")
    *donation_relay_source_proposal.donation_relay_source_proposal.5235393d683737bf-cgu.0.rcgu.o(".text._ZN72_$LT$alloc..vec..Vec$LT$T$GT$$u20$as$u20$borsh..de..BorshDeserialize$GT$18deserialize_reader17h4ec4280c7a36cebeE")
    *donation_relay_source_proposal.donation_relay_source_proposal.5235393d683737bf-cgu.0.rcgu.o(".text._ZN72_$LT$alloc..vec..Vec$LT$T$GT$$u20$as$u20$borsh..de..BorshDeserialize$GT$18deserialize_reader17h5a951054af5008b3E")
    *donation_relay_source_proposal.donation_relay_source_proposal.5235393d683737bf-cgu.0.rcgu.o(".text._ZN72_$LT$alloc..vec..Vec$LT$T$GT$$u20$as$u20$borsh..de..BorshDeserialize$GT$18deserialize_reader17h5cef854e9a7a4a29E")
    *donation_relay_source_proposal.donation_relay_source_proposal.5235393d683737bf-cgu.0.rcgu.o(".text._ZN88_$LT$anchor_lang..accounts..signer..Signer$u20$as$u20$anchor_lang..Accounts$LT$B$GT$$GT$12try_accounts17h017c90c0d8f79935E")
    *donation_relay_source_proposal.donation_relay_source_proposal.5235393d683737bf-cgu.0.rcgu.o(".text._ZN98_$LT$alloc..vec..Vec$LT$T$GT$$u20$as$u20$alloc..vec..spec_from_iter..SpecFromIter$LT$T$C$I$GT$$GT$9from_iter17h3ec071226d1b3272E")
    *donation_relay_source_proposal.donation_relay_source_proposal.5235393d683737bf-cgu.0.rcgu.o(".text._ZN99_$LT$anchor_lang..accounts..account..Account$LT$T$GT$$u20$as$u20$anchor_lang..Accounts$LT$B$GT$$GT$12try_accounts17h3f929f3ca71c86b8E")
    *donation_relay_source_proposal.donation_relay_source_proposal.5235393d683737bf-cgu.0.rcgu.o(".text._ZN99_$LT$anchor_lang..accounts..account..Account$LT$T$GT$$u20$as$u20$anchor_lang..Accounts$LT$B$GT$$GT$12try_accounts17h49c7a1d6a60fac25E")
    *donation_relay_source_proposal.donation_relay_source_proposal.5235393d683737bf-cgu.0.rcgu.o(".text._ZN99_$LT$anchor_lang..accounts..account..Account$LT$T$GT$$u20$as$u20$anchor_lang..Accounts$LT$B$GT$$GT$12try_accounts17h300b9f7e31703bafE")
    *donation_relay_source_proposal.donation_relay_source_proposal.5235393d683737bf-cgu.0.rcgu.o(".text._ZN99_$LT$anchor_lang..accounts..account..Account$LT$T$GT$$u20$as$u20$anchor_lang..Accounts$LT$B$GT$$GT$12try_accounts17h10eccbabe9e73d64E")
    *donation_relay_source_proposal.donation_relay_source_proposal.5235393d683737bf-cgu.0.rcgu.o(".text._ZN99_$LT$anchor_lang..accounts..account..Account$LT$T$GT$$u20$as$u20$anchor_lang..Accounts$LT$B$GT$$GT$12try_accounts17h44f8afd4a1f65580E")
    *donation_relay_source_proposal.donation_relay_source_proposal.5235393d683737bf-cgu.0.rcgu.o(".text._ZN99_$LT$anchor_lang..accounts..account..Account$LT$T$GT$$u20$as$u20$anchor_lang..Accounts$LT$B$GT$$GT$12try_accounts17h08d95fc335b92f8cE")
    *donation_relay_source_proposal.donation_relay_source_proposal.5235393d683737bf-cgu.0.rcgu.o(".text._ZN99_$LT$anchor_lang..accounts..program..Program$LT$T$GT$$u20$as$u20$anchor_lang..Accounts$LT$B$GT$$GT$12try_accounts17h4b7528f5f4ba36a5E")
    *donation_relay_source_proposal.donation_relay_source_proposal.5235393d683737bf-cgu.0.rcgu.o(".text._ZN99_$LT$anchor_lang..accounts..program..Program$LT$T$GT$$u20$as$u20$anchor_lang..Accounts$LT$B$GT$$GT$12try_accounts17h27bb83e9b88a47f6E")
    *donation_relay_source_proposal.donation_relay_source_proposal.5235393d683737bf-cgu.0.rcgu.o(".text._ZN30donation_relay_source_proposal3cpi7jupiter14invoke_jupiter17h64997f5c22e6ebedE")
    *donation_relay_source_proposal.donation_relay_source_proposal.5235393d683737bf-cgu.0.rcgu.o(".text._ZN30donation_relay_source_proposal3cpi7jupiter13swap_observed17hef0060861334b39eE")
    *donation_relay_source_proposal.donation_relay_source_proposal.5235393d683737bf-cgu.0.rcgu.o(".text._ZN30donation_relay_source_proposal17donation_handlers24donate_native_v1_handler17h73743a6744efe460E")
    *donation_relay_source_proposal.donation_relay_source_proposal.5235393d683737bf-cgu.0.rcgu.o(".text._ZN30donation_relay_source_proposal17donation_handlers41donate_native_pubkey_config_id_v1_handler17h62246cfd9185848fE")
    *donation_relay_source_proposal.donation_relay_source_proposal.5235393d683737bf-cgu.0.rcgu.o(".text._ZN30donation_relay_source_proposal17donation_handlers17donate_v1_handler17h92c65cb6044ed7c1E")
    *donation_relay_source_proposal.donation_relay_source_proposal.5235393d683737bf-cgu.0.rcgu.o(".text._ZN30donation_relay_source_proposal17donation_handlers45donate_pubkey_config_id_with_payer_v1_handler17h9cb196e9d767f66fE")
    *donation_relay_source_proposal.donation_relay_source_proposal.5235393d683737bf-cgu.0.rcgu.o(".text._ZN30donation_relay_source_proposal19settlement_handlers11close_epoch17h7f50ab78aa079402E")
    *donation_relay_source_proposal.donation_relay_source_proposal.5235393d683737bf-cgu.0.rcgu.o(".text._ZN30donation_relay_source_proposal19settlement_handlers16distribute_after17hae122c95af0335ccE")
    *donation_relay_source_proposal.donation_relay_source_proposal.5235393d683737bf-cgu.0.rcgu.o(".text._ZN30donation_relay_source_proposal19settlement_handlers19distribute_non_swap17hf7812c2daaeca719E")
    *donation_relay_source_proposal.donation_relay_source_proposal.5235393d683737bf-cgu.0.rcgu.o(".text._ZN30donation_relay_source_proposal19settlement_handlers9just_swap17h76119d6cc0de96aeE")
    *donation_relay_source_proposal.donation_relay_source_proposal.5235393d683737bf-cgu.0.rcgu.o(".text._ZN30donation_relay_source_proposal19settlement_handlers20swap_then_distribute17hacf0c2003fa86c45E")
    *donation_relay_source_proposal.donation_relay_source_proposal.5235393d683737bf-cgu.0.rcgu.o(".text._ZN30donation_relay_source_proposal12instructions2v112relayer_only21upsert_mint_whitelist16upsert_whitelist17h2e0433e4493af13fE")
    *donation_relay_source_proposal.donation_relay_source_proposal.5235393d683737bf-cgu.0.rcgu.o(".text._ZN30donation_relay_source_proposal5tools6checks24native_program_supported17h4cc308dbb264b5e8E")
    *donation_relay_source_proposal.donation_relay_source_proposal.5235393d683737bf-cgu.0.rcgu.o(".text._ZN30donation_relay_source_proposal5tools6checks16native_mint_pair17h2d2e084cb184c1e2E")
    *donation_relay_source_proposal.donation_relay_source_proposal.5235393d683737bf-cgu.0.rcgu.o(".text._ZN30donation_relay_source_proposal5tools6checks13check_message17hf581ceaa526ae3bbE")
    *donation_relay_source_proposal.donation_relay_source_proposal.5235393d683737bf-cgu.0.rcgu.o(".text._ZN30donation_relay_source_proposal5tools6checks13check_relayer17h48c1954d664c5fd6E")
    *donation_relay_source_proposal.donation_relay_source_proposal.5235393d683737bf-cgu.0.rcgu.o(".text._ZN30donation_relay_source_proposal5tools6checks15typed_mint_safe17h9182e90f52125ff1E")
    *donation_relay_source_proposal.donation_relay_source_proposal.5235393d683737bf-cgu.0.rcgu.o(".text._ZN30donation_relay_source_proposal5tools6checks9check_bps17ha1eff23ce80da7e4E")
    *donation_relay_source_proposal.donation_relay_source_proposal.5235393d683737bf-cgu.0.rcgu.o(".text._ZN30donation_relay_source_proposal5tools12distribution6shared10distribute17hd300685ae46489e6E")
    *donation_relay_source_proposal.donation_relay_source_proposal.5235393d683737bf-cgu.0.rcgu.o(".text._ZN30donation_relay_source_proposal5tools12distribution6shared14burn_and_close17h182f9dbcabaa6225E")
    *donation_relay_source_proposal.donation_relay_source_proposal.5235393d683737bf-cgu.0.rcgu.o(".text._ZN30donation_relay_source_proposal5tools6donate6shared25deserialize_token_account17h6d333adc03d929b2E")
    *donation_relay_source_proposal.donation_relay_source_proposal.5235393d683737bf-cgu.0.rcgu.o(".text._ZN30donation_relay_source_proposal5tools6donate6shared16deserialize_mint17h9a500b6890a46455E")
    *donation_relay_source_proposal.donation_relay_source_proposal.5235393d683737bf-cgu.0.rcgu.o(".text._ZN30donation_relay_source_proposal5tools6donate6shared13donate_shared17h78e01572e48ccc82E")
    *donation_relay_source_proposal.donation_relay_source_proposal.5235393d683737bf-cgu.0.rcgu.o(".text._ZN30donation_relay_source_proposal5tools17fair_distribution12fair_amounts17hd926c4aeb3e4c368E")
    *donation_relay_source_proposal.donation_relay_source_proposal.5235393d683737bf-cgu.0.rcgu.o(".text._ZN30donation_relay_source_proposal20business_error_codes9ErrorCode4name17hcef47ac6bf69e137E")
    *donation_relay_source_proposal.donation_relay_source_proposal.5235393d683737bf-cgu.0.rcgu.o(".text._ZN30donation_relay_source_proposal20business_error_codes146_$LT$impl$u20$core..convert..From$LT$donation_relay_source_proposal..business_error_codes..ErrorCode$GT$$u20$for$u20$anchor_lang..error..Error$GT$4from17h7c165f50ab217935E")
    *donation_relay_source_proposal.donation_relay_source_proposal.5235393d683737bf-cgu.0.rcgu.o(".text._ZN102_$LT$donation_relay_source_proposal..business_error_codes..ErrorCode$u20$as$u20$core..fmt..Display$GT$3fmt17hc8d2143ce2174c12E")
    *donation_relay_source_proposal.donation_relay_source_proposal.5235393d683737bf-cgu.0.rcgu.o(".text._ZN140_$LT$donation_relay_source_proposal..events..v1..donation_epoch_closed..DonationEpochClosedV1Event$u20$as$u20$borsh..ser..BorshSerialize$GT$9serialize17hdc6b4feb2b12b698E")
    *donation_relay_source_proposal.donation_relay_source_proposal.5235393d683737bf-cgu.0.rcgu.o(".text._ZN151_$LT$donation_relay_source_proposal..events..v1..donation_epoch_just_swapped..DonationEpochJustSwappedV1Event$u20$as$u20$borsh..ser..BorshSerialize$GT$9serialize17h486720b291cbb0a1E")
    *donation_relay_source_proposal.donation_relay_source_proposal.5235393d683737bf-cgu.0.rcgu.o(".text._ZN146_$LT$donation_relay_source_proposal..events..v1..donation_epoch_processed..DonationEpochProcessedV1Event$u20$as$u20$borsh..ser..BorshSerialize$GT$9serialize17h7c252d3f964c2c24E")
    *donation_relay_source_proposal.donation_relay_source_proposal.5235393d683737bf-cgu.0.rcgu.o(".text._ZN125_$LT$donation_relay_source_proposal..events..v1..donation_made..DonationMadeV1Event$u20$as$u20$borsh..ser..BorshSerialize$GT$9serialize17h90d754bc1e73d1b7E")
    *donation_relay_source_proposal.donation_relay_source_proposal.5235393d683737bf-cgu.0.rcgu.o(".text._ZN227_$LT$donation_relay_source_proposal..instructions..v1..public_api..donate..donate..DonateV1$u20$as$u20$anchor_lang..Accounts$LT$donation_relay_source_proposal..instructions..v1..public_api..donate..donate..DonateV1Bumps$GT$$GT$12try_accounts17hc44a02ac6bfb80b4E")
    *donation_relay_source_proposal.donation_relay_source_proposal.5235393d683737bf-cgu.0.rcgu.o(".text._ZN227_$LT$donation_relay_source_proposal..instructions..v1..public_api..donate..donate..DonateV1$u20$as$u20$anchor_lang..Accounts$LT$donation_relay_source_proposal..instructions..v1..public_api..donate..donate..DonateV1Bumps$GT$$GT$12try_accounts28_$u7b$$u7b$closure$u7d$$u7d$17h7752d2d939a35393E")
    *donation_relay_source_proposal.donation_relay_source_proposal.5235393d683737bf-cgu.0.rcgu.o(".text._ZN227_$LT$donation_relay_source_proposal..instructions..v1..public_api..donate..donate..DonateV1$u20$as$u20$anchor_lang..Accounts$LT$donation_relay_source_proposal..instructions..v1..public_api..donate..donate..DonateV1Bumps$GT$$GT$12try_accounts28_$u7b$$u7b$closure$u7d$$u7d$17h45e3b54e1c6d1682E")
    *donation_relay_source_proposal.donation_relay_source_proposal.5235393d683737bf-cgu.0.rcgu.o(".text._ZN227_$LT$donation_relay_source_proposal..instructions..v1..public_api..donate..donate..DonateV1$u20$as$u20$anchor_lang..Accounts$LT$donation_relay_source_proposal..instructions..v1..public_api..donate..donate..DonateV1Bumps$GT$$GT$12try_accounts28_$u7b$$u7b$closure$u7d$$u7d$17h6828d9397654e3bfE")
    *donation_relay_source_proposal.donation_relay_source_proposal.5235393d683737bf-cgu.0.rcgu.o(".text._ZN132_$LT$donation_relay_source_proposal..instructions..v1..public_api..donate..donate..DonateV1$u20$as$u20$anchor_lang..AccountsExit$GT$4exit17hca5de98c6b1fc5daE")
    *donation_relay_source_proposal.donation_relay_source_proposal.5235393d683737bf-cgu.0.rcgu.o(".text._ZN253_$LT$donation_relay_source_proposal..instructions..v1..public_api..donate..donate_native..DonateNativeV1$u20$as$u20$anchor_lang..Accounts$LT$donation_relay_source_proposal..instructions..v1..public_api..donate..donate_native..DonateNativeV1Bumps$GT$$GT$12try_accounts17heff43721ad936db8E")
    *donation_relay_source_proposal.donation_relay_source_proposal.5235393d683737bf-cgu.0.rcgu.o(".text._ZN253_$LT$donation_relay_source_proposal..instructions..v1..public_api..donate..donate_native..DonateNativeV1$u20$as$u20$anchor_lang..Accounts$LT$donation_relay_source_proposal..instructions..v1..public_api..donate..donate_native..DonateNativeV1Bumps$GT$$GT$12try_accounts28_$u7b$$u7b$closure$u7d$$u7d$17h39dd0df2d3232b0dE")
    *donation_relay_source_proposal.donation_relay_source_proposal.5235393d683737bf-cgu.0.rcgu.o(".text._ZN253_$LT$donation_relay_source_proposal..instructions..v1..public_api..donate..donate_native..DonateNativeV1$u20$as$u20$anchor_lang..Accounts$LT$donation_relay_source_proposal..instructions..v1..public_api..donate..donate_native..DonateNativeV1Bumps$GT$$GT$12try_accounts28_$u7b$$u7b$closure$u7d$$u7d$17hff1fbf787418b129E")
    *donation_relay_source_proposal.donation_relay_source_proposal.5235393d683737bf-cgu.0.rcgu.o(".text._ZN253_$LT$donation_relay_source_proposal..instructions..v1..public_api..donate..donate_native..DonateNativeV1$u20$as$u20$anchor_lang..Accounts$LT$donation_relay_source_proposal..instructions..v1..public_api..donate..donate_native..DonateNativeV1Bumps$GT$$GT$12try_accounts28_$u7b$$u7b$closure$u7d$$u7d$17ha8f0a5a7fcd499e9E")
    *donation_relay_source_proposal.donation_relay_source_proposal.5235393d683737bf-cgu.0.rcgu.o(".text._ZN145_$LT$donation_relay_source_proposal..instructions..v1..public_api..donate..donate_native..DonateNativeV1$u20$as$u20$anchor_lang..AccountsExit$GT$4exit17h2c947d4769983420E")
    *donation_relay_source_proposal.donation_relay_source_proposal.5235393d683737bf-cgu.0.rcgu.o(".text._ZN315_$LT$donation_relay_source_proposal..instructions..v1..public_api..donate..donate_native_pubkey_config_id..DonateNativePubkeyConfigIdV1$u20$as$u20$anchor_lang..Accounts$LT$donation_relay_source_proposal..instructions..v1..public_api..donate..donate_native_pubkey_config_id..DonateNativePubkeyConfigIdV1Bumps$GT$$GT$12try_accounts17hc4b3e2748dca01a3E")
    *donation_relay_source_proposal.donation_relay_source_proposal.5235393d683737bf-cgu.0.rcgu.o(".text._ZN315_$LT$donation_relay_source_proposal..instructions..v1..public_api..donate..donate_native_pubkey_config_id..DonateNativePubkeyConfigIdV1$u20$as$u20$anchor_lang..Accounts$LT$donation_relay_source_proposal..instructions..v1..public_api..donate..donate_native_pubkey_config_id..DonateNativePubkeyConfigIdV1Bumps$GT$$GT$12try_accounts28_$u7b$$u7b$closure$u7d$$u7d$17hd4f34290f4606f8dE")
    *donation_relay_source_proposal.donation_relay_source_proposal.5235393d683737bf-cgu.0.rcgu.o(".text._ZN315_$LT$donation_relay_source_proposal..instructions..v1..public_api..donate..donate_native_pubkey_config_id..DonateNativePubkeyConfigIdV1$u20$as$u20$anchor_lang..Accounts$LT$donation_relay_source_proposal..instructions..v1..public_api..donate..donate_native_pubkey_config_id..DonateNativePubkeyConfigIdV1Bumps$GT$$GT$12try_accounts28_$u7b$$u7b$closure$u7d$$u7d$17heff3c1c635ed0408E")
    *donation_relay_source_proposal.donation_relay_source_proposal.5235393d683737bf-cgu.0.rcgu.o(".text._ZN315_$LT$donation_relay_source_proposal..instructions..v1..public_api..donate..donate_native_pubkey_config_id..DonateNativePubkeyConfigIdV1$u20$as$u20$anchor_lang..Accounts$LT$donation_relay_source_proposal..instructions..v1..public_api..donate..donate_native_pubkey_config_id..DonateNativePubkeyConfigIdV1Bumps$GT$$GT$12try_accounts28_$u7b$$u7b$closure$u7d$$u7d$17h419a86d7401e0082E")
    *donation_relay_source_proposal.donation_relay_source_proposal.5235393d683737bf-cgu.0.rcgu.o(".text._ZN289_$LT$donation_relay_source_proposal..instructions..v1..public_api..donate..donate_pubkey_config_id..DonatePubkeyConfigIdV1$u20$as$u20$anchor_lang..Accounts$LT$donation_relay_source_proposal..instructions..v1..public_api..donate..donate_pubkey_config_id..DonatePubkeyConfigIdV1Bumps$GT$$GT$12try_accounts17ha93f17c247ffd10eE")
    *donation_relay_source_proposal.donation_relay_source_proposal.5235393d683737bf-cgu.0.rcgu.o(".text._ZN289_$LT$donation_relay_source_proposal..instructions..v1..public_api..donate..donate_pubkey_config_id..DonatePubkeyConfigIdV1$u20$as$u20$anchor_lang..Accounts$LT$donation_relay_source_proposal..instructions..v1..public_api..donate..donate_pubkey_config_id..DonatePubkeyConfigIdV1Bumps$GT$$GT$12try_accounts28_$u7b$$u7b$closure$u7d$$u7d$17h47c026e34171ca98E")
    *donation_relay_source_proposal.donation_relay_source_proposal.5235393d683737bf-cgu.0.rcgu.o(".text._ZN289_$LT$donation_relay_source_proposal..instructions..v1..public_api..donate..donate_pubkey_config_id..DonatePubkeyConfigIdV1$u20$as$u20$anchor_lang..Accounts$LT$donation_relay_source_proposal..instructions..v1..public_api..donate..donate_pubkey_config_id..DonatePubkeyConfigIdV1Bumps$GT$$GT$12try_accounts28_$u7b$$u7b$closure$u7d$$u7d$17h2a8d2e027764e6bcE")
    *donation_relay_source_proposal.donation_relay_source_proposal.5235393d683737bf-cgu.0.rcgu.o(".text._ZN329_$LT$donation_relay_source_proposal..instructions..v1..public_api..donate..donate_pubkey_config_id_with_payer..DonatePubkeyConfigIdWithPayerV1$u20$as$u20$anchor_lang..Accounts$LT$donation_relay_source_proposal..instructions..v1..public_api..donate..donate_pubkey_config_id_with_payer..DonatePubkeyConfigIdWithPayerV1Bumps$GT$$GT$12try_accounts17h747030c138c92389E")
    *donation_relay_source_proposal.donation_relay_source_proposal.5235393d683737bf-cgu.0.rcgu.o(".text._ZN329_$LT$donation_relay_source_proposal..instructions..v1..public_api..donate..donate_pubkey_config_id_with_payer..DonatePubkeyConfigIdWithPayerV1$u20$as$u20$anchor_lang..Accounts$LT$donation_relay_source_proposal..instructions..v1..public_api..donate..donate_pubkey_config_id_with_payer..DonatePubkeyConfigIdWithPayerV1Bumps$GT$$GT$12try_accounts28_$u7b$$u7b$closure$u7d$$u7d$17h74872d11b53f07d5E")
    *donation_relay_source_proposal.donation_relay_source_proposal.5235393d683737bf-cgu.0.rcgu.o(".text._ZN329_$LT$donation_relay_source_proposal..instructions..v1..public_api..donate..donate_pubkey_config_id_with_payer..DonatePubkeyConfigIdWithPayerV1$u20$as$u20$anchor_lang..Accounts$LT$donation_relay_source_proposal..instructions..v1..public_api..donate..donate_pubkey_config_id_with_payer..DonatePubkeyConfigIdWithPayerV1Bumps$GT$$GT$12try_accounts28_$u7b$$u7b$closure$u7d$$u7d$17h3b6d08bc0c858444E")
    *donation_relay_source_proposal.donation_relay_source_proposal.5235393d683737bf-cgu.0.rcgu.o(".text._ZN183_$LT$donation_relay_source_proposal..instructions..v1..public_api..donate..donate_pubkey_config_id_with_payer..DonatePubkeyConfigIdWithPayerV1$u20$as$u20$anchor_lang..AccountsExit$GT$4exit17h3f60cbc4b9573b88E")
    *donation_relay_source_proposal.donation_relay_source_proposal.5235393d683737bf-cgu.0.rcgu.o(".text._ZN267_$LT$donation_relay_source_proposal..instructions..v1..relayer_only..close_donation_epoch..CloseDonationEpochV1$u20$as$u20$anchor_lang..Accounts$LT$donation_relay_source_proposal..instructions..v1..relayer_only..close_donation_epoch..CloseDonationEpochV1Bumps$GT$$GT$12try_accounts17h574bac1e93a360bbE")
    *donation_relay_source_proposal.donation_relay_source_proposal.5235393d683737bf-cgu.0.rcgu.o(".text._ZN267_$LT$donation_relay_source_proposal..instructions..v1..relayer_only..close_donation_epoch..CloseDonationEpochV1$u20$as$u20$anchor_lang..Accounts$LT$donation_relay_source_proposal..instructions..v1..relayer_only..close_donation_epoch..CloseDonationEpochV1Bumps$GT$$GT$12try_accounts28_$u7b$$u7b$closure$u7d$$u7d$17habb332a39d228b5eE")
    *donation_relay_source_proposal.donation_relay_source_proposal.5235393d683737bf-cgu.0.rcgu.o(".text._ZN267_$LT$donation_relay_source_proposal..instructions..v1..relayer_only..close_donation_epoch..CloseDonationEpochV1$u20$as$u20$anchor_lang..Accounts$LT$donation_relay_source_proposal..instructions..v1..relayer_only..close_donation_epoch..CloseDonationEpochV1Bumps$GT$$GT$12try_accounts28_$u7b$$u7b$closure$u7d$$u7d$17h379341aae8615e48E")
    *donation_relay_source_proposal.donation_relay_source_proposal.5235393d683737bf-cgu.0.rcgu.o(".text._ZN152_$LT$donation_relay_source_proposal..instructions..v1..relayer_only..close_donation_epoch..CloseDonationEpochV1$u20$as$u20$anchor_lang..AccountsExit$GT$4exit17h0ed6c934bb620adfE")
    *donation_relay_source_proposal.donation_relay_source_proposal.5235393d683737bf-cgu.0.rcgu.o(".text._ZN329_$LT$donation_relay_source_proposal..instructions..v1..relayer_only..distribute..distribute_after_just_swapping..DistributeAfterJustSwappingV1$u20$as$u20$anchor_lang..Accounts$LT$donation_relay_source_proposal..instructions..v1..relayer_only..distribute..distribute_after_just_swapping..DistributeAfterJustSwappingV1Bumps$GT$$GT$12try_accounts17hf6ed5bf49aaa9ef0E")
    *donation_relay_source_proposal.donation_relay_source_proposal.5235393d683737bf-cgu.0.rcgu.o(".text._ZN183_$LT$donation_relay_source_proposal..instructions..v1..relayer_only..distribute..distribute_after_just_swapping..DistributeAfterJustSwappingV1$u20$as$u20$anchor_lang..AccountsExit$GT$4exit17ha2faa836313216f1E")
    *donation_relay_source_proposal.donation_relay_source_proposal.5235393d683737bf-cgu.0.rcgu.o(".text._ZN331_$LT$donation_relay_source_proposal..instructions..v1..relayer_only..distribute..distribute_non_swap_output_mint..DistributeNonSwapOutputMintV1$u20$as$u20$anchor_lang..Accounts$LT$donation_relay_source_proposal..instructions..v1..relayer_only..distribute..distribute_non_swap_output_mint..DistributeNonSwapOutputMintV1Bumps$GT$$GT$12try_accounts17hba3ed3c86c8cf027E")
    *donation_relay_source_proposal.donation_relay_source_proposal.5235393d683737bf-cgu.0.rcgu.o(".text._ZN184_$LT$donation_relay_source_proposal..instructions..v1..relayer_only..distribute..distribute_non_swap_output_mint..DistributeNonSwapOutputMintV1$u20$as$u20$anchor_lang..AccountsExit$GT$4exit17h701147f2b501d615E")
    *donation_relay_source_proposal.donation_relay_source_proposal.5235393d683737bf-cgu.0.rcgu.o(".text._ZN249_$LT$donation_relay_source_proposal..instructions..v1..relayer_only..distribute..just_swap..JustSwapV1$u20$as$u20$anchor_lang..Accounts$LT$donation_relay_source_proposal..instructions..v1..relayer_only..distribute..just_swap..JustSwapV1Bumps$GT$$GT$12try_accounts17h465a9f502bbd91b8E")
    *donation_relay_source_proposal.donation_relay_source_proposal.5235393d683737bf-cgu.0.rcgu.o(".text._ZN249_$LT$donation_relay_source_proposal..instructions..v1..relayer_only..distribute..just_swap..JustSwapV1$u20$as$u20$anchor_lang..Accounts$LT$donation_relay_source_proposal..instructions..v1..relayer_only..distribute..just_swap..JustSwapV1Bumps$GT$$GT$12try_accounts28_$u7b$$u7b$closure$u7d$$u7d$17hecab6326caf7b008E")
    *donation_relay_source_proposal.donation_relay_source_proposal.5235393d683737bf-cgu.0.rcgu.o(".text._ZN249_$LT$donation_relay_source_proposal..instructions..v1..relayer_only..distribute..just_swap..JustSwapV1$u20$as$u20$anchor_lang..Accounts$LT$donation_relay_source_proposal..instructions..v1..relayer_only..distribute..just_swap..JustSwapV1Bumps$GT$$GT$12try_accounts28_$u7b$$u7b$closure$u7d$$u7d$17hb89103af643f4973E")
    *donation_relay_source_proposal.donation_relay_source_proposal.5235393d683737bf-cgu.0.rcgu.o(".text._ZN143_$LT$donation_relay_source_proposal..instructions..v1..relayer_only..distribute..just_swap..JustSwapV1$u20$as$u20$anchor_lang..AccountsExit$GT$4exit17hf6109a29ec81517eE")
    *donation_relay_source_proposal.donation_relay_source_proposal.5235393d683737bf-cgu.0.rcgu.o(".text._ZN291_$LT$donation_relay_source_proposal..instructions..v1..relayer_only..distribute..swap_then_distribute..SwapThenDistributeV1$u20$as$u20$anchor_lang..Accounts$LT$donation_relay_source_proposal..instructions..v1..relayer_only..distribute..swap_then_distribute..SwapThenDistributeV1Bumps$GT$$GT$12try_accounts17h7d1467d38095ce36E")
    *donation_relay_source_proposal.donation_relay_source_proposal.5235393d683737bf-cgu.0.rcgu.o(".text._ZN164_$LT$donation_relay_source_proposal..instructions..v1..relayer_only..distribute..swap_then_distribute..SwapThenDistributeV1$u20$as$u20$anchor_lang..AccountsExit$GT$4exit17h4b6d9f040a3fa506E")
    *donation_relay_source_proposal.donation_relay_source_proposal.5235393d683737bf-cgu.0.rcgu.o(".text._ZN271_$LT$donation_relay_source_proposal..instructions..v1..relayer_only..upsert_mint_whitelist..UpsertMintWhitelistV1$u20$as$u20$anchor_lang..Accounts$LT$donation_relay_source_proposal..instructions..v1..relayer_only..upsert_mint_whitelist..UpsertMintWhitelistV1Bumps$GT$$GT$12try_accounts17hd21bdc9e2f4fc6eeE")
    *donation_relay_source_proposal.donation_relay_source_proposal.5235393d683737bf-cgu.0.rcgu.o(".text._ZN271_$LT$donation_relay_source_proposal..instructions..v1..relayer_only..upsert_mint_whitelist..UpsertMintWhitelistV1$u20$as$u20$anchor_lang..Accounts$LT$donation_relay_source_proposal..instructions..v1..relayer_only..upsert_mint_whitelist..UpsertMintWhitelistV1Bumps$GT$$GT$12try_accounts28_$u7b$$u7b$closure$u7d$$u7d$17hb19b661bfe808a30E")
    *donation_relay_source_proposal.donation_relay_source_proposal.5235393d683737bf-cgu.0.rcgu.o(".text._ZN154_$LT$donation_relay_source_proposal..instructions..v1..relayer_only..upsert_mint_whitelist..UpsertMintWhitelistV1$u20$as$u20$anchor_lang..AccountsExit$GT$4exit17hc192b1decbd128c3E")
    *donation_relay_source_proposal.donation_relay_source_proposal.5235393d683737bf-cgu.0.rcgu.o(".text._ZN117_$LT$donation_relay_source_proposal..state..v1..debouncer..DebouncerV1$u20$as$u20$anchor_lang..AccountDeserialize$GT$15try_deserialize17h5a5ac768769e9268E")
    *donation_relay_source_proposal.donation_relay_source_proposal.5235393d683737bf-cgu.0.rcgu.o(".text._ZN117_$LT$donation_relay_source_proposal..state..v1..debouncer..DebouncerV1$u20$as$u20$anchor_lang..AccountDeserialize$GT$25try_deserialize_unchecked17h98c06febbcfbb529E")
    *donation_relay_source_proposal.donation_relay_source_proposal.5235393d683737bf-cgu.0.rcgu.o(".text._ZN123_$LT$donation_relay_source_proposal..state..v1..distribution..DistributionV1$u20$as$u20$anchor_lang..AccountDeserialize$GT$15try_deserialize17h1a691dc16b4cecf0E")
    *donation_relay_source_proposal.donation_relay_source_proposal.5235393d683737bf-cgu.0.rcgu.o(".text._ZN123_$LT$donation_relay_source_proposal..state..v1..distribution..DistributionV1$u20$as$u20$anchor_lang..AccountDeserialize$GT$25try_deserialize_unchecked17hf890c7e33b3b271fE")
    *donation_relay_source_proposal.donation_relay_source_proposal.5235393d683737bf-cgu.0.rcgu.o(".text._ZN124_$LT$donation_relay_source_proposal..state..v1..epoch_tracker..EpochTrackerV1$u20$as$u20$anchor_lang..AccountDeserialize$GT$15try_deserialize17h936a4f47d19e3ee8E")
    *donation_relay_source_proposal.donation_relay_source_proposal.5235393d683737bf-cgu.0.rcgu.o(".text._ZN124_$LT$donation_relay_source_proposal..state..v1..epoch_tracker..EpochTrackerV1$u20$as$u20$anchor_lang..AccountDeserialize$GT$25try_deserialize_unchecked17h271a520403f78752E")
    *donation_relay_source_proposal.donation_relay_source_proposal.5235393d683737bf-cgu.0.rcgu.o(".text._ZN126_$LT$donation_relay_source_proposal..state..v1..mint_whitelist..MintWhitelistV1$u20$as$u20$anchor_lang..AccountDeserialize$GT$15try_deserialize17hc9e9f3378c7b4226E")
    *donation_relay_source_proposal.donation_relay_source_proposal.5235393d683737bf-cgu.0.rcgu.o(".text._ZN126_$LT$donation_relay_source_proposal..state..v1..mint_whitelist..MintWhitelistV1$u20$as$u20$anchor_lang..AccountDeserialize$GT$25try_deserialize_unchecked17h66c285fd9111eab0E")
    *donation_relay_source_proposal.donation_relay_source_proposal.5235393d683737bf-cgu.0.rcgu.o(".text._ZN122_$LT$donation_relay_source_proposal..state..v1..swap_receipt..SwapReceiptV1$u20$as$u20$anchor_lang..AccountDeserialize$GT$15try_deserialize17h8c041c3d2692d2bbE")
    *donation_relay_source_proposal.donation_relay_source_proposal.5235393d683737bf-cgu.0.rcgu.o(".text._ZN122_$LT$donation_relay_source_proposal..state..v1..swap_receipt..SwapReceiptV1$u20$as$u20$anchor_lang..AccountDeserialize$GT$25try_deserialize_unchecked17hd2d389c80b206d08E")
    *donation_relay_source_proposal.donation_relay_source_proposal.5235393d683737bf-cgu.0.rcgu.o(".text._ZN30donation_relay_source_proposal16anchor_framework5entry17hfc146ccfa6f510d2E")
    *donation_relay_source_proposal.donation_relay_source_proposal.5235393d683737bf-cgu.0.rcgu.o(".text._ZN30donation_relay_source_proposal16anchor_framework9__private5__idl14__idl_dispatch17h9669183d16af5e04E")
    *donation_relay_source_proposal.donation_relay_source_proposal.5235393d683737bf-cgu.0.rcgu.o(".text._ZN30donation_relay_source_proposal16anchor_framework9__private5__idl20__idl_create_account17h9bc5f31bc1b533dbE")
    *donation_relay_source_proposal.donation_relay_source_proposal.5235393d683737bf-cgu.0.rcgu.o(".text._ZN30donation_relay_source_proposal16anchor_framework9__private5__idl20__idl_resize_account17h13c2ed1379467ad9E")
    *donation_relay_source_proposal.donation_relay_source_proposal.5235393d683737bf-cgu.0.rcgu.o(".text._ZN30donation_relay_source_proposal16anchor_framework9__private5__idl19__idl_close_account17he1ab3b66ed41bf16E")
    *donation_relay_source_proposal.donation_relay_source_proposal.5235393d683737bf-cgu.0.rcgu.o(".text._ZN30donation_relay_source_proposal16anchor_framework9__private5__idl19__idl_create_buffer17h0f63c3cbdb29eef2E")
    *donation_relay_source_proposal.donation_relay_source_proposal.5235393d683737bf-cgu.0.rcgu.o(".text._ZN30donation_relay_source_proposal16anchor_framework9__private5__idl11__idl_write17h914d8381bd8e10c3E")
    *donation_relay_source_proposal.donation_relay_source_proposal.5235393d683737bf-cgu.0.rcgu.o(".text._ZN30donation_relay_source_proposal16anchor_framework9__private5__idl19__idl_set_authority17hdff4f5d97546f978E")
    *donation_relay_source_proposal.donation_relay_source_proposal.5235393d683737bf-cgu.0.rcgu.o(".text._ZN30donation_relay_source_proposal16anchor_framework9__private5__idl16__idl_set_buffer17h8b8acdd2aa080bc6E")
    *donation_relay_source_proposal.donation_relay_source_proposal.5235393d683737bf-cgu.0.rcgu.o(".text._ZN30donation_relay_source_proposal16anchor_framework9__private8__global9donate_v117h6d481e43c02c25d6E")
    *donation_relay_source_proposal.donation_relay_source_proposal.5235393d683737bf-cgu.0.rcgu.o(".text._ZN30donation_relay_source_proposal16anchor_framework9__private8__global26donate_pubkey_config_id_v117h4236dfed27ba7110E")
    *donation_relay_source_proposal.donation_relay_source_proposal.5235393d683737bf-cgu.0.rcgu.o(".text._ZN30donation_relay_source_proposal16anchor_framework9__private8__global16donate_native_v117h44d934edfeb163d8E")
    *donation_relay_source_proposal.donation_relay_source_proposal.5235393d683737bf-cgu.0.rcgu.o(".text._ZN30donation_relay_source_proposal16anchor_framework9__private8__global33donate_native_pubkey_config_id_v117h569bf164593fdc52E")
    *donation_relay_source_proposal.donation_relay_source_proposal.5235393d683737bf-cgu.0.rcgu.o(".text._ZN30donation_relay_source_proposal16anchor_framework9__private8__global37donate_pubkey_config_id_with_payer_v117h7a2e362a35fb3a9aE")
    *donation_relay_source_proposal.donation_relay_source_proposal.5235393d683737bf-cgu.0.rcgu.o(".text._ZN30donation_relay_source_proposal16anchor_framework9__private8__global23close_donation_epoch_v117h99dd1a9014557d84E")
    *donation_relay_source_proposal.donation_relay_source_proposal.5235393d683737bf-cgu.0.rcgu.o(".text._ZN30donation_relay_source_proposal16anchor_framework9__private8__global23swap_then_distribute_v117h1c85a9908fbb2154E")
    *donation_relay_source_proposal.donation_relay_source_proposal.5235393d683737bf-cgu.0.rcgu.o(".text._ZN30donation_relay_source_proposal16anchor_framework9__private8__global12just_swap_v117h5b679850c2e9720cE")
    *donation_relay_source_proposal.donation_relay_source_proposal.5235393d683737bf-cgu.0.rcgu.o(".text._ZN30donation_relay_source_proposal16anchor_framework9__private8__global33distribute_after_just_swapping_v117h2c59fdec18f263dfE")
    *donation_relay_source_proposal.donation_relay_source_proposal.5235393d683737bf-cgu.0.rcgu.o(".text._ZN30donation_relay_source_proposal16anchor_framework9__private8__global34distribute_non_swap_output_mint_v117hc23885617f7bf2d4E")
    *donation_relay_source_proposal.donation_relay_source_proposal.5235393d683737bf-cgu.0.rcgu.o(".text._ZN30donation_relay_source_proposal16anchor_framework9__private8__global24upsert_mint_whitelist_v117h95156633e1b353c9E")
    *donation_relay_source_proposal.donation_relay_source_proposal.5235393d683737bf-cgu.0.rcgu.o(".text._ZN30donation_relay_source_proposal16anchor_framework9__private8__events16__event_dispatch17h60e5d840c5e06a4fE")
    *donation_relay_source_proposal.donation_relay_source_proposal.5235393d683737bf-cgu.0.rcgu.o(".text._ZN30donation_relay_source_proposal16anchor_framework37relay_anchor_idl_reconstruction_probe26donate_pubkey_config_id_v117h77b9f575982da00eE")
    *donation_relay_source_proposal.donation_relay_source_proposal.5235393d683737bf-cgu.0.rcgu.o(".text._ZN30donation_relay_source_proposal16anchor_framework37relay_anchor_idl_reconstruction_probe16donate_native_v117h44e53c3024bb86f1E")
    *donation_relay_source_proposal.donation_relay_source_proposal.5235393d683737bf-cgu.0.rcgu.o(".text._ZN30donation_relay_source_proposal16anchor_framework37relay_anchor_idl_reconstruction_probe33donate_native_pubkey_config_id_v117hc92008cccf2d4625E")
    *donation_relay_source_proposal.donation_relay_source_proposal.5235393d683737bf-cgu.0.rcgu.o(".text._ZN30donation_relay_source_proposal16anchor_framework37relay_anchor_idl_reconstruction_probe37donate_pubkey_config_id_with_payer_v117h433f48ed8edd3874E")
    *donation_relay_source_proposal.donation_relay_source_proposal.5235393d683737bf-cgu.0.rcgu.o(".text.entrypoint")
    *donation_relay_source_proposal.donation_relay_source_proposal.5235393d683737bf-cgu.0.rcgu.o(".text.__rust_alloc")
    *donation_relay_source_proposal.donation_relay_source_proposal.5235393d683737bf-cgu.0.rcgu.o(".text.__rust_dealloc")
    *donation_relay_source_proposal.donation_relay_source_proposal.5235393d683737bf-cgu.0.rcgu.o(".text.__rust_realloc")
    *donation_relay_source_proposal.donation_relay_source_proposal.5235393d683737bf-cgu.0.rcgu.o(".text.__rust_alloc_zeroed")
    *donation_relay_source_proposal.donation_relay_source_proposal.5235393d683737bf-cgu.0.rcgu.o(".text.custom_panic")
    *donation_relay_source_proposal.donation_relay_source_proposal.5235393d683737bf-cgu.0.rcgu.o(".text._ZN30donation_relay_source_proposal16anchor_framework37relay_anchor_idl_reconstruction_probe34distribute_non_swap_output_mint_v117h907b033f3b75977fE")
    *donation_relay_source_proposal.donation_relay_source_proposal.5235393d683737bf-cgu.0.rcgu.o(".text._ZN30donation_relay_source_proposal16anchor_framework37relay_anchor_idl_reconstruction_probe33distribute_after_just_swapping_v117he1ef83b7520cb676E")
    *donation_relay_source_proposal.donation_relay_source_proposal.5235393d683737bf-cgu.0.rcgu.o(".text._ZN30donation_relay_source_proposal16anchor_framework37relay_anchor_idl_reconstruction_probe12just_swap_v117hf28f5b2f133f9869E")
    *donation_relay_source_proposal.donation_relay_source_proposal.5235393d683737bf-cgu.0.rcgu.o(".text._ZN30donation_relay_source_proposal16anchor_framework37relay_anchor_idl_reconstruction_probe23swap_then_distribute_v117ha6efb9a30128ff4aE")
    *donation_relay_source_proposal.donation_relay_source_proposal.5235393d683737bf-cgu.0.rcgu.o(".text._ZN30donation_relay_source_proposal16anchor_framework37relay_anchor_idl_reconstruction_probe23close_donation_epoch_v117ha8359eafce3cf67bE")
    *donation_relay_source_proposal.donation_relay_source_proposal.5235393d683737bf-cgu.0.rcgu.o(".text._ZN221_$LT$donation_relay_source_proposal..anchor_framework..__private..__idl..IdlCloseAccount$u20$as$u20$anchor_lang..Accounts$LT$donation_relay_source_proposal..anchor_framework..__private..__idl..IdlCloseAccountBumps$GT$$GT$12try_accounts17h06fc43fe29ef6d2fE")
    *donation_relay_source_proposal.donation_relay_source_proposal.5235393d683737bf-cgu.0.rcgu.o(".text._ZN129_$LT$donation_relay_source_proposal..anchor_framework..__private..__idl..IdlCloseAccount$u20$as$u20$anchor_lang..AccountsExit$GT$4exit17h22638e4aa01d54b4E")
    *donation_relay_source_proposal.donation_relay_source_proposal.5235393d683737bf-cgu.0.rcgu.o(".text._ZN215_$LT$donation_relay_source_proposal..anchor_framework..__private..__idl..IdlSetBuffer$u20$as$u20$anchor_lang..Accounts$LT$donation_relay_source_proposal..anchor_framework..__private..__idl..IdlSetBufferBumps$GT$$GT$12try_accounts17h6806d3281c06412aE")
    *donation_relay_source_proposal.donation_relay_source_proposal.5235393d683737bf-cgu.0.rcgu.o(".text._ZN126_$LT$donation_relay_source_proposal..anchor_framework..__private..__idl..IdlSetBuffer$u20$as$u20$anchor_lang..AccountsExit$GT$4exit17h3d297dff7ef30cc5E")
    *donation_relay_source_proposal.donation_relay_source_proposal.5235393d683737bf-cgu.0.rcgu.o(".text._ZN221_$LT$donation_relay_source_proposal..anchor_framework..__private..__idl..IdlCreateBuffer$u20$as$u20$anchor_lang..Accounts$LT$donation_relay_source_proposal..anchor_framework..__private..__idl..IdlCreateBufferBumps$GT$$GT$12try_accounts17hd7af3978b6d2ab01E")
    *donation_relay_source_proposal.donation_relay_source_proposal.5235393d683737bf-cgu.0.rcgu.o(".text._ZN129_$LT$donation_relay_source_proposal..anchor_framework..__private..__idl..IdlCreateBuffer$u20$as$u20$anchor_lang..AccountsExit$GT$4exit17h3f0a039e97de0496E")
    *donation_relay_source_proposal.donation_relay_source_proposal.5235393d683737bf-cgu.0.rcgu.o(".text._ZN223_$LT$donation_relay_source_proposal..anchor_framework..__private..__idl..IdlResizeAccount$u20$as$u20$anchor_lang..Accounts$LT$donation_relay_source_proposal..anchor_framework..__private..__idl..IdlResizeAccountBumps$GT$$GT$12try_accounts17h5f9e1f02d7df975cE")
    *donation_relay_source_proposal.donation_relay_source_proposal.5235393d683737bf-cgu.0.rcgu.o(".text._ZN130_$LT$donation_relay_source_proposal..anchor_framework..__private..__idl..IdlResizeAccount$u20$as$u20$anchor_lang..AccountsExit$GT$4exit17h6850fcd731f90a2fE")
    *donation_relay_source_proposal.donation_relay_source_proposal.5235393d683737bf-cgu.0.rcgu.o(".text._ZN213_$LT$donation_relay_source_proposal..anchor_framework..__private..__idl..IdlAccounts$u20$as$u20$anchor_lang..Accounts$LT$donation_relay_source_proposal..anchor_framework..__private..__idl..IdlAccountsBumps$GT$$GT$12try_accounts17hda40e7779edbac25E")
    *donation_relay_source_proposal.donation_relay_source_proposal.5235393d683737bf-cgu.0.rcgu.o(".text._ZN125_$LT$donation_relay_source_proposal..anchor_framework..__private..__idl..IdlAccounts$u20$as$u20$anchor_lang..AccountsExit$GT$4exit17h2761634e0ab3a799E")
    *donation_relay_source_proposal.donation_relay_source_proposal.5235393d683737bf-cgu.0.rcgu.o(".text._ZN225_$LT$donation_relay_source_proposal..anchor_framework..__private..__idl..IdlCreateAccounts$u20$as$u20$anchor_lang..Accounts$LT$donation_relay_source_proposal..anchor_framework..__private..__idl..IdlCreateAccountsBumps$GT$$GT$12try_accounts17h1fc7163c1d445c48E")
    *donation_relay_source_proposal.donation_relay_source_proposal.5235393d683737bf-cgu.0.rcgu.o(".text._ZN128_$LT$donation_relay_source_proposal..anchor_framework..__private..__idl..IdlAccount$u20$as$u20$anchor_lang..AccountSerialize$GT$13try_serialize17h6f331ddf6eee0cf0E")
    *donation_relay_source_proposal.donation_relay_source_proposal.5235393d683737bf-cgu.0.rcgu.o(".text._ZN130_$LT$donation_relay_source_proposal..anchor_framework..__private..__idl..IdlAccount$u20$as$u20$anchor_lang..AccountDeserialize$GT$15try_deserialize17h7790a999d2cf50b1E")
    *donation_relay_source_proposal.donation_relay_source_proposal.5235393d683737bf-cgu.0.rcgu.o(".text._ZN130_$LT$donation_relay_source_proposal..anchor_framework..__private..__idl..IdlAccount$u20$as$u20$anchor_lang..AccountDeserialize$GT$25try_deserialize_unchecked17h03467bd4c74186cfE")
    *donation_relay_source_proposal.8jw7t0xjmo4mcg046jzfghqzh.rcgu.o(".text.__rust_alloc_error_handler")
    *libanchor_spl-d2586da0f4bf69d8.rlib:anchor_spl-d2586da0f4bf69d8.anchor_spl.5a586bf85e8a4b78-cgu.0.rcgu.o(".text._ZN4core3ptr74drop_in_place$LT$$u5b$solana_account_info..AccountInfo$u3b$$u20$3$u5d$$GT$17hcc48f81bc4ed363dE")
    *libanchor_spl-d2586da0f4bf69d8.rlib:anchor_spl-d2586da0f4bf69d8.anchor_spl.5a586bf85e8a4b78-cgu.0.rcgu.o(".text._ZN4core3ptr74drop_in_place$LT$$u5b$solana_account_info..AccountInfo$u3b$$u20$4$u5d$$GT$17h7e11850907bdf7e9E")
    *libanchor_spl-d2586da0f4bf69d8.rlib:anchor_spl-d2586da0f4bf69d8.anchor_spl.5a586bf85e8a4b78-cgu.0.rcgu.o(".text._ZN4core3ptr74drop_in_place$LT$$u5b$solana_account_info..AccountInfo$u3b$$u20$6$u5d$$GT$17h0353e844d0c0e0ecE")
    *libanchor_spl-d2586da0f4bf69d8.rlib:anchor_spl-d2586da0f4bf69d8.anchor_spl.5a586bf85e8a4b78-cgu.0.rcgu.o(".text._ZN5alloc2rc15Rc$LT$T$C$A$GT$9drop_slow17h20c87dff362ffd61E")
    *libanchor_spl-d2586da0f4bf69d8.rlib:anchor_spl-d2586da0f4bf69d8.anchor_spl.5a586bf85e8a4b78-cgu.0.rcgu.o(".text._ZN5alloc2rc15Rc$LT$T$C$A$GT$9drop_slow17h47278d69c50c52c3E")
    *libanchor_spl-d2586da0f4bf69d8.rlib:anchor_spl-d2586da0f4bf69d8.anchor_spl.5a586bf85e8a4b78-cgu.0.rcgu.o(".text._ZN10anchor_spl16associated_token6create17hca4967aa5fe3ec12E")
    *libanchor_spl-d2586da0f4bf69d8.rlib:anchor_spl-d2586da0f4bf69d8.anchor_spl.5a586bf85e8a4b78-cgu.0.rcgu.o(".text._ZN10anchor_spl10token_202216transfer_checked17h2d1040c9ece4b5caE")
    *libanchor_spl-d2586da0f4bf69d8.rlib:anchor_spl-d2586da0f4bf69d8.anchor_spl.5a586bf85e8a4b78-cgu.0.rcgu.o(".text._ZN10anchor_spl10token_20224burn17h9976c424280fed23E")
    *libanchor_spl-d2586da0f4bf69d8.rlib:anchor_spl-d2586da0f4bf69d8.anchor_spl.5a586bf85e8a4b78-cgu.0.rcgu.o(".text._ZN10anchor_spl10token_202219initialize_account317h3640be09def98bbfE")
    *libanchor_spl-d2586da0f4bf69d8.rlib:anchor_spl-d2586da0f4bf69d8.anchor_spl.5a586bf85e8a4b78-cgu.0.rcgu.o(".text._ZN10anchor_spl10token_202213close_account17haeab741678477257E")
    *libanchor_spl-d2586da0f4bf69d8.rlib:anchor_spl-d2586da0f4bf69d8.anchor_spl.5a586bf85e8a4b78-cgu.0.rcgu.o(".text._ZN10anchor_spl10token_202211sync_native17hc07c73939bdcc355E")
    *libanchor_spl-d2586da0f4bf69d8.rlib:anchor_spl-d2586da0f4bf69d8.anchor_spl.5a586bf85e8a4b78-cgu.0.rcgu.o(".text._ZN93_$LT$anchor_spl..token_interface..TokenAccount$u20$as$u20$anchor_lang..AccountDeserialize$GT$25try_deserialize_unchecked17hf7478eb51d4e504eE")
    *libanchor_spl-d2586da0f4bf69d8.rlib:anchor_spl-d2586da0f4bf69d8.anchor_spl.5a586bf85e8a4b78-cgu.0.rcgu.o(".text._ZN85_$LT$anchor_spl..token_interface..Mint$u20$as$u20$anchor_lang..AccountDeserialize$GT$25try_deserialize_unchecked17hd61e398abc814482E")
    *libspl_token_2022-af562d5caea3712d.rlib:spl_token_2022-af562d5caea3712d.spl_token_2022.c7ad68e41b9dd4ec-cgu.0.rcgu.o(".text._ZN5alloc7raw_vec11finish_grow17h9029a630bfa2e045E")
    *libspl_token_2022-af562d5caea3712d.rlib:spl_token_2022-af562d5caea3712d.spl_token_2022.c7ad68e41b9dd4ec-cgu.0.rcgu.o(".text._ZN5alloc7raw_vec19RawVec$LT$T$C$A$GT$8grow_one17hda1fe669a3b46cc1E")
    *libspl_token_2022-af562d5caea3712d.rlib:spl_token_2022-af562d5caea3712d.spl_token_2022.c7ad68e41b9dd4ec-cgu.0.rcgu.o(".text._ZN5alloc7raw_vec19RawVec$LT$T$C$A$GT$8grow_one17h83de781ce11ebb2aE")
    *libspl_token_2022-af562d5caea3712d.rlib:spl_token_2022-af562d5caea3712d.spl_token_2022.c7ad68e41b9dd4ec-cgu.0.rcgu.o(".text._ZN5alloc7raw_vec19RawVec$LT$T$C$A$GT$8grow_one17ha077bf6f5e195951E")
    *libspl_token_2022-af562d5caea3712d.rlib:spl_token_2022-af562d5caea3712d.spl_token_2022.c7ad68e41b9dd4ec-cgu.0.rcgu.o(".text.unlikely._ZN5alloc7raw_vec20RawVecInner$LT$A$GT$7reserve21do_reserve_and_handle17he3d2d825bfd6427eE")
    *libspl_token_2022-af562d5caea3712d.rlib:spl_token_2022-af562d5caea3712d.spl_token_2022.c7ad68e41b9dd4ec-cgu.0.rcgu.o(".text._ZN14spl_token_20229extension15get_tlv_indices17ha5df802d825ea6d4E")
    *libspl_token_2022-af562d5caea3712d.rlib:spl_token_2022-af562d5caea3712d.spl_token_2022.c7ad68e41b9dd4ec-cgu.0.rcgu.o(".text._ZN14spl_token_20229extension23adjust_len_for_multisig17h8adeb547978574e5E")
    *libspl_token_2022-af562d5caea3712d.rlib:spl_token_2022-af562d5caea3712d.spl_token_2022.c7ad68e41b9dd4ec-cgu.0.rcgu.o(".text._ZN14spl_token_20229extension17get_tlv_data_info17h7dc74e3b5ca56969E")
    *libspl_token_2022-af562d5caea3712d.rlib:spl_token_2022-af562d5caea3712d.spl_token_2022.c7ad68e41b9dd4ec-cgu.0.rcgu.o(".text._ZN107_$LT$spl_token_2022..extension..ExtensionType$u20$as$u20$core..convert..TryFrom$LT$$RF$$u5b$u8$u5d$$GT$$GT$8try_from17hbbc624ca6462a2f6E")
    *libspl_token_2022-af562d5caea3712d.rlib:spl_token_2022-af562d5caea3712d.spl_token_2022.c7ad68e41b9dd4ec-cgu.0.rcgu.o(".text._ZN14spl_token_20229extension13ExtensionType21try_get_total_tlv_len17hfc5595f2466fa84dE")
    *libspl_token_2022-af562d5caea3712d.rlib:spl_token_2022-af562d5caea3712d.spl_token_2022.c7ad68e41b9dd4ec-cgu.0.rcgu.o(".text._ZN14spl_token_20229extension13ExtensionType36get_required_init_account_extensions17h830e3e181c254f2eE")
    *libspl_token_2022-af562d5caea3712d.rlib:spl_token_2022-af562d5caea3712d.spl_token_2022.c7ad68e41b9dd4ec-cgu.0.rcgu.o(".text._ZN14spl_token_202211instruction16TokenInstruction4pack17h00fb00162403fa8dE")
    *libspl_token_2022-af562d5caea3712d.rlib:spl_token_2022-af562d5caea3712d.spl_token_2022.c7ad68e41b9dd4ec-cgu.0.rcgu.o(".text._ZN14spl_token_202211instruction19initialize_account317h437e7bfbfa0fcec5E")
    *libspl_token_2022-af562d5caea3712d.rlib:spl_token_2022-af562d5caea3712d.spl_token_2022.c7ad68e41b9dd4ec-cgu.0.rcgu.o(".text._ZN14spl_token_202211instruction4burn17h965fef6984d63c17E")
    *libspl_token_2022-af562d5caea3712d.rlib:spl_token_2022-af562d5caea3712d.spl_token_2022.c7ad68e41b9dd4ec-cgu.0.rcgu.o(".text._ZN14spl_token_202211instruction13close_account17h05a0b3b8d54e4842E")
    *libspl_token_2022-af562d5caea3712d.rlib:spl_token_2022-af562d5caea3712d.spl_token_2022.c7ad68e41b9dd4ec-cgu.0.rcgu.o(".text._ZN14spl_token_202211instruction16transfer_checked17he90989c53202b1a0E")
    *libspl_token_2022-af562d5caea3712d.rlib:spl_token_2022-af562d5caea3712d.spl_token_2022.c7ad68e41b9dd4ec-cgu.0.rcgu.o(".text._ZN14spl_token_202211instruction11sync_native17h04a59437d686a088E")
    *libspl_token_2022-af562d5caea3712d.rlib:spl_token_2022-af562d5caea3712d.spl_token_2022.c7ad68e41b9dd4ec-cgu.0.rcgu.o(".text._ZN73_$LT$spl_token_2022..state..Mint$u20$as$u20$solana_program_pack..Pack$GT$17unpack_from_slice17h1deadfb89e88060dE")
    *libspl_token_2022-af562d5caea3712d.rlib:spl_token_2022-af562d5caea3712d.spl_token_2022.c7ad68e41b9dd4ec-cgu.0.rcgu.o(".text._ZN76_$LT$spl_token_2022..state..Account$u20$as$u20$solana_program_pack..Pack$GT$17unpack_from_slice17h3ef757a42f4fa5baE")
    *libspl_pod-6add5e49203b3604.rlib:spl_pod-6add5e49203b3604.spl_pod.785410b8377be627-cgu.0.rcgu.o(".text._ZN7spl_pod13optional_keys152_$LT$impl$u20$core..convert..From$LT$spl_pod..optional_keys..OptionalNonZeroPubkey$GT$$u20$for$u20$core..option..Option$LT$solana_pubkey..Pubkey$GT$$GT$4from17hed0a131cbdc040b6E")
    *libspl_associated_token_account_client-c03624be91a50d2f.rlib:spl_associated_token_account_client-c03624be91a50d2f.spl_associated_token_account_client.c0e635a9280b4441-cgu.0.rcgu.o(".text._ZN35spl_associated_token_account_client7address44get_associated_token_address_with_program_id17h2eafa6ea206c23a1E")
    *libspl_associated_token_account_client-c03624be91a50d2f.rlib:spl_associated_token_account_client-c03624be91a50d2f.spl_associated_token_account_client.c0e635a9280b4441-cgu.0.rcgu.o(".text._ZN35spl_associated_token_account_client11instruction42build_associated_token_account_instruction17ha10d8ca8c64e9249E")
    *libspl_associated_token_account_client-c03624be91a50d2f.rlib:spl_associated_token_account_client-c03624be91a50d2f.spl_associated_token_account_client.c0e635a9280b4441-cgu.0.rcgu.o(".text._ZN35spl_associated_token_account_client11instruction31create_associated_token_account17ha1821be887ede9c0E")
    *libanchor_lang-dc27724906a48c40.rlib:anchor_lang-dc27724906a48c40.anchor_lang.65d6d884001bcf8a-cgu.0.rcgu.o(".text._ZN3std2io5error5Error3new17h5d2510c0535e6763E")
    *libanchor_lang-dc27724906a48c40.rlib:anchor_lang-dc27724906a48c40.anchor_lang.65d6d884001bcf8a-cgu.0.rcgu.o(".text._ZN42_$LT$$RF$T$u20$as$u20$core..fmt..Debug$GT$3fmt17h33f9518c7a42d8c9E")
    *libanchor_lang-dc27724906a48c40.rlib:anchor_lang-dc27724906a48c40.anchor_lang.65d6d884001bcf8a-cgu.0.rcgu.o(".text._ZN42_$LT$$RF$T$u20$as$u20$core..fmt..Debug$GT$3fmt17h0b0a638374f2cb23E")
    *libanchor_lang-dc27724906a48c40.rlib:anchor_lang-dc27724906a48c40.anchor_lang.65d6d884001bcf8a-cgu.0.rcgu.o(".text._ZN44_$LT$$RF$T$u20$as$u20$core..fmt..Display$GT$3fmt17h58fb9ed1c4829457E")
    *libanchor_lang-dc27724906a48c40.rlib:anchor_lang-dc27724906a48c40.anchor_lang.65d6d884001bcf8a-cgu.0.rcgu.o(".text._ZN44_$LT$$RF$T$u20$as$u20$core..fmt..Display$GT$3fmt17h88dc42aa5bee9447E")
    *libanchor_lang-dc27724906a48c40.rlib:anchor_lang-dc27724906a48c40.anchor_lang.65d6d884001bcf8a-cgu.0.rcgu.o(".text._ZN4core3fmt5Write9write_fmt17hc6d72856a65a9cbaE")
    *libanchor_lang-dc27724906a48c40.rlib:anchor_lang-dc27724906a48c40.anchor_lang.65d6d884001bcf8a-cgu.0.rcgu.o(".text._ZN4core3fmt9Formatter9write_fmt17h3a79942b75e80ca9E")
    *libanchor_lang-dc27724906a48c40.rlib:anchor_lang-dc27724906a48c40.anchor_lang.65d6d884001bcf8a-cgu.0.rcgu.o(".text._ZN4core3ptr238drop_in_place$LT$alloc..boxed..convert..$LT$impl$u20$core..convert..From$LT$alloc..string..String$GT$$u20$for$u20$alloc..boxed..Box$LT$dyn$u20$core..error..Error$u2b$core..marker..Sync$u2b$core..marker..Send$GT$$GT$..from..StringError$GT$17h7a8a136dfcf1f903E")
    *libanchor_lang-dc27724906a48c40.rlib:anchor_lang-dc27724906a48c40.anchor_lang.65d6d884001bcf8a-cgu.0.rcgu.o(".text._ZN4core3ptr42drop_in_place$LT$alloc..string..String$GT$17hf7f77132cf10f050E")
    *libanchor_lang-dc27724906a48c40.rlib:anchor_lang-dc27724906a48c40.anchor_lang.65d6d884001bcf8a-cgu.0.rcgu.o(".text._ZN4core5error5Error5cause17h66db8aa8f0dc6f53E")
    *libanchor_lang-dc27724906a48c40.rlib:anchor_lang-dc27724906a48c40.anchor_lang.65d6d884001bcf8a-cgu.0.rcgu.o(".text._ZN4core5error5Error7provide17hca401fa34acaf4ddE")
    *libanchor_lang-dc27724906a48c40.rlib:anchor_lang-dc27724906a48c40.anchor_lang.65d6d884001bcf8a-cgu.0.rcgu.o(".text._ZN4core5error5Error7type_id17hafd53864c6919f69E")
    *libanchor_lang-dc27724906a48c40.rlib:anchor_lang-dc27724906a48c40.anchor_lang.65d6d884001bcf8a-cgu.0.rcgu.o(".text._ZN52_$LT$T$u20$as$u20$alloc..slice..hack..ConvertVec$GT$6to_vec17h9091360876fe73abE")
    *libanchor_lang-dc27724906a48c40.rlib:anchor_lang-dc27724906a48c40.anchor_lang.65d6d884001bcf8a-cgu.0.rcgu.o(".text._ZN53_$LT$core..fmt..Error$u20$as$u20$core..fmt..Debug$GT$3fmt17hde1f1ab10afbbf92E")
    *libanchor_lang-dc27724906a48c40.rlib:anchor_lang-dc27724906a48c40.anchor_lang.65d6d884001bcf8a-cgu.0.rcgu.o(".text._ZN58_$LT$alloc..string..String$u20$as$u20$core..fmt..Write$GT$10write_char17hbf1d9fc611d850b0E")
    *libanchor_lang-dc27724906a48c40.rlib:anchor_lang-dc27724906a48c40.anchor_lang.65d6d884001bcf8a-cgu.0.rcgu.o(".text._ZN58_$LT$alloc..string..String$u20$as$u20$core..fmt..Write$GT$9write_str17h5448a1b581b20374E")
    *libanchor_lang-dc27724906a48c40.rlib:anchor_lang-dc27724906a48c40.anchor_lang.65d6d884001bcf8a-cgu.0.rcgu.o(".text._ZN5alloc2rc15Rc$LT$T$C$A$GT$9drop_slow17hc0fe3f997bc9d939E")
    *libanchor_lang-dc27724906a48c40.rlib:anchor_lang-dc27724906a48c40.anchor_lang.65d6d884001bcf8a-cgu.0.rcgu.o(".text._ZN5alloc2rc15Rc$LT$T$C$A$GT$9drop_slow17h19802713a5f7474aE")
    *libanchor_lang-dc27724906a48c40.rlib:anchor_lang-dc27724906a48c40.anchor_lang.65d6d884001bcf8a-cgu.0.rcgu.o(".text._ZN5alloc7raw_vec11finish_grow17h608861b616c5e5e8E")
    *libanchor_lang-dc27724906a48c40.rlib:anchor_lang-dc27724906a48c40.anchor_lang.65d6d884001bcf8a-cgu.0.rcgu.o(".text._ZN5alloc7raw_vec19RawVec$LT$T$C$A$GT$8grow_one17h042a5a766098d2f1E")
    *libanchor_lang-dc27724906a48c40.rlib:anchor_lang-dc27724906a48c40.anchor_lang.65d6d884001bcf8a-cgu.0.rcgu.o(".text.unlikely._ZN5alloc7raw_vec20RawVecInner$LT$A$GT$7reserve21do_reserve_and_handle17he29b494651d9bb4bE")
    *libanchor_lang-dc27724906a48c40.rlib:anchor_lang-dc27724906a48c40.anchor_lang.65d6d884001bcf8a-cgu.0.rcgu.o(".text._ZN60_$LT$alloc..string..String$u20$as$u20$core..fmt..Display$GT$3fmt17h8034bf5499229a41E")
    *libanchor_lang-dc27724906a48c40.rlib:anchor_lang-dc27724906a48c40.anchor_lang.65d6d884001bcf8a-cgu.0.rcgu.o(".text._ZN71_$LT$solana_program_error..ProgramError$u20$as$u20$core..fmt..Debug$GT$3fmt17h6aeb965aaa1f17daE")
    *libanchor_lang-dc27724906a48c40.rlib:anchor_lang-dc27724906a48c40.anchor_lang.65d6d884001bcf8a-cgu.0.rcgu.o(".text._ZN73_$LT$solana_program_error..ProgramError$u20$as$u20$core..clone..Clone$GT$5clone17h5a2ceede6b397d6dE")
    *libanchor_lang-dc27724906a48c40.rlib:anchor_lang-dc27724906a48c40.anchor_lang.65d6d884001bcf8a-cgu.0.rcgu.o(".text._ZN11anchor_lang8accounts6signer6Signer8try_from17hc6bd84267840cfb6E")
    *libanchor_lang-dc27724906a48c40.rlib:anchor_lang-dc27724906a48c40.anchor_lang.65d6d884001bcf8a-cgu.0.rcgu.o(".text._ZN101_$LT$anchor_lang..bpf_writer..BpfWriter$LT$$RF$mut$u20$$u5b$u8$u5d$$GT$$u20$as$u20$std..io..Write$GT$9write_all17hfb7e5b31b2ce51b2E")
    *libanchor_lang-dc27724906a48c40.rlib:anchor_lang-dc27724906a48c40.anchor_lang.65d6d884001bcf8a-cgu.0.rcgu.o(".text._ZN11anchor_lang6common5close17h95a7eaa54f9b930cE")
    *libanchor_lang-dc27724906a48c40.rlib:anchor_lang-dc27724906a48c40.anchor_lang.65d6d884001bcf8a-cgu.0.rcgu.o(".text._ZN11anchor_lang6common9is_closed17h7d48acbf80dd6457E")
    *libanchor_lang-dc27724906a48c40.rlib:anchor_lang-dc27724906a48c40.anchor_lang.65d6d884001bcf8a-cgu.0.rcgu.o(".text._ZN104_$LT$anchor_lang..error..Error$u20$as$u20$core..convert..From$LT$anchor_lang..error..AnchorError$GT$$GT$4from17hd1cca414339c9f54E")
    *libanchor_lang-dc27724906a48c40.rlib:anchor_lang-dc27724906a48c40.anchor_lang.65d6d884001bcf8a-cgu.0.rcgu.o(".text._ZN107_$LT$anchor_lang..error..Error$u20$as$u20$core..convert..From$LT$solana_program_error..ProgramError$GT$$GT$4from17hdb1b28040de9f973E")
    *libanchor_lang-dc27724906a48c40.rlib:anchor_lang-dc27724906a48c40.anchor_lang.65d6d884001bcf8a-cgu.0.rcgu.o(".text._ZN11anchor_lang5error5Error3log17h211686bad5f1c30dE")
    *libanchor_lang-dc27724906a48c40.rlib:anchor_lang-dc27724906a48c40.anchor_lang.65d6d884001bcf8a-cgu.0.rcgu.o(".text._ZN11anchor_lang5error5Error12with_pubkeys17h3ed9553dc48cbfa1E")
    *libanchor_lang-dc27724906a48c40.rlib:anchor_lang-dc27724906a48c40.anchor_lang.65d6d884001bcf8a-cgu.0.rcgu.o(".text._ZN11anchor_lang5error22ProgramErrorWithOrigin3log17hea470cd8f87aa93bE")
    *libanchor_lang-dc27724906a48c40.rlib:anchor_lang-dc27724906a48c40.anchor_lang.65d6d884001bcf8a-cgu.0.rcgu.o(".text._ZN11anchor_lang5error11AnchorError3log17h019656a6bda272c0E")
    *libanchor_lang-dc27724906a48c40.rlib:anchor_lang-dc27724906a48c40.anchor_lang.65d6d884001bcf8a-cgu.0.rcgu.o(".text._ZN11anchor_lang5error117_$LT$impl$u20$core..convert..From$LT$anchor_lang..error..Error$GT$$u20$for$u20$solana_program_error..ProgramError$GT$4from17hc7ee94ae539c2715E")
    *libanchor_lang-dc27724906a48c40.rlib:anchor_lang-dc27724906a48c40.anchor_lang.65d6d884001bcf8a-cgu.0.rcgu.o(".text._ZN11anchor_lang14system_program8allocate17hca4f3ed7915025feE")
    *libanchor_lang-dc27724906a48c40.rlib:anchor_lang-dc27724906a48c40.anchor_lang.65d6d884001bcf8a-cgu.0.rcgu.o(".text._ZN11anchor_lang14system_program6assign17h8939b1d37aeebf0eE")
    *libanchor_lang-dc27724906a48c40.rlib:anchor_lang-dc27724906a48c40.anchor_lang.65d6d884001bcf8a-cgu.0.rcgu.o(".text._ZN11anchor_lang14system_program14create_account17h288c4b02f0a73348E")
    *libanchor_lang-dc27724906a48c40.rlib:anchor_lang-dc27724906a48c40.anchor_lang.65d6d884001bcf8a-cgu.0.rcgu.o(".text._ZN11anchor_lang14system_program8transfer17hcedc418b4c0b3b7aE")
    *libanchor_lang-dc27724906a48c40.rlib:anchor_lang-dc27724906a48c40.anchor_lang.65d6d884001bcf8a-cgu.0.rcgu.o(".text._ZN11anchor_lang14solana_program3log12sol_log_data17hf19d516260ef58d4E")
    *libanchor_lang-dc27724906a48c40.rlib:anchor_lang-dc27724906a48c40.anchor_lang.65d6d884001bcf8a-cgu.0.rcgu.o(".text._ZN11anchor_lang5error9ErrorCode4name17hfdefcc6efe2c8d6fE")
    *libanchor_lang-dc27724906a48c40.rlib:anchor_lang-dc27724906a48c40.anchor_lang.65d6d884001bcf8a-cgu.0.rcgu.o(".text._ZN102_$LT$anchor_lang..error..Error$u20$as$u20$core..convert..From$LT$anchor_lang..error..ErrorCode$GT$$GT$4from17heacfbd43875175aeE")
    *libanchor_lang-dc27724906a48c40.rlib:anchor_lang-dc27724906a48c40.anchor_lang.65d6d884001bcf8a-cgu.0.rcgu.o(".text._ZN68_$LT$anchor_lang..error..ErrorCode$u20$as$u20$core..fmt..Display$GT$3fmt17hf2013e712e4b8ef5E")
    *libsolana_invoke-4c3b53d619a508eb.rlib:solana_invoke-4c3b53d619a508eb.solana_invoke.b19d7d8bf9a6da7-cgu.0.rcgu.o(".text._ZN13solana_invoke6invoke17heb311246e95c9dfbE")
    *libsolana_invoke-4c3b53d619a508eb.rlib:solana_invoke-4c3b53d619a508eb.solana_invoke.b19d7d8bf9a6da7-cgu.0.rcgu.o(".text._ZN13solana_invoke13invoke_signed17he2e92ccf3c17fb24E")
    *libsolana_sysvar-c6af7c337840e4d5.rlib:solana_sysvar-c6af7c337840e4d5.solana_sysvar.e408d825b6767955-cgu.0.rcgu.o(".text._ZN13solana_sysvar4rent69_$LT$impl$u20$solana_sysvar..Sysvar$u20$for$u20$solana_rent..Rent$GT$3get17he8a7a539e26c7ed3E")
    *libsolana_cpi-0ef637a7db82dbb1.rlib:solana_cpi-0ef637a7db82dbb1.solana_cpi.6586607b4abff706-cgu.0.rcgu.o(".text._ZN10solana_cpi15set_return_data17hbadd903892032de6E")
    *libsolana_program_entrypoint-26cd7175e3813a76.rlib:solana_program_entrypoint-26cd7175e3813a76.solana_program_entrypoint.c79bd6abb5f8200a-cgu.0.rcgu.o(".text._ZN5alloc7raw_vec11finish_grow17h4eadd3f0b9d1d0f8E")
    *libsolana_program_entrypoint-26cd7175e3813a76.rlib:solana_program_entrypoint-26cd7175e3813a76.solana_program_entrypoint.c79bd6abb5f8200a-cgu.0.rcgu.o(".text._ZN5alloc7raw_vec19RawVec$LT$T$C$A$GT$8grow_one17ha139cfa28fd5c607E")
    *libsolana_program_entrypoint-26cd7175e3813a76.rlib:solana_program_entrypoint-26cd7175e3813a76.solana_program_entrypoint.c79bd6abb5f8200a-cgu.0.rcgu.o(".text._ZN25solana_program_entrypoint11deserialize17h177438f4eaf4371dE")
    *libsolana_system_interface-67a6489d43908d38.rlib:solana_system_interface-67a6489d43908d38.solana_system_interface.9641b87559abc9c7-cgu.0.rcgu.o(".text._ZN13solana_pubkey1_78_$LT$impl$u20$serde_core..ser..Serialize$u20$for$u20$solana_pubkey..Pubkey$GT$9serialize17h514b0ab55ccff16cE")
    *libsolana_system_interface-67a6489d43908d38.rlib:solana_system_interface-67a6489d43908d38.solana_system_interface.9641b87559abc9c7-cgu.0.rcgu.o(".text._ZN18solana_instruction11Instruction16new_with_bincode17h73ff48dc7a7489d0E")
    *libsolana_system_interface-67a6489d43908d38.rlib:solana_system_interface-67a6489d43908d38.solana_system_interface.9641b87559abc9c7-cgu.0.rcgu.o(".text._ZN42_$LT$$RF$T$u20$as$u20$core..fmt..Debug$GT$3fmt17hee1a0efb47df6ce6E")
    *libsolana_system_interface-67a6489d43908d38.rlib:solana_system_interface-67a6489d43908d38.solana_system_interface.9641b87559abc9c7-cgu.0.rcgu.o(".text._ZN42_$LT$$RF$T$u20$as$u20$core..fmt..Debug$GT$3fmt17h8218823f8c10321cE")
    *libsolana_system_interface-67a6489d43908d38.rlib:solana_system_interface-67a6489d43908d38.solana_system_interface.9641b87559abc9c7-cgu.0.rcgu.o(".text._ZN42_$LT$$RF$T$u20$as$u20$core..fmt..Debug$GT$3fmt17h63aada071c3bcd96E")
    *libsolana_system_interface-67a6489d43908d38.rlib:solana_system_interface-67a6489d43908d38.solana_system_interface.9641b87559abc9c7-cgu.0.rcgu.o(".text._ZN42_$LT$$RF$T$u20$as$u20$core..fmt..Debug$GT$3fmt17hddf7816a37c891bfE")
    *libsolana_system_interface-67a6489d43908d38.rlib:solana_system_interface-67a6489d43908d38.solana_system_interface.9641b87559abc9c7-cgu.0.rcgu.o(".text._ZN42_$LT$$RF$T$u20$as$u20$core..fmt..Debug$GT$3fmt17hbfc94be52ed5cebbE")
    *libsolana_system_interface-67a6489d43908d38.rlib:solana_system_interface-67a6489d43908d38.solana_system_interface.9641b87559abc9c7-cgu.0.rcgu.o(".text._ZN42_$LT$$RF$T$u20$as$u20$core..fmt..Debug$GT$3fmt17h9c5ec2923cf851bdE")
    *libsolana_system_interface-67a6489d43908d38.rlib:solana_system_interface-67a6489d43908d38.solana_system_interface.9641b87559abc9c7-cgu.0.rcgu.o(".text._ZN4core3fmt3num52_$LT$impl$u20$core..fmt..Debug$u20$for$u20$usize$GT$3fmt17hb34f657bfee651b7E")
    *libsolana_system_interface-67a6489d43908d38.rlib:solana_system_interface-67a6489d43908d38.solana_system_interface.9641b87559abc9c7-cgu.0.rcgu.o(".text._ZN4core3ptr71drop_in_place$LT$alloc..boxed..Box$LT$bincode..error..ErrorKind$GT$$GT$17hff46ff84aa86e41fE")
    *libsolana_system_interface-67a6489d43908d38.rlib:solana_system_interface-67a6489d43908d38.solana_system_interface.9641b87559abc9c7-cgu.0.rcgu.o(".text._ZN5alloc7raw_vec11finish_grow17h06bd025255860c41E")
    *libsolana_system_interface-67a6489d43908d38.rlib:solana_system_interface-67a6489d43908d38.solana_system_interface.9641b87559abc9c7-cgu.0.rcgu.o(".text.unlikely._ZN5alloc7raw_vec20RawVecInner$LT$A$GT$7reserve21do_reserve_and_handle17ha12cc2f6440945b4E")
    *libsolana_system_interface-67a6489d43908d38.rlib:solana_system_interface-67a6489d43908d38.solana_system_interface.9641b87559abc9c7-cgu.0.rcgu.o(".text._ZN67_$LT$alloc..boxed..Box$LT$T$C$A$GT$$u20$as$u20$core..fmt..Debug$GT$3fmt17h88fb5ef1ad894999E")
    *libsolana_system_interface-67a6489d43908d38.rlib:solana_system_interface-67a6489d43908d38.solana_system_interface.9641b87559abc9c7-cgu.0.rcgu.o(".text._ZN23solana_system_interface11instruction14create_account17h20bdc8d331751448E")
    *libsolana_system_interface-67a6489d43908d38.rlib:solana_system_interface-67a6489d43908d38.solana_system_interface.9641b87559abc9c7-cgu.0.rcgu.o(".text._ZN23solana_system_interface11instruction24create_account_with_seed17hb506292169143b99E")
    *libsolana_system_interface-67a6489d43908d38.rlib:solana_system_interface-67a6489d43908d38.solana_system_interface.9641b87559abc9c7-cgu.0.rcgu.o(".text._ZN23solana_system_interface11instruction6assign17h9bd5e5c267ec3237E")
    *libsolana_system_interface-67a6489d43908d38.rlib:solana_system_interface-67a6489d43908d38.solana_system_interface.9641b87559abc9c7-cgu.0.rcgu.o(".text._ZN23solana_system_interface11instruction8transfer17hcc9c3c370861c11dE")
    *libsolana_system_interface-67a6489d43908d38.rlib:solana_system_interface-67a6489d43908d38.solana_system_interface.9641b87559abc9c7-cgu.0.rcgu.o(".text._ZN23solana_system_interface11instruction8allocate17h9608aac1f98f5900E")
    *libsolana_rent-50dbfe50f940ab63.rlib:solana_rent-50dbfe50f940ab63.solana_rent.45d39e9f2976a002-cgu.0.rcgu.o(".text._ZN11solana_rent4Rent15minimum_balance17hd8edc1144b1c911eE")
    *libsolana_rent-50dbfe50f940ab63.rlib:solana_rent-50dbfe50f940ab63.solana_rent.45d39e9f2976a002-cgu.0.rcgu.o(".text._ZN11solana_rent4Rent9is_exempt17h943dd7ef546de1f3E")
    *libsolana_account_info-06aef04b95b0800b.rlib:solana_account_info-06aef04b95b0800b.solana_account_info.eb5d856af04cbc17-cgu.0.rcgu.o(".text._ZN19solana_account_info11AccountInfo8lamports17h17ee8789180baa28E")
    *libsolana_account_info-06aef04b95b0800b.rlib:solana_account_info-06aef04b95b0800b.solana_account_info.eb5d856af04cbc17-cgu.0.rcgu.o(".text._ZN19solana_account_info11AccountInfo8data_len17h577edad428228cfbE")
    *libsolana_account_info-06aef04b95b0800b.rlib:solana_account_info-06aef04b95b0800b.solana_account_info.eb5d856af04cbc17-cgu.0.rcgu.o(".text._ZN19solana_account_info11AccountInfo12try_data_len17h483ef5297d922238E")
    *libsolana_account_info-06aef04b95b0800b.rlib:solana_account_info-06aef04b95b0800b.solana_account_info.eb5d856af04cbc17-cgu.0.rcgu.o(".text._ZN19solana_account_info11AccountInfo13data_is_empty17h045180529e53b8c8E")
    *libsolana_account_info-06aef04b95b0800b.rlib:solana_account_info-06aef04b95b0800b.solana_account_info.eb5d856af04cbc17-cgu.0.rcgu.o(".text._ZN19solana_account_info11AccountInfo19try_borrow_lamports17hf1c28fbcbe17033fE")
    *libsolana_account_info-06aef04b95b0800b.rlib:solana_account_info-06aef04b95b0800b.solana_account_info.eb5d856af04cbc17-cgu.0.rcgu.o(".text._ZN19solana_account_info11AccountInfo15try_borrow_data17hfeed61d3c3b43d2dE")
    *libsolana_account_info-06aef04b95b0800b.rlib:solana_account_info-06aef04b95b0800b.solana_account_info.eb5d856af04cbc17-cgu.0.rcgu.o(".text._ZN19solana_account_info11AccountInfo6resize17h3cb1fa5724b2e690E")
    *libsolana_account_info-06aef04b95b0800b.rlib:solana_account_info-06aef04b95b0800b.solana_account_info.eb5d856af04cbc17-cgu.0.rcgu.o(".text._ZN19solana_account_info11AccountInfo6assign17h8e04f282f061a23bE")
    *libsolana_program_error-93c094557a8433ef.rlib:solana_program_error-93c094557a8433ef.solana_program_error.e4691928e786d911-cgu.0.rcgu.o(".text._ZN44_$LT$$RF$T$u20$as$u20$core..fmt..Display$GT$3fmt17ha8f6d509b8828a51E")
    *libsolana_program_error-93c094557a8433ef.rlib:solana_program_error-93c094557a8433ef.solana_program_error.e4691928e786d911-cgu.0.rcgu.o(".text._ZN45_$LT$$RF$T$u20$as$u20$core..fmt..LowerHex$GT$3fmt17hdeb5fa9ce9f6ed03E")
    *libsolana_program_error-93c094557a8433ef.rlib:solana_program_error-93c094557a8433ef.solana_program_error.e4691928e786d911-cgu.0.rcgu.o(".text._ZN73_$LT$solana_program_error..ProgramError$u20$as$u20$core..fmt..Display$GT$3fmt17he66b5e2a20254172E")
    *libsolana_program_error-93c094557a8433ef.rlib:solana_program_error-93c094557a8433ef.solana_program_error.e4691928e786d911-cgu.0.rcgu.o(".text._ZN20solana_program_error95_$LT$impl$u20$core..convert..From$LT$solana_program_error..ProgramError$GT$$u20$for$u20$u64$GT$4from17h11a7991909b3f5deE")
    *libsolana_program_error-93c094557a8433ef.rlib:solana_program_error-93c094557a8433ef.solana_program_error.e4691928e786d911-cgu.0.rcgu.o(".text._ZN85_$LT$solana_program_error..ProgramError$u20$as$u20$core..convert..From$LT$u64$GT$$GT$4from17h5ad9e47897e24c6aE")
    *libsolana_instruction-c46bd5154f2f2176.rlib:solana_instruction-c46bd5154f2f2176.solana_instruction.36205c7e6990d29d-cgu.0.rcgu.o(".text._ZN18solana_instruction11Instruction14new_with_bytes17h70db9a87c0de930bE")
    *libsolana_pubkey-c89ed04981fb1773.rlib:solana_pubkey-c89ed04981fb1773.solana_pubkey.1f9877e3ebdd9c3a-cgu.0.rcgu.o(".text._ZN13solana_pubkey6Pubkey16create_with_seed17hbc8c0a3220ca887dE")
    *libsolana_pubkey-c89ed04981fb1773.rlib:solana_pubkey-c89ed04981fb1773.solana_pubkey.1f9877e3ebdd9c3a-cgu.0.rcgu.o(".text._ZN13solana_pubkey6Pubkey20find_program_address17h40f577ac7ea49283E")
    *libsolana_pubkey-c89ed04981fb1773.rlib:solana_pubkey-c89ed04981fb1773.solana_pubkey.1f9877e3ebdd9c3a-cgu.0.rcgu.o(".text._ZN13solana_pubkey6Pubkey22create_program_address17h2cb287e598e4020aE")
    *libsolana_pubkey-c89ed04981fb1773.rlib:solana_pubkey-c89ed04981fb1773.solana_pubkey.1f9877e3ebdd9c3a-cgu.0.rcgu.o(".text._ZN13solana_pubkey6Pubkey3log17h126492e71e6a275dE")
    *libsolana_pubkey-c89ed04981fb1773.rlib:solana_pubkey-c89ed04981fb1773.solana_pubkey.1f9877e3ebdd9c3a-cgu.0.rcgu.o(".text._ZN13solana_pubkey15write_as_base5817hbf6f671151c038b5E")
    *libsolana_pubkey-c89ed04981fb1773.rlib:solana_pubkey-c89ed04981fb1773.solana_pubkey.1f9877e3ebdd9c3a-cgu.0.rcgu.o(".text._ZN58_$LT$solana_pubkey..Pubkey$u20$as$u20$core..fmt..Debug$GT$3fmt17h52b086c22b0bfe1cE")
    *libborsh-a5a7011785ea3982.rlib:borsh-a5a7011785ea3982.borsh.34311099cb07a7ca-cgu.0.rcgu.o(".text._ZN3std2io5error14repr_bitpacked14kind_from_prim17h92fe7ecc88b028dfE")
    *libborsh-a5a7011785ea3982.rlib:borsh-a5a7011785ea3982.borsh.34311099cb07a7ca-cgu.0.rcgu.o(".text._ZN3std2io5error5Error3new17hefe5563d49b733f3E")
    *libborsh-a5a7011785ea3982.rlib:borsh-a5a7011785ea3982.borsh.34311099cb07a7ca-cgu.0.rcgu.o(".text._ZN4core3ptr238drop_in_place$LT$alloc..boxed..convert..$LT$impl$u20$core..convert..From$LT$alloc..string..String$GT$$u20$for$u20$alloc..boxed..Box$LT$dyn$u20$core..error..Error$u2b$core..marker..Sync$u2b$core..marker..Send$GT$$GT$..from..StringError$GT$17h7c6e85227388f641E")
    *libborsh-a5a7011785ea3982.rlib:borsh-a5a7011785ea3982.borsh.34311099cb07a7ca-cgu.0.rcgu.o(".text._ZN4core5error5Error5cause17h1f2c30f231356dbeE")
    *libborsh-a5a7011785ea3982.rlib:borsh-a5a7011785ea3982.borsh.34311099cb07a7ca-cgu.0.rcgu.o(".text._ZN4core5error5Error7provide17hdde07b02953ebc43E")
    *libborsh-a5a7011785ea3982.rlib:borsh-a5a7011785ea3982.borsh.34311099cb07a7ca-cgu.0.rcgu.o(".text._ZN4core5error5Error7type_id17hea324c56ebe6eb15E")
    *libborsh-a5a7011785ea3982.rlib:borsh-a5a7011785ea3982.borsh.34311099cb07a7ca-cgu.0.rcgu.o(".text._ZN5borsh2de44unexpected_eof_to_unexpected_length_of_input17hd6eda515e7f4fc7aE")
    *libsolana_sha256_hasher-87a021811b65a912.rlib:solana_sha256_hasher-87a021811b65a912.solana_sha256_hasher.4ce48a26874e65f0-cgu.0.rcgu.o(".text._ZN20solana_sha256_hasher5hashv17h84fe63c6c67cf6f8E")
    *libstd-0f02fa4f6c0db083.rlib:std-0f02fa4f6c0db083.std.a5fda89f1476700d-cgu.0.rcgu.o(".text._ZN42_$LT$$RF$T$u20$as$u20$core..fmt..Debug$GT$3fmt17hea3b92dc98917970E")
    *libstd-0f02fa4f6c0db083.rlib:std-0f02fa4f6c0db083.std.a5fda89f1476700d-cgu.0.rcgu.o(".text._ZN4core3fmt3num50_$LT$impl$u20$core..fmt..Debug$u20$for$u20$i32$GT$3fmt17h16bcced659abf0cdE")
    *libstd-0f02fa4f6c0db083.rlib:std-0f02fa4f6c0db083.std.a5fda89f1476700d-cgu.0.rcgu.o(".text._ZN4core3ptr238drop_in_place$LT$alloc..boxed..convert..$LT$impl$u20$core..convert..From$LT$alloc..string..String$GT$$u20$for$u20$alloc..boxed..Box$LT$dyn$u20$core..error..Error$u2b$core..marker..Sync$u2b$core..marker..Send$GT$$GT$..from..StringError$GT$17h8099dc33aa6b6308E")
    *libstd-0f02fa4f6c0db083.rlib:std-0f02fa4f6c0db083.std.a5fda89f1476700d-cgu.0.rcgu.o(".text._ZN58_$LT$alloc..string..String$u20$as$u20$core..fmt..Debug$GT$3fmt17he29af01eecd487ddE")
    *libstd-0f02fa4f6c0db083.rlib:std-0f02fa4f6c0db083.std.a5fda89f1476700d-cgu.0.rcgu.o(".text._ZN3std2io5error14repr_bitpacked14kind_from_prim17h92fe7ecc88b028dfE")
    *libstd-0f02fa4f6c0db083.rlib:std-0f02fa4f6c0db083.std.a5fda89f1476700d-cgu.0.rcgu.o(".text._ZN58_$LT$std..io..error..Error$u20$as$u20$core..fmt..Debug$GT$3fmt17h532bf5e639c9bad4E")
    *libstd-0f02fa4f6c0db083.rlib:std-0f02fa4f6c0db083.std.a5fda89f1476700d-cgu.0.rcgu.o(".text._ZN3std2io5error5Error4_new17hc244825f79c4c0bcE")
    *libstd-0f02fa4f6c0db083.rlib:std-0f02fa4f6c0db083.std.a5fda89f1476700d-cgu.0.rcgu.o(".text._ZN3std2io5error83_$LT$impl$u20$core..fmt..Debug$u20$for$u20$std..io..error..repr_bitpacked..Repr$GT$3fmt17h9e94103c5533fbfbE")
    *libstd-0f02fa4f6c0db083.rlib:std-0f02fa4f6c0db083.std.a5fda89f1476700d-cgu.0.rcgu.o(".text.unlikely._ZN3std7process5abort17h5243fa3171509297E")
    *libstd-0f02fa4f6c0db083.rlib:std-0f02fa4f6c0db083.std.a5fda89f1476700d-cgu.0.rcgu.o(".text.rust_begin_unwind")
    *libstd-0f02fa4f6c0db083.rlib:std-0f02fa4f6c0db083.std.a5fda89f1476700d-cgu.0.rcgu.o(".text._ZN62_$LT$std..io..error..ErrorKind$u20$as$u20$core..fmt..Debug$GT$3fmt17ha2dba8f8d24e470aE")
    *libstd-0f02fa4f6c0db083.rlib:std-0f02fa4f6c0db083.std.a5fda89f1476700d-cgu.0.rcgu.o(".text._ZN3std3sys3pal3sbf2os12error_string17h2e3adc5b9e6a61bfE")
    *libstd-0f02fa4f6c0db083.rlib:std-0f02fa4f6c0db083.std.a5fda89f1476700d-cgu.0.rcgu.o(".text._ZN3std3sys3pal3sbf7sol_log17h7c3fa49b67dd8cddE")
    *libstd-0f02fa4f6c0db083.rlib:std-0f02fa4f6c0db083.std.a5fda89f1476700d-cgu.0.rcgu.o(".text._ZN3std3sys3pal3sbf5panic17h0b9cc6b6e89f5028E")
    *libstd-0f02fa4f6c0db083.rlib:std-0f02fa4f6c0db083.std.a5fda89f1476700d-cgu.0.rcgu.o(".text._ZN3std3sys3pal3sbf14abort_internal17hc9219cc351182d06E")
    *libstd-0f02fa4f6c0db083.rlib:std-0f02fa4f6c0db083.std.a5fda89f1476700d-cgu.0.rcgu.o(".text._ZN3std5alloc8rust_oom17h8692f0979a495416E")
    *libstd-0f02fa4f6c0db083.rlib:std-0f02fa4f6c0db083.std.a5fda89f1476700d-cgu.0.rcgu.o(".text.__rg_oom")
    *liballoc-dc3bf3e87d3d7094.rlib:alloc-dc3bf3e87d3d7094.alloc.bea306f2d63a01f0-cgu.0.rcgu.o(".text._ZN42_$LT$$RF$T$u20$as$u20$core..fmt..Debug$GT$3fmt17he0151818262ca042E")
    *liballoc-dc3bf3e87d3d7094.rlib:alloc-dc3bf3e87d3d7094.alloc.bea306f2d63a01f0-cgu.0.rcgu.o(".text._ZN4core3fmt5Write9write_fmt17hce3174e97d67e925E")
    *liballoc-dc3bf3e87d3d7094.rlib:alloc-dc3bf3e87d3d7094.alloc.bea306f2d63a01f0-cgu.0.rcgu.o(".text._ZN4core3ptr42drop_in_place$LT$alloc..string..String$GT$17h85196e35dbaff974E")
    *liballoc-dc3bf3e87d3d7094.rlib:alloc-dc3bf3e87d3d7094.alloc.bea306f2d63a01f0-cgu.0.rcgu.o(".text._ZN53_$LT$core..fmt..Error$u20$as$u20$core..fmt..Debug$GT$3fmt17hde1f1ab10afbbf92E")
    *liballoc-dc3bf3e87d3d7094.rlib:alloc-dc3bf3e87d3d7094.alloc.bea306f2d63a01f0-cgu.0.rcgu.o(".text._ZN5alloc7raw_vec17capacity_overflow17h79bc6a5bb6ecab54E")
    *liballoc-dc3bf3e87d3d7094.rlib:alloc-dc3bf3e87d3d7094.alloc.bea306f2d63a01f0-cgu.0.rcgu.o(".text._ZN5alloc7raw_vec19RawVec$LT$T$C$A$GT$8grow_one17h541dd01837ce01acE")
    *liballoc-dc3bf3e87d3d7094.rlib:alloc-dc3bf3e87d3d7094.alloc.bea306f2d63a01f0-cgu.0.rcgu.o(".text._ZN77_$LT$alloc..raw_vec..RawVec$LT$T$C$A$GT$$u20$as$u20$core..ops..drop..Drop$GT$4drop17hdeda3651aef8a278E")
    *liballoc-dc3bf3e87d3d7094.rlib:alloc-dc3bf3e87d3d7094.alloc.bea306f2d63a01f0-cgu.0.rcgu.o(".text._ZN5alloc7raw_vec20RawVecInner$LT$A$GT$15try_allocate_in17hdc45092cf2829890E")
    *liballoc-dc3bf3e87d3d7094.rlib:alloc-dc3bf3e87d3d7094.alloc.bea306f2d63a01f0-cgu.0.rcgu.o(".text.unlikely._ZN5alloc7raw_vec20RawVecInner$LT$A$GT$7reserve21do_reserve_and_handle17h4dac848c9a2883a3E")
    *liballoc-dc3bf3e87d3d7094.rlib:alloc-dc3bf3e87d3d7094.alloc.bea306f2d63a01f0-cgu.0.rcgu.o(".text._ZN5alloc7raw_vec20RawVecInner$LT$A$GT$14grow_amortized17hfb19797630f8ab49E")
    *liballoc-dc3bf3e87d3d7094.rlib:alloc-dc3bf3e87d3d7094.alloc.bea306f2d63a01f0-cgu.0.rcgu.o(".text._ZN5alloc7raw_vec11finish_grow17h23fdd3baba0ce75bE")
    *liballoc-dc3bf3e87d3d7094.rlib:alloc-dc3bf3e87d3d7094.alloc.bea306f2d63a01f0-cgu.0.rcgu.o(".text.unlikely._ZN5alloc7raw_vec12handle_error17hbf6197bd6069e92aE")
    *liballoc-dc3bf3e87d3d7094.rlib:alloc-dc3bf3e87d3d7094.alloc.bea306f2d63a01f0-cgu.0.rcgu.o(".text.unlikely._ZN5alloc5alloc18handle_alloc_error17ha87cfc9b8cb79374E")
    *liballoc-dc3bf3e87d3d7094.rlib:alloc-dc3bf3e87d3d7094.alloc.bea306f2d63a01f0-cgu.0.rcgu.o(".text._ZN256_$LT$alloc..boxed..convert..$LT$impl$u20$core..convert..From$LT$alloc..string..String$GT$$u20$for$u20$alloc..boxed..Box$LT$dyn$u20$core..error..Error$u2b$core..marker..Sync$u2b$core..marker..Send$GT$$GT$..from..StringError$u20$as$u20$core..error..Error$GT$11description17h4294b359187fbcb8E")
    *liballoc-dc3bf3e87d3d7094.rlib:alloc-dc3bf3e87d3d7094.alloc.bea306f2d63a01f0-cgu.0.rcgu.o(".text._ZN256_$LT$alloc..boxed..convert..$LT$impl$u20$core..convert..From$LT$alloc..string..String$GT$$u20$for$u20$alloc..boxed..Box$LT$dyn$u20$core..error..Error$u2b$core..marker..Sync$u2b$core..marker..Send$GT$$GT$..from..StringError$u20$as$u20$core..fmt..Display$GT$3fmt17h03f27c1f4de4d72bE")
    *liballoc-dc3bf3e87d3d7094.rlib:alloc-dc3bf3e87d3d7094.alloc.bea306f2d63a01f0-cgu.0.rcgu.o(".text._ZN254_$LT$alloc..boxed..convert..$LT$impl$u20$core..convert..From$LT$alloc..string..String$GT$$u20$for$u20$alloc..boxed..Box$LT$dyn$u20$core..error..Error$u2b$core..marker..Sync$u2b$core..marker..Send$GT$$GT$..from..StringError$u20$as$u20$core..fmt..Debug$GT$3fmt17h9961eca1c565ec26E")
    *liballoc-dc3bf3e87d3d7094.rlib:alloc-dc3bf3e87d3d7094.alloc.bea306f2d63a01f0-cgu.0.rcgu.o(".text._ZN5alloc3fmt6format12format_inner17hee135e54100b7586E")
    *liballoc-dc3bf3e87d3d7094.rlib:alloc-dc3bf3e87d3d7094.alloc.bea306f2d63a01f0-cgu.0.rcgu.o(".text._ZN67_$LT$alloc..string..FromUtf8Error$u20$as$u20$core..fmt..Display$GT$3fmt17hbfaa8c2148ac5ca1E")
    *liballoc-dc3bf3e87d3d7094.rlib:alloc-dc3bf3e87d3d7094.alloc.bea306f2d63a01f0-cgu.0.rcgu.o(".text._ZN60_$LT$alloc..string..String$u20$as$u20$core..clone..Clone$GT$5clone17h51f392585751e9c2E")
    *liballoc-dc3bf3e87d3d7094.rlib:alloc-dc3bf3e87d3d7094.alloc.bea306f2d63a01f0-cgu.0.rcgu.o(".text._ZN58_$LT$alloc..string..String$u20$as$u20$core..fmt..Write$GT$9write_str17h5448a1b581b20374E")
    *liballoc-dc3bf3e87d3d7094.rlib:alloc-dc3bf3e87d3d7094.alloc.bea306f2d63a01f0-cgu.0.rcgu.o(".text._ZN58_$LT$alloc..string..String$u20$as$u20$core..fmt..Write$GT$10write_char17hbf1d9fc611d850b0E")
    *liballoc-dc3bf3e87d3d7094.rlib:alloc-dc3bf3e87d3d7094.alloc.bea306f2d63a01f0-cgu.0.rcgu.o(".text._ZN67_$LT$alloc..vec..Vec$LT$T$C$A$GT$$u20$as$u20$core..clone..Clone$GT$5clone17h810d88d4905d49b2E")
    *liballoc-dc3bf3e87d3d7094.rlib:alloc-dc3bf3e87d3d7094.alloc.bea306f2d63a01f0-cgu.0.rcgu.o(".text._ZN70_$LT$alloc..vec..Vec$LT$T$C$A$GT$$u20$as$u20$core..ops..drop..Drop$GT$4drop17h5fb2d2c7b362abedE")
    *libcore-df2f94031a6f96fd.rlib:core-df2f94031a6f96fd.core.7a381ca89f2cf5f-cgu.0.rcgu.o(".text._ZN71_$LT$core..ops..range..Range$LT$Idx$GT$$u20$as$u20$core..fmt..Debug$GT$3fmt17hb52e1514a635204eE")
    *libcore-df2f94031a6f96fd.rlib:core-df2f94031a6f96fd.core.7a381ca89f2cf5f-cgu.0.rcgu.o(".text._ZN60_$LT$core..cell..BorrowError$u20$as$u20$core..fmt..Debug$GT$3fmt17h37fd5090231eb4faE")
    *libcore-df2f94031a6f96fd.rlib:core-df2f94031a6f96fd.core.7a381ca89f2cf5f-cgu.0.rcgu.o(".text._ZN63_$LT$core..cell..BorrowMutError$u20$as$u20$core..fmt..Debug$GT$3fmt17hcc1216da1fd1d2a2E")
    *libcore-df2f94031a6f96fd.rlib:core-df2f94031a6f96fd.core.7a381ca89f2cf5f-cgu.0.rcgu.o(".text.unlikely._ZN4core4cell22panic_already_borrowed17ha2f06d0ca19d2d9fE")
    *libcore-df2f94031a6f96fd.rlib:core-df2f94031a6f96fd.core.7a381ca89f2cf5f-cgu.0.rcgu.o(".text.unlikely._ZN4core4cell30panic_already_mutably_borrowed17h08f457cd07756ae7E")
    *libcore-df2f94031a6f96fd.rlib:core-df2f94031a6f96fd.core.7a381ca89f2cf5f-cgu.0.rcgu.o(".text._ZN62_$LT$core..char..EscapeDebug$u20$as$u20$core..fmt..Display$GT$3fmt17h890de2c59a9fcf80E")
    *libcore-df2f94031a6f96fd.rlib:core-df2f94031a6f96fd.core.7a381ca89f2cf5f-cgu.0.rcgu.o(".text.unlikely._ZN4core6option13unwrap_failed17h49c6d1bce003dd3dE")
    *libcore-df2f94031a6f96fd.rlib:core-df2f94031a6f96fd.core.7a381ca89f2cf5f-cgu.0.rcgu.o(".text.unlikely._ZN4core6option13expect_failed17hd3d1b3c37c177a30E")
    *libcore-df2f94031a6f96fd.rlib:core-df2f94031a6f96fd.core.7a381ca89f2cf5f-cgu.0.rcgu.o(".text._ZN73_$LT$core..panic..panic_info..PanicInfo$u20$as$u20$core..fmt..Display$GT$3fmt17hd2d0a9f2e6aae4feE")
    *libcore-df2f94031a6f96fd.rlib:core-df2f94031a6f96fd.core.7a381ca89f2cf5f-cgu.0.rcgu.o(".text.unlikely._ZN4core9panicking9panic_fmt17ha4a6c4ba8141afc1E")
    *libcore-df2f94031a6f96fd.rlib:core-df2f94031a6f96fd.core.7a381ca89f2cf5f-cgu.0.rcgu.o(".text.unlikely._ZN4core9panicking5panic17he4f343d4dff1ad06E")
    *libcore-df2f94031a6f96fd.rlib:core-df2f94031a6f96fd.core.7a381ca89f2cf5f-cgu.0.rcgu.o(".text.unlikely._ZN4core9panicking18panic_bounds_check17hbf9d22ffdbdf6731E")
    *libcore-df2f94031a6f96fd.rlib:core-df2f94031a6f96fd.core.7a381ca89f2cf5f-cgu.0.rcgu.o(".text.unlikely._ZN4core6result13unwrap_failed17hc82e07e24346d732E")
    *libcore-df2f94031a6f96fd.rlib:core-df2f94031a6f96fd.core.7a381ca89f2cf5f-cgu.0.rcgu.o(".text._ZN68_$LT$core..fmt..builders..PadAdapter$u20$as$u20$core..fmt..Write$GT$9write_str17ha650cc359dbbb8d4E")
    *libcore-df2f94031a6f96fd.rlib:core-df2f94031a6f96fd.core.7a381ca89f2cf5f-cgu.0.rcgu.o(".text._ZN68_$LT$core..fmt..builders..PadAdapter$u20$as$u20$core..fmt..Write$GT$10write_char17h8c15471f94103f7eE")
    *libcore-df2f94031a6f96fd.rlib:core-df2f94031a6f96fd.core.7a381ca89f2cf5f-cgu.0.rcgu.o(".text._ZN4core3fmt8builders11DebugStruct5field17h90dd43337b795aa0E")
    *libcore-df2f94031a6f96fd.rlib:core-df2f94031a6f96fd.core.7a381ca89f2cf5f-cgu.0.rcgu.o(".text._ZN4core3fmt8builders11DebugStruct10field_with17h8f89ab8a6d2347adE")
    *libcore-df2f94031a6f96fd.rlib:core-df2f94031a6f96fd.core.7a381ca89f2cf5f-cgu.0.rcgu.o(".text._ZN4core3fmt8builders11DebugStruct6finish17h8dac566c082ddb06E")
    *libcore-df2f94031a6f96fd.rlib:core-df2f94031a6f96fd.core.7a381ca89f2cf5f-cgu.0.rcgu.o(".text._ZN4core3fmt8builders10DebugTuple5field17hfd574c8542f8f7eeE")
    *libcore-df2f94031a6f96fd.rlib:core-df2f94031a6f96fd.core.7a381ca89f2cf5f-cgu.0.rcgu.o(".text._ZN4core3fmt8builders10DebugTuple10field_with17h1d6015b7dac68563E")
    *libcore-df2f94031a6f96fd.rlib:core-df2f94031a6f96fd.core.7a381ca89f2cf5f-cgu.0.rcgu.o(".text._ZN4core3fmt8builders10DebugTuple6finish17h9e11c8fc8d1954aeE")
    *libcore-df2f94031a6f96fd.rlib:core-df2f94031a6f96fd.core.7a381ca89f2cf5f-cgu.0.rcgu.o(".text._ZN4core3fmt3num12GenericRadix7fmt_int17h2b310b3f2f4c2067E")
    *libcore-df2f94031a6f96fd.rlib:core-df2f94031a6f96fd.core.7a381ca89f2cf5f-cgu.0.rcgu.o(".text._ZN4core3fmt3num12GenericRadix7fmt_int17h809664ed81bd3a31E")
    *libcore-df2f94031a6f96fd.rlib:core-df2f94031a6f96fd.core.7a381ca89f2cf5f-cgu.0.rcgu.o(".text._ZN4core3fmt3num12GenericRadix7fmt_int17h8ef53353a3ec99f4E")
    *libcore-df2f94031a6f96fd.rlib:core-df2f94031a6f96fd.core.7a381ca89f2cf5f-cgu.0.rcgu.o(".text._ZN4core3fmt3num12GenericRadix7fmt_int17h98ed51c4be3e323fE")
    *libcore-df2f94031a6f96fd.rlib:core-df2f94031a6f96fd.core.7a381ca89f2cf5f-cgu.0.rcgu.o(".text._ZN4core3fmt3num12GenericRadix7fmt_int17hb022b77474673b87E")
    *libcore-df2f94031a6f96fd.rlib:core-df2f94031a6f96fd.core.7a381ca89f2cf5f-cgu.0.rcgu.o(".text._ZN4core3fmt3num12GenericRadix7fmt_int17hb6982fac47c41e2fE")
    *libcore-df2f94031a6f96fd.rlib:core-df2f94031a6f96fd.core.7a381ca89f2cf5f-cgu.0.rcgu.o(".text._ZN4core3fmt5Write9write_fmt17h6c0bd0e5662a6bf4E")
    *libcore-df2f94031a6f96fd.rlib:core-df2f94031a6f96fd.core.7a381ca89f2cf5f-cgu.0.rcgu.o(".text._ZN4core3fmt5write17h6a241f3daa234c27E")
    *libcore-df2f94031a6f96fd.rlib:core-df2f94031a6f96fd.core.7a381ca89f2cf5f-cgu.0.rcgu.o(".text._ZN4core3fmt9Formatter12pad_integral17hdc9f09e04df65e22E")
    *libcore-df2f94031a6f96fd.rlib:core-df2f94031a6f96fd.core.7a381ca89f2cf5f-cgu.0.rcgu.o(".text._ZN4core3fmt9Formatter12pad_integral12write_prefix17hb97083af731966f1E")
    *libcore-df2f94031a6f96fd.rlib:core-df2f94031a6f96fd.core.7a381ca89f2cf5f-cgu.0.rcgu.o(".text._ZN4core3fmt9Formatter3pad17hcdc9ed8fef2b8973E")
    *libcore-df2f94031a6f96fd.rlib:core-df2f94031a6f96fd.core.7a381ca89f2cf5f-cgu.0.rcgu.o(".text._ZN4core3fmt9Formatter7padding17h857bbf56ecb4473cE")
    *libcore-df2f94031a6f96fd.rlib:core-df2f94031a6f96fd.core.7a381ca89f2cf5f-cgu.0.rcgu.o(".text._ZN4core3fmt9Formatter9write_str17h2607398d24539386E")
    *libcore-df2f94031a6f96fd.rlib:core-df2f94031a6f96fd.core.7a381ca89f2cf5f-cgu.0.rcgu.o(".text._ZN4core3fmt9Formatter12debug_struct17h5a60fd1fd000f021E")
    *libcore-df2f94031a6f96fd.rlib:core-df2f94031a6f96fd.core.7a381ca89f2cf5f-cgu.0.rcgu.o(".text._ZN4core3fmt9Formatter26debug_struct_field2_finish17h825879940e06a1b7E")
    *libcore-df2f94031a6f96fd.rlib:core-df2f94031a6f96fd.core.7a381ca89f2cf5f-cgu.0.rcgu.o(".text._ZN4core3fmt9Formatter11debug_tuple17h2891c2004c2608e7E")
    *libcore-df2f94031a6f96fd.rlib:core-df2f94031a6f96fd.core.7a381ca89f2cf5f-cgu.0.rcgu.o(".text._ZN4core3fmt9Formatter25debug_tuple_field1_finish17h730ef7125678741dE")
    *libcore-df2f94031a6f96fd.rlib:core-df2f94031a6f96fd.core.7a381ca89f2cf5f-cgu.0.rcgu.o(".text._ZN40_$LT$str$u20$as$u20$core..fmt..Debug$GT$3fmt17h2aa353688760a10dE")
    *libcore-df2f94031a6f96fd.rlib:core-df2f94031a6f96fd.core.7a381ca89f2cf5f-cgu.0.rcgu.o(".text._ZN42_$LT$str$u20$as$u20$core..fmt..Display$GT$3fmt17ha7660963738b5aa0E")
    *libcore-df2f94031a6f96fd.rlib:core-df2f94031a6f96fd.core.7a381ca89f2cf5f-cgu.0.rcgu.o(".text._ZN41_$LT$char$u20$as$u20$core..fmt..Debug$GT$3fmt17h7f5730143d2b215fE")
    *libcore-df2f94031a6f96fd.rlib:core-df2f94031a6f96fd.core.7a381ca89f2cf5f-cgu.0.rcgu.o(".text._ZN4core5slice6memchr14memchr_aligned17hf2fb38846c76d079E")
    *libcore-df2f94031a6f96fd.rlib:core-df2f94031a6f96fd.core.7a381ca89f2cf5f-cgu.0.rcgu.o(".text._ZN4core5slice4sort6stable5drift11sqrt_approx17h18eaa7964ccd41cbE")
    *libcore-df2f94031a6f96fd.rlib:core-df2f94031a6f96fd.core.7a381ca89f2cf5f-cgu.0.rcgu.o(".text.unlikely._ZN4core5slice4sort6shared9smallsort22panic_on_ord_violation17h18818527b19ad3eeE")
    *libcore-df2f94031a6f96fd.rlib:core-df2f94031a6f96fd.core.7a381ca89f2cf5f-cgu.0.rcgu.o(".text.unlikely._ZN4core5slice5index26slice_start_index_len_fail17h8e8b449ff941898fE")
    *libcore-df2f94031a6f96fd.rlib:core-df2f94031a6f96fd.core.7a381ca89f2cf5f-cgu.0.rcgu.o(".text.unlikely._ZN4core5slice5index24slice_end_index_len_fail17h4c5089adf1dc3001E")
    *libcore-df2f94031a6f96fd.rlib:core-df2f94031a6f96fd.core.7a381ca89f2cf5f-cgu.0.rcgu.o(".text.unlikely._ZN4core5slice5index22slice_index_order_fail17hc2bc571caabeae51E")
    *libcore-df2f94031a6f96fd.rlib:core-df2f94031a6f96fd.core.7a381ca89f2cf5f-cgu.0.rcgu.o(".text._ZN4core3str8converts9from_utf817hace24f7e7c50c464E")
    *libcore-df2f94031a6f96fd.rlib:core-df2f94031a6f96fd.core.7a381ca89f2cf5f-cgu.0.rcgu.o(".text._ZN4core3str5count14do_count_chars17h4534cdd10be07d67E")
    *libcore-df2f94031a6f96fd.rlib:core-df2f94031a6f96fd.core.7a381ca89f2cf5f-cgu.0.rcgu.o(".text._ZN66_$LT$core..str..error..Utf8Error$u20$as$u20$core..fmt..Display$GT$3fmt17h4a6f200a1ec90e51E")
    *libcore-df2f94031a6f96fd.rlib:core-df2f94031a6f96fd.core.7a381ca89f2cf5f-cgu.0.rcgu.o(".text.unlikely._ZN4core3str16slice_error_fail17h0e553e73325ecdb6E")
    *libcore-df2f94031a6f96fd.rlib:core-df2f94031a6f96fd.core.7a381ca89f2cf5f-cgu.0.rcgu.o(".text._ZN4core3str19slice_error_fail_rt17h77ad82d5d1d84e91E")
    *libcore-df2f94031a6f96fd.rlib:core-df2f94031a6f96fd.core.7a381ca89f2cf5f-cgu.0.rcgu.o(".text._ZN4core7unicode9printable5check17hc31baee057819da1E")
    *libcore-df2f94031a6f96fd.rlib:core-df2f94031a6f96fd.core.7a381ca89f2cf5f-cgu.0.rcgu.o(".text._ZN4core7unicode9printable12is_printable17hfb971d6b773a3238E")
    *libcore-df2f94031a6f96fd.rlib:core-df2f94031a6f96fd.core.7a381ca89f2cf5f-cgu.0.rcgu.o(".text._ZN4core6escape14escape_unicode17h5e94a6b13e5515a7E")
    *libcore-df2f94031a6f96fd.rlib:core-df2f94031a6f96fd.core.7a381ca89f2cf5f-cgu.0.rcgu.o(".text.unlikely._ZN4core9panicking11panic_const24panic_const_add_overflow17h8b8b9126f0a07fd2E")
    *libcore-df2f94031a6f96fd.rlib:core-df2f94031a6f96fd.core.7a381ca89f2cf5f-cgu.0.rcgu.o(".text.unlikely._ZN4core9panicking11panic_const24panic_const_sub_overflow17hcdd04dd50d3acd0cE")
    *libcore-df2f94031a6f96fd.rlib:core-df2f94031a6f96fd.core.7a381ca89f2cf5f-cgu.0.rcgu.o(".text.unlikely._ZN4core9panicking11panic_const24panic_const_mul_overflow17h34fd5d43d8aad9ceE")
    *libcore-df2f94031a6f96fd.rlib:core-df2f94031a6f96fd.core.7a381ca89f2cf5f-cgu.0.rcgu.o(".text._ZN73_$LT$core..fmt..num..LowerHex$u20$as$u20$core..fmt..num..GenericRadix$GT$5digit17hb1a87458a41405cbE")
    *libcore-df2f94031a6f96fd.rlib:core-df2f94031a6f96fd.core.7a381ca89f2cf5f-cgu.0.rcgu.o(".text._ZN73_$LT$core..fmt..num..UpperHex$u20$as$u20$core..fmt..num..GenericRadix$GT$5digit17hdebbfad76ae01e90E")
    *libcore-df2f94031a6f96fd.rlib:core-df2f94031a6f96fd.core.7a381ca89f2cf5f-cgu.0.rcgu.o(".text._ZN4core3fmt3num52_$LT$impl$u20$core..fmt..LowerHex$u20$for$u20$i8$GT$3fmt17h4e933b63ad47632dE")
    *libcore-df2f94031a6f96fd.rlib:core-df2f94031a6f96fd.core.7a381ca89f2cf5f-cgu.0.rcgu.o(".text._ZN4core3fmt3num52_$LT$impl$u20$core..fmt..UpperHex$u20$for$u20$i8$GT$3fmt17h998529b7f6416e18E")
    *libcore-df2f94031a6f96fd.rlib:core-df2f94031a6f96fd.core.7a381ca89f2cf5f-cgu.0.rcgu.o(".text._ZN4core3fmt3num53_$LT$impl$u20$core..fmt..LowerHex$u20$for$u20$i32$GT$3fmt17hb9f325b2d19e3c4cE")
    *libcore-df2f94031a6f96fd.rlib:core-df2f94031a6f96fd.core.7a381ca89f2cf5f-cgu.0.rcgu.o(".text._ZN4core3fmt3num53_$LT$impl$u20$core..fmt..UpperHex$u20$for$u20$i32$GT$3fmt17h35e7adf8015f9050E")
    *libcore-df2f94031a6f96fd.rlib:core-df2f94031a6f96fd.core.7a381ca89f2cf5f-cgu.0.rcgu.o(".text._ZN4core3fmt3num53_$LT$impl$u20$core..fmt..LowerHex$u20$for$u20$i64$GT$3fmt17hd82829896be0596dE")
    *libcore-df2f94031a6f96fd.rlib:core-df2f94031a6f96fd.core.7a381ca89f2cf5f-cgu.0.rcgu.o(".text._ZN4core3fmt3num53_$LT$impl$u20$core..fmt..UpperHex$u20$for$u20$i64$GT$3fmt17h1445a4e65386a882E")
    *libcore-df2f94031a6f96fd.rlib:core-df2f94031a6f96fd.core.7a381ca89f2cf5f-cgu.0.rcgu.o(".text._ZN4core3fmt3num3imp51_$LT$impl$u20$core..fmt..Display$u20$for$u20$u8$GT$3fmt17h78a736d023957aecE")
    *libcore-df2f94031a6f96fd.rlib:core-df2f94031a6f96fd.core.7a381ca89f2cf5f-cgu.0.rcgu.o(".text._ZN4core3fmt3num3imp20_$LT$impl$u20$u8$GT$4_fmt17h41b5e2fc1f8c6a8bE")
    *libcore-df2f94031a6f96fd.rlib:core-df2f94031a6f96fd.core.7a381ca89f2cf5f-cgu.0.rcgu.o(".text._ZN4core3fmt3num3imp52_$LT$impl$u20$core..fmt..Display$u20$for$u20$i32$GT$3fmt17ha3511aa5f89e8a7fE")
    *libcore-df2f94031a6f96fd.rlib:core-df2f94031a6f96fd.core.7a381ca89f2cf5f-cgu.0.rcgu.o(".text._ZN4core3fmt3num3imp52_$LT$impl$u20$core..fmt..Display$u20$for$u20$u32$GT$3fmt17hca8643922c14f78aE")
    *libcore-df2f94031a6f96fd.rlib:core-df2f94031a6f96fd.core.7a381ca89f2cf5f-cgu.0.rcgu.o(".text._ZN4core3fmt3num3imp21_$LT$impl$u20$u32$GT$4_fmt17he8f52e2a671b3304E")
    *libcore-df2f94031a6f96fd.rlib:core-df2f94031a6f96fd.core.7a381ca89f2cf5f-cgu.0.rcgu.o(".text._ZN4core3fmt3num3imp52_$LT$impl$u20$core..fmt..Display$u20$for$u20$u64$GT$3fmt17hb198718d36d08afeE")
    *libcore-df2f94031a6f96fd.rlib:core-df2f94031a6f96fd.core.7a381ca89f2cf5f-cgu.0.rcgu.o(".text._ZN4core3fmt3num3imp21_$LT$impl$u20$u64$GT$4_fmt17h5fb3983a084bd345E")
    *libcore-df2f94031a6f96fd.rlib:core-df2f94031a6f96fd.core.7a381ca89f2cf5f-cgu.0.rcgu.o(".text._ZN42_$LT$$RF$T$u20$as$u20$core..fmt..Debug$GT$3fmt17h156cd705c27ba84eE")
    *libcore-df2f94031a6f96fd.rlib:core-df2f94031a6f96fd.core.7a381ca89f2cf5f-cgu.0.rcgu.o(".text._ZN44_$LT$$RF$T$u20$as$u20$core..fmt..Display$GT$3fmt17h15ddc0af5e4c6acfE")
    *libcore-df2f94031a6f96fd.rlib:core-df2f94031a6f96fd.core.7a381ca89f2cf5f-cgu.0.rcgu.o(".text._ZN4core5slice5index26slice_start_index_len_fail8do_panic7runtime17h6ae28d9df288ffe6E")
    *libcore-df2f94031a6f96fd.rlib:core-df2f94031a6f96fd.core.7a381ca89f2cf5f-cgu.0.rcgu.o(".text._ZN4core5slice5index24slice_end_index_len_fail8do_panic7runtime17hcbef553469ee2f4fE")
    *libcore-df2f94031a6f96fd.rlib:core-df2f94031a6f96fd.core.7a381ca89f2cf5f-cgu.0.rcgu.o(".text._ZN4core5slice5index22slice_index_order_fail8do_panic7runtime17hcbb86a57a944a493E")
    *libcore-df2f94031a6f96fd.rlib:core-df2f94031a6f96fd.core.7a381ca89f2cf5f-cgu.0.rcgu.o(".text._ZN4core7unicode12unicode_data15grapheme_extend11lookup_slow17h99075dd237925af0E")
    *libcompiler_builtins-d7924d72317b3879.rlib:compiler_builtins-d7924d72317b3879.compiler_builtins.e42d3e2e9a5e555c-cgu.078.rcgu.o(".text.memcpy")
    *libcompiler_builtins-d7924d72317b3879.rlib:compiler_builtins-d7924d72317b3879.compiler_builtins.e42d3e2e9a5e555c-cgu.078.rcgu.o(".text.memset")
    *libcompiler_builtins-d7924d72317b3879.rlib:compiler_builtins-d7924d72317b3879.compiler_builtins.e42d3e2e9a5e555c-cgu.078.rcgu.o(".text.memcmp")
    *libcompiler_builtins-d7924d72317b3879.rlib:compiler_builtins-d7924d72317b3879.compiler_builtins.e42d3e2e9a5e555c-cgu.121.rcgu.o(".text.__gtdf2")
    *libcompiler_builtins-d7924d72317b3879.rlib:compiler_builtins-d7924d72317b3879.compiler_builtins.e42d3e2e9a5e555c-cgu.012.rcgu.o(".text._ZN17compiler_builtins5float3cmp3cmp17h6dc37c32129324cbE")
    *libcompiler_builtins-d7924d72317b3879.rlib:compiler_builtins-d7924d72317b3879.compiler_builtins.e42d3e2e9a5e555c-cgu.012.rcgu.o(".text._ZN17compiler_builtins5float3cmp7__gedf217ha69cd366e6a4f2cdE")
    *libcompiler_builtins-d7924d72317b3879.rlib:compiler_builtins-d7924d72317b3879.compiler_builtins.e42d3e2e9a5e555c-cgu.009.rcgu.o(".text._ZN17compiler_builtins3int19specialized_div_rem12u128_div_rem17ha15779c3106e5756E")
    *libcompiler_builtins-d7924d72317b3879.rlib:compiler_builtins-d7924d72317b3879.compiler_builtins.e42d3e2e9a5e555c-cgu.132.rcgu.o(".text.__udivti3")
    *libcompiler_builtins-d7924d72317b3879.rlib:compiler_builtins-d7924d72317b3879.compiler_builtins.e42d3e2e9a5e555c-cgu.005.rcgu.o(".text._ZN17compiler_builtins5float3mul3mul17h8da8fc9debe956c1E")
    *libcompiler_builtins-d7924d72317b3879.rlib:compiler_builtins-d7924d72317b3879.compiler_builtins.e42d3e2e9a5e555c-cgu.178.rcgu.o(".text.__muldf3")
    *libcompiler_builtins-d7924d72317b3879.rlib:compiler_builtins-d7924d72317b3879.compiler_builtins.e42d3e2e9a5e555c-cgu.013.rcgu.o(".text._ZN17compiler_builtins3int3mul3Mul3mul17hb7c7310383c1421aE")
    *libcompiler_builtins-d7924d72317b3879.rlib:compiler_builtins-d7924d72317b3879.compiler_builtins.e42d3e2e9a5e555c-cgu.201.rcgu.o(".text.__floatundidf")
    *libcompiler_builtins-d7924d72317b3879.rlib:compiler_builtins-d7924d72317b3879.compiler_builtins.e42d3e2e9a5e555c-cgu.205.rcgu.o(".text.__fixunsdfdi")
    *libcompiler_builtins-d7924d72317b3879.rlib:compiler_builtins-d7924d72317b3879.compiler_builtins.e42d3e2e9a5e555c-cgu.220.rcgu.o(".text.__lshrti3")
    *libcompiler_builtins-d7924d72317b3879.rlib:compiler_builtins-d7924d72317b3879.compiler_builtins.e42d3e2e9a5e555c-cgu.021.rcgu.o(".text._ZN17compiler_builtins3int5shift4Ashl4ashl17h731515ed4426c7bdE")
    *libcompiler_builtins-d7924d72317b3879.rlib:compiler_builtins-d7924d72317b3879.compiler_builtins.e42d3e2e9a5e555c-cgu.021.rcgu.o(".text._ZN17compiler_builtins3int5shift4Lshr4lshr17h799de876e844e18aE")
    *libcompiler_builtins-d7924d72317b3879.rlib:compiler_builtins-d7924d72317b3879.compiler_builtins.e42d3e2e9a5e555c-cgu.238.rcgu.o(".text.__ashlti3")
    *libcompiler_builtins-d7924d72317b3879.rlib:compiler_builtins-d7924d72317b3879.compiler_builtins.e42d3e2e9a5e555c-cgu.249.rcgu.o(".text.__multi3")
    *libcompiler_builtins-d7924d72317b3879.rlib:compiler_builtins-d7924d72317b3879.compiler_builtins.e42d3e2e9a5e555c-cgu.259.rcgu.o(".text.__gedf2")
    *(.text*)
  } :text
  .rodata : { *(.rodata*) } :rodata
  .data.rel.ro : { *(.data.rel.ro*) } :rodata
  .dynamic : { *(.dynamic) } :dynamic
  .dynsym : { *(.dynsym) } :data
  .dynstr : { *(.dynstr) } :data
  .rel.dyn : { *(.rel.dyn) } :data
  /DISCARD/ : {
      *(.eh_frame*)
      *(.gnu.hash*)
      *(.hash*)
    }
}
