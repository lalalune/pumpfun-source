
PHDRS
{
  text PT_LOAD ;
  rodata PT_LOAD ;
  data PT_LOAD ;
  dynamic PT_DYNAMIC ;
}

SECTIONS
{
  . = SIZEOF_HEADERS;
  .text : {
    *pump_recovered.pump_recovered.*-cgu.0.rcgu.o(".text._ZN103_$LT$anchor_lang..accounts..interface..Interface$LT$T$GT$$u20$as$u20$anchor_lang..Accounts$LT$B$GT$$GT$12try_accounts17h2e0b18c6f2883269E")
    *pump_recovered.pump_recovered.*-cgu.0.rcgu.o(".text._ZN118_$LT$anchor_lang..accounts..interface_account..InterfaceAccount$LT$T$GT$$u20$as$u20$anchor_lang..Accounts$LT$B$GT$$GT$12try_accounts17h12ad5e22598c5f62E")
    *pump_recovered.pump_recovered.*-cgu.0.rcgu.o(".text._ZN118_$LT$anchor_lang..accounts..interface_account..InterfaceAccount$LT$T$GT$$u20$as$u20$anchor_lang..Accounts$LT$B$GT$$GT$12try_accounts17h0682d36f23bb67e5E")
    *pump_recovered.pump_recovered.*-cgu.0.rcgu.o(".text._ZN11anchor_lang5error5Error11with_values17h8504a53ddb496dcbE")
    *pump_recovered.pump_recovered.*-cgu.0.rcgu.o(".text._ZN11anchor_lang5error5Error11with_values17h2dc9c3ab326f6f51E")
    *pump_recovered.pump_recovered.*-cgu.0.rcgu.o(".text._ZN11anchor_lang5error5Error11with_values17h17a91ba7c0882e46E")
    *pump_recovered.pump_recovered.*-cgu.0.rcgu.o(".text._ZN11anchor_lang5error5Error11with_values17he8c2a935fab70db2E")
    *pump_recovered.pump_recovered.*-cgu.0.rcgu.o(".text._ZN11anchor_lang5error5Error11with_values17ha6df42326d4a37a2E")
    *pump_recovered.pump_recovered.*-cgu.0.rcgu.o(".text._ZN11anchor_lang5error5Error11with_values17hffd3f17b77d4930dE")
    *pump_recovered.pump_recovered.*-cgu.0.rcgu.o(".text._ZN11anchor_lang5error5Error17with_account_name17h27417fed71115bcbE")
    *pump_recovered.pump_recovered.*-cgu.0.rcgu.o(".text._ZN11anchor_lang5error5Error17with_account_name17h8535d5b89152f24eE")
    *pump_recovered.pump_recovered.*-cgu.0.rcgu.o(".text._ZN11anchor_lang5error5Error17with_account_name17h7716d56cec9f092aE")
    *pump_recovered.pump_recovered.*-cgu.0.rcgu.o(".text._ZN11anchor_lang8accounts12account_info93_$LT$impl$u20$anchor_lang..Accounts$LT$B$GT$$u20$for$u20$solana_account_info..AccountInfo$GT$12try_accounts17h06efe4f69d274181E")
    *pump_recovered.pump_recovered.*-cgu.0.rcgu.o(".text._ZN11anchor_lang8accounts17interface_account25InterfaceAccount$LT$T$GT$18try_from_unchecked17h73793b1c35fdd1b0E")
    *pump_recovered.pump_recovered.*-cgu.0.rcgu.o(".text._ZN11anchor_lang8accounts17interface_account25InterfaceAccount$LT$T$GT$18try_from_unchecked17h25dd62d415ed414eE")
    *pump_recovered.pump_recovered.*-cgu.0.rcgu.o(".text._ZN11anchor_lang8accounts5boxed87_$LT$impl$u20$anchor_lang..Accounts$LT$B$GT$$u20$for$u20$alloc..boxed..Box$LT$T$GT$$GT$12try_accounts17h808984e46e56ad62E")
    *pump_recovered.pump_recovered.*-cgu.0.rcgu.o(".text._ZN11anchor_lang8accounts5boxed87_$LT$impl$u20$anchor_lang..Accounts$LT$B$GT$$u20$for$u20$alloc..boxed..Box$LT$T$GT$$GT$12try_accounts17h27829cc00aafa609E")
    *pump_recovered.pump_recovered.*-cgu.0.rcgu.o(".text._ZN11anchor_lang8accounts5boxed87_$LT$impl$u20$anchor_lang..Accounts$LT$B$GT$$u20$for$u20$alloc..boxed..Box$LT$T$GT$$GT$12try_accounts17h7b81f0d9605a4828E")
    *pump_recovered.pump_recovered.*-cgu.0.rcgu.o(".text._ZN11anchor_lang8accounts5boxed87_$LT$impl$u20$anchor_lang..Accounts$LT$B$GT$$u20$for$u20$alloc..boxed..Box$LT$T$GT$$GT$12try_accounts17h1fe4bdbe0fa6717dE")
    *pump_recovered.pump_recovered.*-cgu.0.rcgu.o(".text._ZN11anchor_lang8accounts5boxed87_$LT$impl$u20$anchor_lang..Accounts$LT$B$GT$$u20$for$u20$alloc..boxed..Box$LT$T$GT$$GT$12try_accounts17ha060d561b8cabaa2E")
    *pump_recovered.pump_recovered.*-cgu.0.rcgu.o(".text._ZN11anchor_lang8accounts7account16Account$LT$T$GT$18try_from_unchecked17h6ddd04748077ab31E")
    *pump_recovered.pump_recovered.*-cgu.0.rcgu.o(".text._ZN11anchor_lang8accounts7account16Account$LT$T$GT$18try_from_unchecked17h5419988371f39d1cE")
    *pump_recovered.pump_recovered.*-cgu.0.rcgu.o(".text._ZN11anchor_lang8accounts7account16Account$LT$T$GT$18try_from_unchecked17h175cd376106ccda9E")
    *pump_recovered.pump_recovered.*-cgu.0.rcgu.o(".text._ZN11anchor_lang8accounts7account16Account$LT$T$GT$18try_from_unchecked17hbd14e8d378204e33E")
    *pump_recovered.pump_recovered.*-cgu.0.rcgu.o(".text._ZN11anchor_lang8accounts7account16Account$LT$T$GT$18try_from_unchecked17hbfc813e15182b348E")
    *pump_recovered.pump_recovered.*-cgu.0.rcgu.o(".text._ZN11anchor_lang8accounts7account16Account$LT$T$GT$18try_from_unchecked17ha731cfc3be1dabd0E")
    *pump_recovered.pump_recovered.*-cgu.0.rcgu.o(".text._ZN11anchor_lang8accounts7account16Account$LT$T$GT$18try_from_unchecked17h6e0560255f193ea1E")
    *pump_recovered.pump_recovered.*-cgu.0.rcgu.o(".text._ZN11anchor_lang8accounts7account16Account$LT$T$GT$24exit_with_expected_owner17hba412cd3d6fd567cE")
    *pump_recovered.pump_recovered.*-cgu.0.rcgu.o(".text._ZN11anchor_lang8accounts7account16Account$LT$T$GT$24exit_with_expected_owner17hbc12d3e18236498fE")
    *pump_recovered.pump_recovered.*-cgu.0.rcgu.o(".text._ZN11anchor_lang8accounts7account16Account$LT$T$GT$24exit_with_expected_owner17ha86a6811beeda6d7E")
    *pump_recovered.pump_recovered.*-cgu.0.rcgu.o(".text._ZN11anchor_lang8accounts7account16Account$LT$T$GT$24exit_with_expected_owner17h036b9a240fca28beE")
    *pump_recovered.pump_recovered.*-cgu.0.rcgu.o(".text._ZN11anchor_lang8accounts7account16Account$LT$T$GT$24exit_with_expected_owner17h302fc97437a8f69eE")
    *pump_recovered.pump_recovered.*-cgu.0.rcgu.o(".text._ZN11anchor_lang8accounts7account16Account$LT$T$GT$6reload17hc3ece0ad994fcd5aE")
    *pump_recovered.pump_recovered.*-cgu.0.rcgu.o(".text._ZN11anchor_lang8accounts7account16Account$LT$T$GT$8try_from17had96992f076bce36E")
    *pump_recovered.pump_recovered.*-cgu.0.rcgu.o(".text._ZN11anchor_lang8accounts7account16Account$LT$T$GT$8try_from17h735b6b5dfbac5880E")
    *pump_recovered.pump_recovered.*-cgu.0.rcgu.o(".text._ZN11anchor_lang8accounts7account16Account$LT$T$GT$8try_from17h30e8e0598c5f6d13E")
    *pump_recovered.pump_recovered.*-cgu.0.rcgu.o(".text._ZN11anchor_lang8accounts7account16Account$LT$T$GT$8try_from17h45dd799163aa7383E")
    *pump_recovered.pump_recovered.*-cgu.0.rcgu.o(".text._ZN11anchor_lang8accounts7account16Account$LT$T$GT$8try_from17hb59ce75d4ed4715eE")
    *pump_recovered.pump_recovered.*-cgu.0.rcgu.o(".text._ZN11anchor_lang8accounts7account16Account$LT$T$GT$8try_from17h35cd9c913c9b5aa9E")
    *pump_recovered.pump_recovered.*-cgu.0.rcgu.o(".text._ZN11anchor_lang8accounts7account16Account$LT$T$GT$8try_from17h6529145cedcadcf9E")
    *pump_recovered.pump_recovered.*-cgu.0.rcgu.o(".text._ZN11anchor_lang8accounts7account16Account$LT$T$GT$8try_from17h462636b99b3b294aE")
    *pump_recovered.pump_recovered.*-cgu.0.rcgu.o(".text._ZN11anchor_lang8accounts7account16Account$LT$T$GT$8try_from17h506d6043f73ff98eE")
    *pump_recovered.pump_recovered.*-cgu.0.rcgu.o(".text._ZN139_$LT$anchor_lang..accounts..interface..Interface$LT$T$GT$$u20$as$u20$core..convert..TryFrom$LT$$RF$solana_account_info..AccountInfo$GT$$GT$8try_from17h6afe4ae9df2d5beaE")
    *pump_recovered.pump_recovered.*-cgu.0.rcgu.o(".text._ZN3std2io5error5Error3new17h903aae344ddd0254E")
    *pump_recovered.pump_recovered.*-cgu.0.rcgu.o(".text._ZN3std2io5error5Error3new17h07ed4b6c50240568E")
    *pump_recovered.pump_recovered.*-cgu.0.rcgu.o(".text._ZN42_$LT$$RF$T$u20$as$u20$core..fmt..Debug$GT$3fmt17h41f50786517b90bdE")
    *pump_recovered.pump_recovered.*-cgu.0.rcgu.o(".text._ZN42_$LT$$RF$T$u20$as$u20$core..fmt..Debug$GT$3fmt17h3f746cf584c88d58E")
    *pump_recovered.pump_recovered.*-cgu.0.rcgu.o(".text._ZN42_$LT$$RF$T$u20$as$u20$core..fmt..Debug$GT$3fmt17h0333b338da31ddcaE")
    *pump_recovered.pump_recovered.*-cgu.0.rcgu.o(".text._ZN42_$LT$$RF$T$u20$as$u20$core..fmt..Debug$GT$3fmt17hd61aa3bb24cbeaf1E")
    *pump_recovered.pump_recovered.*-cgu.0.rcgu.o(".text._ZN42_$LT$$RF$T$u20$as$u20$core..fmt..Debug$GT$3fmt17hc7eb8f545b1bbf09E")
    *pump_recovered.pump_recovered.*-cgu.0.rcgu.o(".text._ZN42_$LT$$RF$T$u20$as$u20$core..fmt..Debug$GT$3fmt17h423179bffa8572ecE")
    *pump_recovered.pump_recovered.*-cgu.0.rcgu.o(".text._ZN42_$LT$$RF$T$u20$as$u20$core..fmt..Debug$GT$3fmt17h7b484d29a0c55781E")
    *pump_recovered.pump_recovered.*-cgu.0.rcgu.o(".text._ZN44_$LT$$RF$T$u20$as$u20$core..fmt..Display$GT$3fmt17hce86dbee7e23dfa8E")
    *pump_recovered.pump_recovered.*-cgu.0.rcgu.o(".text._ZN45_$LT$T$u20$as$u20$alloc..string..ToString$GT$9to_string17h1551814bef63e52cE")
    *pump_recovered.pump_recovered.*-cgu.0.rcgu.o(".text._ZN45_$LT$T$u20$as$u20$alloc..string..ToString$GT$9to_string17h4b386cbefe3ebd9eE")
    *pump_recovered.pump_recovered.*-cgu.0.rcgu.o(".text._ZN4core3fmt3num49_$LT$impl$u20$core..fmt..Debug$u20$for$u20$u8$GT$3fmt17h56fe0bc454683bb8E")
    *pump_recovered.pump_recovered.*-cgu.0.rcgu.o(".text._ZN4core3fmt3num50_$LT$impl$u20$core..fmt..Debug$u20$for$u20$i64$GT$3fmt17h09fd8368c16afbbbE")
    *pump_recovered.pump_recovered.*-cgu.0.rcgu.o(".text._ZN4core3fmt5Write9write_fmt17hd52a4ebe329e4f3cE")
    *pump_recovered.pump_recovered.*-cgu.0.rcgu.o(".text._ZN4core3fmt9Formatter9write_fmt17ha225da5d76e7eb00E")
    *pump_recovered.pump_recovered.*-cgu.0.rcgu.o(".text._ZN4core3ptr166drop_in_place$LT$anchor_lang..context..CpiContext$LT$pump_recovered..pump_fees..internal..__cpi_client_accounts_get_fees_with_quote_mint..GetFeesWithQuoteMint$GT$$GT$17h768941269e7f26a0E")
    *pump_recovered.pump_recovered.*-cgu.0.rcgu.o(".text._ZN4core3ptr205drop_in_place$LT$$LT$alloc..boxed..Box$LT$dyn$u20$core..error..Error$u2b$core..marker..Sync$u2b$core..marker..Send$GT$$u20$as$u20$core..convert..From$LT$alloc..string..String$GT$$GT$..from..StringError$GT$17hdc93fc981b1837d7E")
    *pump_recovered.pump_recovered.*-cgu.0.rcgu.o(".text._ZN4core3ptr24drop_in_place$LT$i64$GT$17hbb9ccc48fb1c72b9E")
    *pump_recovered.pump_recovered.*-cgu.0.rcgu.o(".text._ZN4core3ptr37drop_in_place$LT$core..fmt..Error$GT$17hcd839a646a3475c3E")
    *pump_recovered.pump_recovered.*-cgu.0.rcgu.o(".text._ZN4core3ptr42drop_in_place$LT$alloc..string..String$GT$17h36d8e4095db7ad83E")
    *pump_recovered.pump_recovered.*-cgu.0.rcgu.o(".text._ZN4core3ptr42drop_in_place$LT$solana_pubkey..Pubkey$GT$17h814c333b3d438f34E")
    *pump_recovered.pump_recovered.*-cgu.0.rcgu.o(".text._ZN4core3ptr42drop_in_place$LT$std..io..error..Error$GT$17heda1e8160243d4ecE")
    *pump_recovered.pump_recovered.*-cgu.0.rcgu.o(".text._ZN4core3ptr53drop_in_place$LT$pump_recovered..migrate..Migrate$GT$17hb68e4d733267dbe9E")
    *pump_recovered.pump_recovered.*-cgu.0.rcgu.o(".text._ZN4core3ptr46drop_in_place$LT$anchor_lang..error..Error$GT$17ha40a84cd5ee73fdeE")
    *pump_recovered.pump_recovered.*-cgu.0.rcgu.o(".text._ZN4core3ptr56drop_in_place$LT$pump_recovered..admin_cto..AdminCto$GT$17h771ce1158a0a4ec8E")
    *pump_recovered.pump_recovered.*-cgu.0.rcgu.o(".text._ZN4core3ptr55drop_in_place$LT$solana_program_error..ProgramError$GT$17hede90c8776bd7f24E")
    *pump_recovered.pump_recovered.*-cgu.0.rcgu.o(".text._ZN4core3ptr72drop_in_place$LT$pump_recovered..__private..__idl..IdlCreateAccounts$GT$17ha4f685bbd1697e18E")
    *pump_recovered.pump_recovered.*-cgu.0.rcgu.o(".text._ZN4core3ptr72drop_in_place$LT$pump_recovered..idl_authority..AdminSetIdlAuthority$GT$17h34d84447f11f57b9E")
    *pump_recovered.pump_recovered.*-cgu.0.rcgu.o(".text._ZN4core3ptr74drop_in_place$LT$$u5b$solana_account_info..AccountInfo$u3b$$u20$4$u5d$$GT$17hdeb9e8cdf823c163E")
    *pump_recovered.pump_recovered.*-cgu.0.rcgu.o(".text._ZN4core3ptr74drop_in_place$LT$$u5b$solana_account_info..AccountInfo$u3b$$u20$6$u5d$$GT$17he3c1ee89ec1c3077E")
    *pump_recovered.pump_recovered.*-cgu.0.rcgu.o(".text._ZN4core3ptr74drop_in_place$LT$$u5b$solana_account_info..AccountInfo$u3b$$u20$7$u5d$$GT$17h3c7eb2ea127c0ac9E")
    *pump_recovered.pump_recovered.*-cgu.0.rcgu.o(".text._ZN4core3ptr86drop_in_place$LT$pump_recovered..creator..collect_creator_fee..CollectCreatorFeeV2$GT$17h35038d0eafd34da1E")
    *pump_recovered.pump_recovered.*-cgu.0.rcgu.o(".text._ZN4core3ptr93drop_in_place$LT$core..option..Option$LT$pump_recovered..multi_hop_curve..PreviousHop$GT$$GT$17he2db0028ed086361E")
    *pump_recovered.pump_recovered.*-cgu.0.rcgu.o(".text._ZN4core3ptr90drop_in_place$LT$alloc..collections..btree..set..BTreeSet$LT$solana_pubkey..Pubkey$GT$$GT$17h1eb94d3b7f4179e0E")
    *pump_recovered.pump_recovered.*-cgu.0.rcgu.o(".text._ZN4core5array69_$LT$impl$u20$core..fmt..Debug$u20$for$u20$$u5b$T$u3b$$u20$N$u5d$$GT$3fmt17hc138f7426a8dbfdaE")
    *pump_recovered.pump_recovered.*-cgu.0.rcgu.o(".text._ZN4core5error5Error5cause17hf2229b30be285589E")
    *pump_recovered.pump_recovered.*-cgu.0.rcgu.o(".text._ZN4core5error5Error7provide17hb085b6db5176ba22E")
    *pump_recovered.pump_recovered.*-cgu.0.rcgu.o(".text._ZN4core5error5Error7type_id17h3884e1c72ff64a9cE")
    *pump_recovered.pump_recovered.*-cgu.0.rcgu.o(".text._ZN51_$LT$u64$u20$as$u20$borsh..de..BorshDeserialize$GT$18deserialize_reader17hee367698f3fa91c6E")
    *pump_recovered.pump_recovered.*-cgu.0.rcgu.o(".text._ZN52_$LT$T$u20$as$u20$alloc..slice..hack..ConvertVec$GT$6to_vec17h149ff237ee4ade54E")
    *pump_recovered.pump_recovered.*-cgu.0.rcgu.o(".text._ZN52_$LT$bool$u20$as$u20$borsh..de..BorshDeserialize$GT$18deserialize_reader17h0d5247211ab9208aE")
    *pump_recovered.pump_recovered.*-cgu.0.rcgu.o(".text._ZN53_$LT$core..fmt..Error$u20$as$u20$core..fmt..Debug$GT$3fmt17h85666afa16c4890eE")
    *pump_recovered.pump_recovered.*-cgu.0.rcgu.o(".text._ZN58_$LT$alloc..string..String$u20$as$u20$core..fmt..Write$GT$10write_char17hfde5b685689164ccE")
    *pump_recovered.pump_recovered.*-cgu.0.rcgu.o(".text._ZN58_$LT$alloc..string..String$u20$as$u20$core..fmt..Write$GT$9write_str17h4b62f46a222bd5b2E")
    *pump_recovered.pump_recovered.*-cgu.0.rcgu.o(".text._ZN5alloc3fmt6format17h5424e8a08f31e4d3E")
    *pump_recovered.pump_recovered.*-cgu.0.rcgu.o(".text._ZN5alloc5alloc15exchange_malloc17h6cd8dd11b0e3424eE")
    *pump_recovered.pump_recovered.*-cgu.0.rcgu.o(".text._ZN5alloc6string6String4push17h96dfc48c19bd6e38E")
    *pump_recovered.pump_recovered.*-cgu.0.rcgu.o(".text._ZN5alloc7raw_vec11finish_grow17h96542f446ab77dc2E")
    *pump_recovered.pump_recovered.*-cgu.0.rcgu.o(".text.unlikely._ZN5alloc7raw_vec19RawVec$LT$T$C$A$GT$7reserve21do_reserve_and_handle17h2b6fc2e6a45111cdE")
    *pump_recovered.pump_recovered.*-cgu.0.rcgu.o(".text.unlikely._ZN5alloc7raw_vec19RawVec$LT$T$C$A$GT$7reserve21do_reserve_and_handle17h601202fc52ac84a5E")
    *pump_recovered.pump_recovered.*-cgu.0.rcgu.o(".text.unlikely._ZN5alloc7raw_vec19RawVec$LT$T$C$A$GT$7reserve21do_reserve_and_handle17h435205c6b11d6843E")
    *pump_recovered.pump_recovered.*-cgu.0.rcgu.o(".text._ZN5alloc7raw_vec19RawVec$LT$T$C$A$GT$8grow_one17h9dcacb32c2818d08E")
    *pump_recovered.pump_recovered.*-cgu.0.rcgu.o(".text._ZN5alloc7raw_vec19RawVec$LT$T$C$A$GT$8grow_one17h9b31d6dd0e76ad9eE")
    *pump_recovered.pump_recovered.*-cgu.0.rcgu.o(".text._ZN5alloc7raw_vec19RawVec$LT$T$C$A$GT$8grow_one17h9ebc9d13e0716237E")
    *pump_recovered.pump_recovered.*-cgu.0.rcgu.o(".text._ZN5alloc7raw_vec19RawVec$LT$T$C$A$GT$8grow_one17h46b265fcf5577b9cE")
    *pump_recovered.pump_recovered.*-cgu.0.rcgu.o(".text._ZN5alloc7raw_vec19RawVec$LT$T$C$A$GT$8grow_one17h3733c9383ac37ae1E")
    *pump_recovered.pump_recovered.*-cgu.0.rcgu.o(".text._ZN5alloc7raw_vec19RawVec$LT$T$C$A$GT$8grow_one17h1348046c5a452d5cE")
    *pump_recovered.pump_recovered.*-cgu.0.rcgu.o(".text._ZN5alloc7raw_vec19RawVec$LT$T$C$A$GT$8grow_one17hc1f2db44798e6f67E")
    *pump_recovered.pump_recovered.*-cgu.0.rcgu.o(".text._ZN60_$LT$alloc..string..String$u20$as$u20$core..fmt..Display$GT$3fmt17heb0494973da8b0beE")
    *pump_recovered.pump_recovered.*-cgu.0.rcgu.o(".text._ZN63_$LT$solana_pubkey..PubkeyError$u20$as$u20$core..fmt..Debug$GT$3fmt17h8fc110c9d09a131fE")
    *pump_recovered.pump_recovered.*-cgu.0.rcgu.o(".text._ZN69_$LT$$u5b$T$u3b$$u20$N$u5d$$u20$as$u20$borsh..ser..BorshSerialize$GT$9serialize17h80d8fd5083fc2dacE")
    *pump_recovered.pump_recovered.*-cgu.0.rcgu.o(".text._ZN69_$LT$$u5b$T$u3b$$u20$N$u5d$$u20$as$u20$borsh..ser..BorshSerialize$GT$9serialize17hf4b108918b3ad1a9E")
    *pump_recovered.pump_recovered.*-cgu.0.rcgu.o(".text._ZN69_$LT$$u5b$T$u3b$$u20$N$u5d$$u20$as$u20$borsh..ser..BorshSerialize$GT$9serialize17h147d263ac31cc7d9E")
    *pump_recovered.pump_recovered.*-cgu.0.rcgu.o(".text._ZN69_$LT$$u5b$T$u3b$$u20$N$u5d$$u20$as$u20$borsh..ser..BorshSerialize$GT$9serialize17h990804dec2caef26E")
    *pump_recovered.pump_recovered.*-cgu.0.rcgu.o(".text._ZN69_$LT$$u5b$T$u3b$$u20$N$u5d$$u20$as$u20$borsh..ser..BorshSerialize$GT$9serialize17h29354f4f838948eaE")
    *pump_recovered.pump_recovered.*-cgu.0.rcgu.o(".text._ZN69_$LT$alloc..string..String$u20$as$u20$borsh..de..BorshDeserialize$GT$18deserialize_reader17h2aa7111b08ba519dE")
    *pump_recovered.pump_recovered.*-cgu.0.rcgu.o(".text._ZN69_$LT$solana_pubkey..Pubkey$u20$as$u20$borsh..de..BorshDeserialize$GT$18deserialize_reader17h47c51d66dd20c3d8E")
    *pump_recovered.pump_recovered.*-cgu.0.rcgu.o(".text._ZN70_$LT$$u5b$T$u3b$$u20$N$u5d$$u20$as$u20$borsh..de..BorshDeserialize$GT$18deserialize_reader17h52c3b7deb04b3226E")
    *pump_recovered.pump_recovered.*-cgu.0.rcgu.o(".text._ZN70_$LT$$u5b$T$u3b$$u20$N$u5d$$u20$as$u20$borsh..de..BorshDeserialize$GT$18deserialize_reader17h5014539f43089f4eE")
    *pump_recovered.pump_recovered.*-cgu.0.rcgu.o(".text._ZN70_$LT$$u5b$T$u3b$$u20$N$u5d$$u20$as$u20$borsh..de..BorshDeserialize$GT$18deserialize_reader17hb9c5a5dd35fa4597E")
    *pump_recovered.pump_recovered.*-cgu.0.rcgu.o(".text._ZN70_$LT$core..num..error..TryFromIntError$u20$as$u20$core..fmt..Debug$GT$3fmt17h19e859f4ad052900E")
    *pump_recovered.pump_recovered.*-cgu.0.rcgu.o(".text._ZN71_$LT$solana_account_info..AccountInfo$u20$as$u20$core..clone..Clone$GT$5clone17h759150bcde62cc00E")
    *pump_recovered.pump_recovered.*-cgu.0.rcgu.o(".text._ZN71_$LT$solana_program_error..ProgramError$u20$as$u20$core..fmt..Debug$GT$3fmt17h33e8d6b26dda9bffE")
    *pump_recovered.pump_recovered.*-cgu.0.rcgu.o(".text._ZN72_$LT$alloc..vec..Vec$LT$T$GT$$u20$as$u20$borsh..de..BorshDeserialize$GT$18deserialize_reader17h43164f0ff6785abaE")
    *pump_recovered.pump_recovered.*-cgu.0.rcgu.o(".text._ZN72_$LT$alloc..vec..Vec$LT$T$GT$$u20$as$u20$borsh..de..BorshDeserialize$GT$18deserialize_reader17hb801b7d470cf3307E")
    *pump_recovered.pump_recovered.*-cgu.0.rcgu.o(".text._ZN72_$LT$alloc..vec..Vec$LT$T$GT$$u20$as$u20$borsh..de..BorshDeserialize$GT$18deserialize_reader17h6423f72dbed7e652E")
    *pump_recovered.pump_recovered.*-cgu.0.rcgu.o(".text._ZN78_$LT$anchor_lang..idl..IdlAccount$u20$as$u20$anchor_lang..AccountSerialize$GT$13try_serialize17hf060f96d1e2f2426E")
    *pump_recovered.pump_recovered.*-cgu.0.rcgu.o(".text._ZN85_$LT$anchor_lang..accounts..account..Account$LT$T$GT$$u20$as$u20$core..fmt..Debug$GT$3fmt17h545171893f174f97E")
    *pump_recovered.pump_recovered.*-cgu.0.rcgu.o(".text._ZN88_$LT$anchor_lang..accounts..signer..Signer$u20$as$u20$anchor_lang..Accounts$LT$B$GT$$GT$12try_accounts17h0e2047cb811e7515E")
    *pump_recovered.pump_recovered.*-cgu.0.rcgu.o(".text._ZN97_$LT$anchor_lang..accounts..sysvar..Sysvar$LT$T$GT$$u20$as$u20$anchor_lang..Accounts$LT$B$GT$$GT$12try_accounts17hc8e252afadc46ab6E")
    *pump_recovered.pump_recovered.*-cgu.0.rcgu.o(".text._ZN98_$LT$alloc..vec..Vec$LT$T$GT$$u20$as$u20$alloc..vec..spec_from_iter..SpecFromIter$LT$T$C$I$GT$$GT$9from_iter17h05834ec09ece64f1E")
    *pump_recovered.pump_recovered.*-cgu.0.rcgu.o(".text._ZN99_$LT$anchor_lang..accounts..account..Account$LT$T$GT$$u20$as$u20$anchor_lang..Accounts$LT$B$GT$$GT$12try_accounts17h179bcc691706aaffE")
    *pump_recovered.pump_recovered.*-cgu.0.rcgu.o(".text._ZN99_$LT$anchor_lang..accounts..account..Account$LT$T$GT$$u20$as$u20$anchor_lang..Accounts$LT$B$GT$$GT$12try_accounts17h0774583de916150dE")
    *pump_recovered.pump_recovered.*-cgu.0.rcgu.o(".text._ZN99_$LT$anchor_lang..accounts..account..Account$LT$T$GT$$u20$as$u20$anchor_lang..Accounts$LT$B$GT$$GT$12try_accounts17h377e01c42e45264bE")
    *pump_recovered.pump_recovered.*-cgu.0.rcgu.o(".text._ZN99_$LT$anchor_lang..accounts..account..Account$LT$T$GT$$u20$as$u20$anchor_lang..Accounts$LT$B$GT$$GT$12try_accounts17h01cd6d50ded66e35E")
    *pump_recovered.pump_recovered.*-cgu.0.rcgu.o(".text._ZN99_$LT$anchor_lang..accounts..account..Account$LT$T$GT$$u20$as$u20$anchor_lang..Accounts$LT$B$GT$$GT$12try_accounts17h04d8d1f0fa719739E")
    *pump_recovered.pump_recovered.*-cgu.0.rcgu.o(".text._ZN99_$LT$anchor_lang..accounts..account..Account$LT$T$GT$$u20$as$u20$anchor_lang..Accounts$LT$B$GT$$GT$12try_accounts17h71f157e52be3335fE")
    *pump_recovered.pump_recovered.*-cgu.0.rcgu.o(".text._ZN99_$LT$anchor_lang..accounts..account..Account$LT$T$GT$$u20$as$u20$anchor_lang..Accounts$LT$B$GT$$GT$12try_accounts17h19d88f41bf8b7122E")
    *pump_recovered.pump_recovered.*-cgu.0.rcgu.o(".text._ZN99_$LT$anchor_lang..accounts..account..Account$LT$T$GT$$u20$as$u20$anchor_lang..Accounts$LT$B$GT$$GT$12try_accounts17h249f9c01449324abE")
    *pump_recovered.pump_recovered.*-cgu.0.rcgu.o(".text._ZN99_$LT$anchor_lang..accounts..account..Account$LT$T$GT$$u20$as$u20$anchor_lang..Accounts$LT$B$GT$$GT$12try_accounts17h6bfa956549cc1783E")
    *pump_recovered.pump_recovered.*-cgu.0.rcgu.o(".text._ZN99_$LT$anchor_lang..accounts..account..Account$LT$T$GT$$u20$as$u20$anchor_lang..Accounts$LT$B$GT$$GT$12try_accounts17h30c03e729c37ae27E")
    *pump_recovered.pump_recovered.*-cgu.0.rcgu.o(".text._ZN99_$LT$anchor_lang..accounts..program..Program$LT$T$GT$$u20$as$u20$anchor_lang..Accounts$LT$B$GT$$GT$12try_accounts17h23e39198be353e0aE")
    *pump_recovered.pump_recovered.*-cgu.0.rcgu.o(".text._ZN99_$LT$anchor_lang..accounts..program..Program$LT$T$GT$$u20$as$u20$anchor_lang..Accounts$LT$B$GT$$GT$12try_accounts17h148fe3dfc31818cbE")
    *pump_recovered.pump_recovered.*-cgu.0.rcgu.o(".text._ZN99_$LT$anchor_lang..accounts..program..Program$LT$T$GT$$u20$as$u20$anchor_lang..Accounts$LT$B$GT$$GT$12try_accounts17h0bbb44cad614c929E")
    *pump_recovered.pump_recovered.*-cgu.0.rcgu.o(".text._ZN99_$LT$anchor_lang..accounts..program..Program$LT$T$GT$$u20$as$u20$anchor_lang..Accounts$LT$B$GT$$GT$12try_accounts17h1235233c7c15d8b3E")
    *pump_recovered.pump_recovered.*-cgu.0.rcgu.o(".text._ZN99_$LT$anchor_lang..accounts..program..Program$LT$T$GT$$u20$as$u20$anchor_lang..Accounts$LT$B$GT$$GT$12try_accounts17h13ad08d931efcba2E")
    *pump_recovered.pump_recovered.*-cgu.0.rcgu.o(".text._ZN99_$LT$anchor_lang..accounts..program..Program$LT$T$GT$$u20$as$u20$anchor_lang..Accounts$LT$B$GT$$GT$12try_accounts17h43e2df87df71bbf8E")
    *pump_recovered.pump_recovered.*-cgu.0.rcgu.o(".text._ZN99_$LT$anchor_lang..accounts..program..Program$LT$T$GT$$u20$as$u20$anchor_lang..Accounts$LT$B$GT$$GT$12try_accounts17he21bdd1ce2c33566E")
    *pump_recovered.pump_recovered.*-cgu.0.rcgu.o(".text._ZN99_$LT$anchor_lang..accounts..program..Program$LT$T$GT$$u20$as$u20$anchor_lang..Accounts$LT$B$GT$$GT$12try_accounts17h3cf7584072c479feE")
    *pump_recovered.pump_recovered.*-cgu.0.rcgu.o(.text*)
    *(".text.__rust_alloc_error_handler")
    *libpump_token_ext-*.rlib:*(".text._ZN14pump_token_ext26quote_extensions_supported17h9da1a8340eca5276E")
    *libpump_token_ext-*.rlib:*(".text._ZN14pump_token_ext26required_quote_account_len17hf8489509559df655E")
    *libpump_token_ext-*.rlib:*(".text._ZN14pump_token_ext3Fee13calculate_fee17h9d072eb206dd1238E")
    *libpump_token_ext-*.rlib:*(".text._ZN14pump_token_ext3Fee24calculate_pre_fee_amount17h88b9041744a9ebb7E")
    *libpump_token_ext-*.rlib:*(".text._ZN14pump_token_ext23get_transfer_fee_config17h49f4a2f0d4424044E")
    *libanchor_spl-*.rlib:*(".text._ZN4core3ptr74drop_in_place$LT$$u5b$solana_account_info..AccountInfo$u3b$$u20$2$u5d$$GT$17h874259d7d44ef3e8E")
    *libanchor_spl-*.rlib:*(".text._ZN4core3ptr74drop_in_place$LT$$u5b$solana_account_info..AccountInfo$u3b$$u20$3$u5d$$GT$17h46b38303db25da95E")
    *libanchor_spl-*.rlib:*(".text._ZN4core3ptr74drop_in_place$LT$$u5b$solana_account_info..AccountInfo$u3b$$u20$4$u5d$$GT$17ha467bc362b1c55faE")
    *libanchor_spl-*.rlib:*(".text._ZN4core3ptr74drop_in_place$LT$$u5b$solana_account_info..AccountInfo$u3b$$u20$5$u5d$$GT$17h27af0d6c3dd81c54E")
    *libanchor_spl-*.rlib:*(".text._ZN4core3ptr74drop_in_place$LT$$u5b$solana_account_info..AccountInfo$u3b$$u20$6$u5d$$GT$17h3c5498a396782e87E")
    *libanchor_spl-*.rlib:*(".text._ZN4core3ptr76drop_in_place$LT$alloc..vec..Vec$LT$solana_account_info..AccountInfo$GT$$GT$17h4f49cc865b18d01dE")
    *libanchor_spl-*.rlib:*(".text._ZN5alloc7raw_vec11finish_grow17h07de39e67b27598cE")
    *libanchor_spl-*.rlib:*(".text.unlikely._ZN5alloc7raw_vec19RawVec$LT$T$C$A$GT$7reserve21do_reserve_and_handle17hee80464f0ffd2a27E")
    *libanchor_spl-*.rlib:*(".text._ZN5alloc7raw_vec19RawVec$LT$T$C$A$GT$8grow_one17h08ef4aaea09a3c89E")
    *libanchor_spl-*.rlib:*(".text._ZN10anchor_spl16associated_token6create17hb5153b864d430ce3E")
    *libanchor_spl-*.rlib:*(".text._ZN10anchor_spl16associated_token17create_idempotent17h6d66b04320e05cf1E")
    *libanchor_spl-*.rlib:*(".text._ZN10anchor_spl5token7mint_to17h7a3d22830ddb9a6cE")
    *libanchor_spl-*.rlib:*(".text._ZN10anchor_spl5token13set_authority17h847bf15db3a19c11E")
    *libanchor_spl-*.rlib:*(".text._ZN83_$LT$anchor_spl..token..TokenAccount$u20$as$u20$anchor_lang..AccountDeserialize$GT$25try_deserialize_unchecked17h8391fe8cb8196d03E")
    *libanchor_spl-*.rlib:*(".text._ZN75_$LT$anchor_spl..token..Mint$u20$as$u20$anchor_lang..AccountDeserialize$GT$25try_deserialize_unchecked17h6ad6e4d9281a3de6E")
    *libanchor_spl-*.rlib:*(".text._ZN10anchor_spl10token_202216transfer_checked17h41d7593a59ca7245E")
    *libanchor_spl-*.rlib:*(".text._ZN10anchor_spl10token_20227mint_to17hd9a994012d6711b8E")
    *libanchor_spl-*.rlib:*(".text._ZN10anchor_spl10token_20224burn17h0bdafee27b3ccfa5E")
    *libanchor_spl-*.rlib:*(".text._ZN10anchor_spl10token_202213close_account17hba6ff00c144507a6E")
    *libanchor_spl-*.rlib:*(".text._ZN10anchor_spl10token_202216initialize_mint217h7f7f1b8df25caca8E")
    *libanchor_spl-*.rlib:*(".text._ZN10anchor_spl10token_202213set_authority17h32f3457ce5847269E")
    *libanchor_spl-*.rlib:*(".text._ZN10anchor_spl21token_2022_extensions20group_member_pointer31group_member_pointer_initialize17hf59d9ba2aa47dc81E")
    *libanchor_spl-*.rlib:*(".text._ZN10anchor_spl21token_2022_extensions13group_pointer24group_pointer_initialize17h040f49d8b1ccf840E")
    *libanchor_spl-*.rlib:*(".text._ZN10anchor_spl21token_2022_extensions16metadata_pointer27metadata_pointer_initialize17had67681a98ba5800E")
    *libanchor_spl-*.rlib:*(".text._ZN10anchor_spl21token_2022_extensions20mint_close_authority31mint_close_authority_initialize17hb34ce88f36625923E")
    *libanchor_spl-*.rlib:*(".text._ZN10anchor_spl21token_2022_extensions16non_transferable32non_transferable_mint_initialize17h648a8b29bdcfac40E")
    *libanchor_spl-*.rlib:*(".text._ZN10anchor_spl21token_2022_extensions14token_metadata25token_metadata_initialize17h0ffe95482509db82E")
    *libanchor_spl-*.rlib:*(".text._ZN10anchor_spl21token_2022_extensions14token_metadata31token_metadata_update_authority17hcde0537ef66bc8dbE")
    *libanchor_spl-*.rlib:*(".text._ZN10anchor_spl21token_2022_extensions12transfer_fee31harvest_withheld_tokens_to_mint17hbd06a957a03849f5E")
    *libanchor_spl-*.rlib:*(".text._ZN10anchor_spl21token_2022_extensions13transfer_hook24transfer_hook_initialize17h2ce912b747626584E")
    *libanchor_spl-*.rlib:*(".text._ZN93_$LT$anchor_spl..token_interface..TokenAccount$u20$as$u20$anchor_lang..AccountDeserialize$GT$25try_deserialize_unchecked17hae25a5b8fdd5feacE")
    *libanchor_spl-*.rlib:*(".text._ZN85_$LT$anchor_spl..token_interface..Mint$u20$as$u20$anchor_lang..AccountDeserialize$GT$25try_deserialize_unchecked17h49e65162f3292dabE")
    *libanchor_spl-*.rlib:*(".text._ZN10anchor_spl15token_interface22find_mint_account_size17h37c9d22ffb80168fE")
    *libanchor_spl-*.rlib:*(".text._ZN10anchor_spl8metadata27create_metadata_accounts_v317h9ff3df4ea165f02bE")
    *libanchor_spl-*.rlib:*(".text._ZN89_$LT$anchor_spl..metadata..MetadataAccount$u20$as$u20$anchor_lang..AccountDeserialize$GT$15try_deserialize17hf3e8c447438c9c53E")
    *libanchor_spl-*.rlib:*(".text._ZN101_$LT$anchor_spl..metadata..SetAndVerifySizedCollectionItem$u20$as$u20$anchor_lang..ToAccountInfos$GT$16to_account_infos17he013278dd31f9f40E")
    *libmpl_token_metadata-*.rlib:*(".text._ZN3std2io5error5Error3new17ha630c2a1252b9446E")
    *libmpl_token_metadata-*.rlib:*(".text._ZN3std2io5error5Error3new17h8239ae3048857c0dE")
    *libmpl_token_metadata-*.rlib:*(".text._ZN4core3fmt3num49_$LT$impl$u20$core..fmt..Debug$u20$for$u20$u8$GT$3fmt17h56fe0bc454683bb8E")
    *libmpl_token_metadata-*.rlib:*(".text._ZN4core3fmt5Write9write_fmt17h972574b65522e56eE")
    *libmpl_token_metadata-*.rlib:*(".text._ZN4core3ptr176drop_in_place$LT$core..result..Result$LT$core..option..Option$LT$mpl_token_metadata..generated..types..collection_details..CollectionDetails$GT$$C$std..io..error..Error$GT$$GT$17h51df764ce8719156E")
    *libmpl_token_metadata-*.rlib:*(".text._ZN4core3ptr178drop_in_place$LT$core..result..Result$LT$core..option..Option$LT$mpl_token_metadata..generated..types..programmable_config..ProgrammableConfig$GT$$C$std..io..error..Error$GT$$GT$17hfb85b8c457181ac0E")
    *libmpl_token_metadata-*.rlib:*(".text._ZN4core3ptr205drop_in_place$LT$$LT$alloc..boxed..Box$LT$dyn$u20$core..error..Error$u2b$core..marker..Sync$u2b$core..marker..Send$GT$$u20$as$u20$core..convert..From$LT$alloc..string..String$GT$$GT$..from..StringError$GT$17hc298364554f47f91E")
    *libmpl_token_metadata-*.rlib:*(".text._ZN4core3ptr37drop_in_place$LT$core..fmt..Error$GT$17h58168986b46e4137E")
    *libmpl_token_metadata-*.rlib:*(".text._ZN4core3ptr42drop_in_place$LT$alloc..string..String$GT$17h4d89d574edd909f5E")
    *libmpl_token_metadata-*.rlib:*(".text._ZN4core3ptr42drop_in_place$LT$std..io..error..Error$GT$17h3b0bdf15a4697df8E")
    *libmpl_token_metadata-*.rlib:*(".text._ZN4core3ptr450drop_in_place$LT$$LP$core..result..Result$LT$core..option..Option$LT$mpl_token_metadata..generated..types..token_standard..TokenStandard$GT$$C$std..io..error..Error$GT$$C$core..result..Result$LT$core..option..Option$LT$mpl_token_metadata..generated..types..collection..Collection$GT$$C$std..io..error..Error$GT$$C$core..result..Result$LT$core..option..Option$LT$mpl_token_metadata..generated..types..uses..Uses$GT$$C$std..io..error..Error$GT$$RP$$GT$17h8ccbd8a267b4b648E")
    *libmpl_token_metadata-*.rlib:*(".text._ZN4core5error5Error5cause17hac265c8c14aa4e17E")
    *libmpl_token_metadata-*.rlib:*(".text._ZN4core5error5Error7provide17hd6775fab5fafb83eE")
    *libmpl_token_metadata-*.rlib:*(".text._ZN4core5error5Error7type_id17hc974b0000a7d6323E")
    *libmpl_token_metadata-*.rlib:*(".text._ZN53_$LT$core..fmt..Error$u20$as$u20$core..fmt..Debug$GT$3fmt17h85666afa16c4890eE")
    *libmpl_token_metadata-*.rlib:*(".text._ZN58_$LT$alloc..string..String$u20$as$u20$core..fmt..Write$GT$10write_char17hfde5b685689164ccE")
    *libmpl_token_metadata-*.rlib:*(".text._ZN58_$LT$alloc..string..String$u20$as$u20$core..fmt..Write$GT$9write_str17h4b62f46a222bd5b2E")
    *libmpl_token_metadata-*.rlib:*(".text._ZN5alloc7raw_vec11finish_grow17h3468ed2705eba064E")
    *libmpl_token_metadata-*.rlib:*(".text.unlikely._ZN5alloc7raw_vec19RawVec$LT$T$C$A$GT$7reserve21do_reserve_and_handle17h32d7dfdbb45b39a5E")
    *libmpl_token_metadata-*.rlib:*(".text.unlikely._ZN5alloc7raw_vec19RawVec$LT$T$C$A$GT$7reserve21do_reserve_and_handle17hd8c1fe82d50c50fcE")
    *libmpl_token_metadata-*.rlib:*(".text._ZN5alloc7raw_vec19RawVec$LT$T$C$A$GT$8grow_one17h37ea2b88ecf6688cE")
    *libmpl_token_metadata-*.rlib:*(".text._ZN5alloc7raw_vec19RawVec$LT$T$C$A$GT$8grow_one17h78a4337d67f43070E")
    *libmpl_token_metadata-*.rlib:*(".text._ZN5borsh3ser14BorshSerialize10try_to_vec17he9ffeab2ac4212c8E")
    *libmpl_token_metadata-*.rlib:*(".text._ZN69_$LT$alloc..string..String$u20$as$u20$borsh..de..BorshDeserialize$GT$18deserialize_reader17h1f80065453a93b35E")
    *libmpl_token_metadata-*.rlib:*(".text._ZN72_$LT$alloc..vec..Vec$LT$T$GT$$u20$as$u20$borsh..de..BorshDeserialize$GT$18deserialize_reader17he14e5f5e1b395e05E")
    *libmpl_token_metadata-*.rlib:*(".text._ZN76_$LT$core..option..Option$LT$T$GT$$u20$as$u20$borsh..ser..BorshSerialize$GT$9serialize17h2fff4b3217db4ed2E")
    *libmpl_token_metadata-*.rlib:*(".text._ZN76_$LT$core..option..Option$LT$T$GT$$u20$as$u20$borsh..ser..BorshSerialize$GT$9serialize17h69adcd78e41cac8eE")
    *libmpl_token_metadata-*.rlib:*(".text._ZN76_$LT$core..option..Option$LT$T$GT$$u20$as$u20$borsh..ser..BorshSerialize$GT$9serialize17h12d763268b0fc165E")
    *libmpl_token_metadata-*.rlib:*(".text._ZN77_$LT$core..option..Option$LT$T$GT$$u20$as$u20$borsh..de..BorshDeserialize$GT$18deserialize_reader17hed54eb32a3e0891bE")
    *libmpl_token_metadata-*.rlib:*(".text._ZN77_$LT$core..option..Option$LT$T$GT$$u20$as$u20$borsh..de..BorshDeserialize$GT$18deserialize_reader17hc3d42a5ebc7a0765E")
    *libmpl_token_metadata-*.rlib:*(".text._ZN77_$LT$core..option..Option$LT$T$GT$$u20$as$u20$borsh..de..BorshDeserialize$GT$18deserialize_reader17ha8a1f56742b6eecdE")
    *libmpl_token_metadata-*.rlib:*(".text._ZN77_$LT$core..option..Option$LT$T$GT$$u20$as$u20$borsh..de..BorshDeserialize$GT$18deserialize_reader17h6e37ed61ae52e324E")
    *libmpl_token_metadata-*.rlib:*(".text._ZN77_$LT$core..option..Option$LT$T$GT$$u20$as$u20$borsh..de..BorshDeserialize$GT$18deserialize_reader17h997e2158451a59ddE")
    *libmpl_token_metadata-*.rlib:*(".text._ZN77_$LT$core..option..Option$LT$T$GT$$u20$as$u20$borsh..de..BorshDeserialize$GT$18deserialize_reader17hf61edb399fadd03cE")
    *libmpl_token_metadata-*.rlib:*(".text._ZN77_$LT$core..option..Option$LT$T$GT$$u20$as$u20$borsh..de..BorshDeserialize$GT$18deserialize_reader17hd09c87f76840c4b1E")
    *libmpl_token_metadata-*.rlib:*(".text._ZN18mpl_token_metadata9generated12instructions26create_metadata_account_v323CreateMetadataAccountV311instruction17ha6702f1fc24a3fa4E")
    *libmpl_token_metadata-*.rlib:*(".text._ZN18mpl_token_metadata9generated12instructions26create_metadata_account_v323CreateMetadataAccountV335instruction_with_remaining_accounts17hb39bf40cb5358d3aE")
    *libmpl_token_metadata-*.rlib:*(".text._ZN18mpl_token_metadata6traits77_$LT$impl$u20$mpl_token_metadata..generated..accounts..metadata..Metadata$GT$16safe_deserialize17h5c13460512f7332bE")
    *libmpl_token_metadata-*.rlib:*(".text._ZN122_$LT$mpl_token_metadata..generated..types..collection_details..CollectionDetails$u20$as$u20$borsh..ser..BorshSerialize$GT$9serialize17hf63498c85281a2faE")
    *libmpl_token_metadata-*.rlib:*(".text._ZN100_$LT$mpl_token_metadata..generated..types..data_v2..DataV2$u20$as$u20$borsh..ser..BorshSerialize$GT$9serialize17h379ff1a936e0caf1E")
    *libmpl_token_metadata-*.rlib:*(".text._ZN95_$LT$mpl_token_metadata..generated..types..uses..Uses$u20$as$u20$borsh..ser..BorshSerialize$GT$9serialize17heef9d4727b66b2f7E")
    *libspl_token_2022-*.rlib:*(".text._ZN5alloc7raw_vec11finish_grow17he21ecaad2978559bE")
    *libspl_token_2022-*.rlib:*(".text.unlikely._ZN5alloc7raw_vec19RawVec$LT$T$C$A$GT$7reserve21do_reserve_and_handle17h44b5592aebd1eda2E")
    *libspl_token_2022-*.rlib:*(".text._ZN5alloc7raw_vec19RawVec$LT$T$C$A$GT$8grow_one17hdad16bf940bd0b06E")
    *libspl_token_2022-*.rlib:*(".text._ZN5alloc7raw_vec19RawVec$LT$T$C$A$GT$8grow_one17hf589fd6360cb59e1E")
    *libspl_token_2022-*.rlib:*(".text._ZN5alloc7raw_vec19RawVec$LT$T$C$A$GT$8grow_one17h965a993e4d5e7f09E")
    *libspl_token_2022-*.rlib:*(".text._ZN14spl_token_20229extension20group_member_pointer11instruction10initialize17hd32e94d650b3652cE")
    *libspl_token_2022-*.rlib:*(".text._ZN14spl_token_20229extension13group_pointer11instruction10initialize17h1d7981d0cacd43ccE")
    *libspl_token_2022-*.rlib:*(".text._ZN14spl_token_20229extension16metadata_pointer11instruction10initialize17h8f62d279d453be88E")
    *libspl_token_2022-*.rlib:*(".text._ZN14spl_token_20229extension12transfer_fee11instruction22TransferFeeInstruction4pack17h0c83bca80bc2754eE")
    *libspl_token_2022-*.rlib:*(".text._ZN14spl_token_20229extension12transfer_fee11instruction31harvest_withheld_tokens_to_mint17h52cd5580ba292814E")
    *libspl_token_2022-*.rlib:*(".text._ZN14spl_token_20229extension13transfer_hook11instruction10initialize17h0d9cfca5594d69c8E")
    *libspl_token_2022-*.rlib:*(".text._ZN14spl_token_20229extension23adjust_len_for_multisig17h138a354b4b62bc2fE")
    *libspl_token_2022-*.rlib:*(".text._ZN14spl_token_20229extension13ExtensionType21try_get_total_tlv_len17h54ed3d767d94060dE")
    *libspl_token_2022-*.rlib:*(".text._ZN14spl_token_202211instruction16TokenInstruction4pack17hfeca0a80d152aab7E")
    *libspl_token_2022-*.rlib:*(".text._ZN14spl_token_202211instruction16initialize_mint217h846de2ddc590935bE")
    *libspl_token_2022-*.rlib:*(".text._ZN14spl_token_202211instruction13set_authority17h3b51d9b2f79b909aE")
    *libspl_token_2022-*.rlib:*(".text._ZN14spl_token_202211instruction7mint_to17he16f4ba0b21c9131E")
    *libspl_token_2022-*.rlib:*(".text._ZN14spl_token_202211instruction4burn17h2a7fca9e3b059c69E")
    *libspl_token_2022-*.rlib:*(".text._ZN14spl_token_202211instruction13close_account17hb75d3006aa316a7aE")
    *libspl_token_2022-*.rlib:*(".text._ZN14spl_token_202211instruction16transfer_checked17he7c6d648b34ca87fE")
    *libspl_token_2022-*.rlib:*(".text._ZN14spl_token_202211instruction31initialize_mint_close_authority17hae8ec33c998fe45cE")
    *libspl_token_2022-*.rlib:*(".text._ZN14spl_token_202211instruction32initialize_non_transferable_mint17hd38b172077c8d5daE")
    *libspl_token_2022-*.rlib:*(".text._ZN73_$LT$spl_token_2022..state..Mint$u20$as$u20$solana_program_pack..Pack$GT$17unpack_from_slice17hb11a1c0233408e56E")
    *libspl_token_2022-*.rlib:*(".text._ZN76_$LT$spl_token_2022..state..Account$u20$as$u20$solana_program_pack..Pack$GT$17unpack_from_slice17hc3becab88fd02c53E")
    *libspl_token-*.rlib:*(".text._ZN5alloc7raw_vec11finish_grow17hf61494253fa7a29cE")
    *libspl_token-*.rlib:*(".text.unlikely._ZN5alloc7raw_vec19RawVec$LT$T$C$A$GT$7reserve21do_reserve_and_handle17h831e6668823e9f84E")
    *libspl_token-*.rlib:*(".text._ZN5alloc7raw_vec19RawVec$LT$T$C$A$GT$8grow_one17hd67f81b21c42f250E")
    *libspl_token-*.rlib:*(".text._ZN9spl_token11instruction16TokenInstruction4pack17h1c034d953107d74cE")
    *libspl_token-*.rlib:*(".text._ZN9spl_token11instruction13set_authority17hf0a910c36c979b64E")
    *libspl_token-*.rlib:*(".text._ZN9spl_token11instruction7mint_to17h0089657767cb489cE")
    *libspl_token-*.rlib:*(".text._ZN9spl_token11instruction11sync_native17h31602471f5a2c7b2E")
    *libspl_token-*.rlib:*(".text._ZN68_$LT$spl_token..state..Mint$u20$as$u20$solana_program_pack..Pack$GT$17unpack_from_slice17hd07b6f9c000a6b17E")
    *libspl_token-*.rlib:*(".text._ZN71_$LT$spl_token..state..Account$u20$as$u20$solana_program_pack..Pack$GT$17unpack_from_slice17ha6f46e426aa62893E")
    *libspl_token_metadata_interface-*.rlib:*(".text._ZN12solana_borsh2v123get_instance_packed_len17h60329a6cc4f89f74E")
    *libspl_token_metadata_interface-*.rlib:*(".text._ZN3std2io5Write9write_all17h8b9a578ea943398cE")
    *libspl_token_metadata_interface-*.rlib:*(".text._ZN3std2io5error14repr_bitpacked14kind_from_prim17h357bcb36090597d1E")
    *libspl_token_metadata_interface-*.rlib:*(".text._ZN4core3ptr42drop_in_place$LT$std..io..error..Error$GT$17h741cbdb3e5f06992E")
    *libspl_token_metadata_interface-*.rlib:*(".text._ZN4core3ptr88drop_in_place$LT$spl_token_metadata_interface..instruction..TokenMetadataInstruction$GT$17hf07d5e4dc2640443E")
    *libspl_token_metadata_interface-*.rlib:*(".text._ZN58_$LT$$u5b$T$u5d$$u20$as$u20$borsh..ser..BorshSerialize$GT$9serialize17h209bc7d04872d2bcE")
    *libspl_token_metadata_interface-*.rlib:*(".text._ZN5alloc7raw_vec11finish_grow17h948b770b5c49a830E")
    *libspl_token_metadata_interface-*.rlib:*(".text.unlikely._ZN5alloc7raw_vec19RawVec$LT$T$C$A$GT$7reserve21do_reserve_and_handle17h2b23e25bc4a44b8bE")
    *libspl_token_metadata_interface-*.rlib:*(".text._ZN71_$LT$alloc..vec..Vec$LT$T$GT$$u20$as$u20$borsh..ser..BorshSerialize$GT$9serialize17h5731ec2d54d986f7E")
    *libspl_token_metadata_interface-*.rlib:*(".text._ZN28spl_token_metadata_interface11instruction24TokenMetadataInstruction4pack17h397c6ad77ef87e52E")
    *libspl_token_metadata_interface-*.rlib:*(".text._ZN28spl_token_metadata_interface11instruction10initialize17h79cc36d6fd1bd8d3E")
    *libspl_token_metadata_interface-*.rlib:*(".text._ZN28spl_token_metadata_interface11instruction16update_authority17ha98f30000e8eded4E")
    *libspl_token_metadata_interface-*.rlib:*(".text._ZN128_$LT$spl_token_metadata_interface..state..TokenMetadata$u20$as$u20$spl_type_length_value..variable_len_pack..VariableLenPack$GT$14get_packed_len17h624684d6e2b79c0eE")
    *libspl_pod-*.rlib:*(".text._ZN145_$LT$spl_pod..optional_keys..OptionalNonZeroPubkey$u20$as$u20$core..convert..TryFrom$LT$core..option..Option$LT$solana_pubkey..Pubkey$GT$$GT$$GT$8try_from17hc4273da0e1dc5267E")
    *libspl_associated_token_account_client-*.rlib:*(".text._ZN35spl_associated_token_account_client7address44get_associated_token_address_with_program_id17ha02765ea535ac9e1E")
    *libspl_associated_token_account_client-*.rlib:*(".text._ZN35spl_associated_token_account_client11instruction42build_associated_token_account_instruction17he2789df0763e9f81E")
    *libspl_associated_token_account_client-*.rlib:*(".text._ZN35spl_associated_token_account_client11instruction31create_associated_token_account17h709fed41ceb95c3bE")
    *libspl_associated_token_account_client-*.rlib:*(".text._ZN35spl_associated_token_account_client11instruction42create_associated_token_account_idempotent17h4223a67c67ddacf1E")
    *libanchor_lang-*.rlib:*(".text._ZN3std2io5error5Error3new17h49b9f72f36c57737E")
    *libanchor_lang-*.rlib:*(".text._ZN42_$LT$$RF$T$u20$as$u20$core..fmt..Debug$GT$3fmt17hc629f2a5af7ee64dE")
    *libanchor_lang-*.rlib:*(".text._ZN42_$LT$$RF$T$u20$as$u20$core..fmt..Debug$GT$3fmt17hf09f119409077e23E")
    *libanchor_lang-*.rlib:*(".text._ZN44_$LT$$RF$T$u20$as$u20$core..fmt..Display$GT$3fmt17h74c3478a856f71b4E")
    *libanchor_lang-*.rlib:*(".text._ZN44_$LT$$RF$T$u20$as$u20$core..fmt..Display$GT$3fmt17h3a9e8f4e899f047aE")
    *libanchor_lang-*.rlib:*(".text._ZN4core3fmt5Write9write_fmt17h2d7f7712d8e8941dE")
    *libanchor_lang-*.rlib:*(".text._ZN4core3fmt9Formatter9write_fmt17ha225da5d76e7eb00E")
    *libanchor_lang-*.rlib:*(".text._ZN4core3ptr205drop_in_place$LT$$LT$alloc..boxed..Box$LT$dyn$u20$core..error..Error$u2b$core..marker..Sync$u2b$core..marker..Send$GT$$u20$as$u20$core..convert..From$LT$alloc..string..String$GT$$GT$..from..StringError$GT$17h3d9275238cd0aebdE")
    *libanchor_lang-*.rlib:*(".text._ZN4core3ptr28drop_in_place$LT$$RF$str$GT$17hb053501fc7258821E")
    *libanchor_lang-*.rlib:*(".text._ZN4core3ptr37drop_in_place$LT$core..fmt..Error$GT$17h484459ff8f5610c6E")
    *libanchor_lang-*.rlib:*(".text._ZN4core3ptr42drop_in_place$LT$alloc..string..String$GT$17hd7847ebb192a45e1E")
    *libanchor_lang-*.rlib:*(".text._ZN4core3ptr47drop_in_place$LT$solana_pubkey..PubkeyError$GT$17hd57194ba2dce436aE")
    *libanchor_lang-*.rlib:*(".text._ZN4core3ptr74drop_in_place$LT$$u5b$solana_account_info..AccountInfo$u3b$$u20$2$u5d$$GT$17he7671e1bbe6654beE")
    *libanchor_lang-*.rlib:*(".text._ZN4core3ptr74drop_in_place$LT$$u5b$solana_account_info..AccountInfo$u3b$$u20$3$u5d$$GT$17hc2c21df1c723f71dE")
    *libanchor_lang-*.rlib:*(".text._ZN4core3ptr76drop_in_place$LT$alloc..vec..Vec$LT$solana_account_info..AccountInfo$GT$$GT$17h031ff73d9721cac2E")
    *libanchor_lang-*.rlib:*(".text._ZN4core5error5Error5cause17hf87aa267f54a974eE")
    *libanchor_lang-*.rlib:*(".text._ZN4core5error5Error7provide17ha9252dba9b3e6ef7E")
    *libanchor_lang-*.rlib:*(".text._ZN4core5error5Error7type_id17hb738d0ae8b1b3d29E")
    *libanchor_lang-*.rlib:*(".text._ZN52_$LT$T$u20$as$u20$alloc..slice..hack..ConvertVec$GT$6to_vec17h58a9ca4b6556daf8E")
    *libanchor_lang-*.rlib:*(".text._ZN53_$LT$core..fmt..Error$u20$as$u20$core..fmt..Debug$GT$3fmt17h85666afa16c4890eE")
    *libanchor_lang-*.rlib:*(".text._ZN58_$LT$alloc..string..String$u20$as$u20$core..fmt..Write$GT$10write_char17hfde5b685689164ccE")
    *libanchor_lang-*.rlib:*(".text._ZN58_$LT$alloc..string..String$u20$as$u20$core..fmt..Write$GT$9write_str17h4b62f46a222bd5b2E")
    *libanchor_lang-*.rlib:*(".text._ZN5alloc7raw_vec11finish_grow17h69df3ca7ab466e15E")
    *libanchor_lang-*.rlib:*(".text.unlikely._ZN5alloc7raw_vec19RawVec$LT$T$C$A$GT$7reserve21do_reserve_and_handle17hdd501ebd6e3a4cbcE")
    *libanchor_lang-*.rlib:*(".text._ZN5alloc7raw_vec19RawVec$LT$T$C$A$GT$8grow_one17haf3681b0c174580aE")
    *libanchor_lang-*.rlib:*(".text._ZN60_$LT$alloc..string..String$u20$as$u20$core..fmt..Display$GT$3fmt17heb0494973da8b0beE")
    *libanchor_lang-*.rlib:*(".text._ZN63_$LT$solana_pubkey..PubkeyError$u20$as$u20$core..fmt..Debug$GT$3fmt17h8fc110c9d09a131fE")
    *libanchor_lang-*.rlib:*(".text._ZN71_$LT$solana_program_error..ProgramError$u20$as$u20$core..fmt..Debug$GT$3fmt17h33e8d6b26dda9bffE")
    *libanchor_lang-*.rlib:*(".text._ZN73_$LT$solana_program_error..ProgramError$u20$as$u20$core..clone..Clone$GT$5clone17h8f4703fba7311a0cE")
    *libanchor_lang-*.rlib:*(".text._ZN11anchor_lang8accounts12account_info90_$LT$impl$u20$anchor_lang..ToAccountInfos$u20$for$u20$solana_account_info..AccountInfo$GT$16to_account_infos17h6bcc8bb8409b0e63E")
    *libanchor_lang-*.rlib:*(".text._ZN11anchor_lang8accounts6signer6Signer8try_from17h5b68cfab3faee67bE")
    *libanchor_lang-*.rlib:*(".text._ZN101_$LT$anchor_lang..bpf_writer..BpfWriter$LT$$RF$mut$u20$$u5b$u8$u5d$$GT$$u20$as$u20$std..io..Write$GT$9write_all17ha44565a12b5a2b56E")
    *libanchor_lang-*.rlib:*(".text._ZN11anchor_lang6common5close17h9d7c537725ff59f4E")
    *libanchor_lang-*.rlib:*(".text._ZN11anchor_lang6common9is_closed17he9edb2ac1700dc1aE")
    *libanchor_lang-*.rlib:*(".text._ZN104_$LT$anchor_lang..error..Error$u20$as$u20$core..convert..From$LT$anchor_lang..error..AnchorError$GT$$GT$4from17h4ec711440ff80a00E")
    *libanchor_lang-*.rlib:*(".text._ZN107_$LT$anchor_lang..error..Error$u20$as$u20$core..convert..From$LT$solana_program_error..ProgramError$GT$$GT$4from17ha4865197be4b9a2fE")
    *libanchor_lang-*.rlib:*(".text._ZN94_$LT$anchor_lang..error..Error$u20$as$u20$core..convert..From$LT$std..io..error..Error$GT$$GT$4from17hbd7f1286cbbfd7a2E")
    *libanchor_lang-*.rlib:*(".text._ZN106_$LT$anchor_lang..error..Error$u20$as$u20$core..convert..From$LT$core..num..error..TryFromIntError$GT$$GT$4from17h9cd348e4f6bb5e13E")
    *libanchor_lang-*.rlib:*(".text._ZN11anchor_lang5error5Error3log17h67ef5df1eff115acE")
    *libanchor_lang-*.rlib:*(".text._ZN11anchor_lang5error5Error17with_account_name17h63cb4e0e45294ce6E")
    *libanchor_lang-*.rlib:*(".text._ZN11anchor_lang5error5Error12with_pubkeys17hca6dbbbe6a9a5da7E")
    *libanchor_lang-*.rlib:*(".text._ZN11anchor_lang5error22ProgramErrorWithOrigin3log17h46e3d2dc6af525d2E")
    *libanchor_lang-*.rlib:*(".text._ZN11anchor_lang5error11AnchorError3log17h25bb33ee3a3445f4E")
    *libanchor_lang-*.rlib:*(".text._ZN11anchor_lang5error117_$LT$impl$u20$core..convert..From$LT$anchor_lang..error..Error$GT$$u20$for$u20$solana_program_error..ProgramError$GT$4from17h50c1869550ee9669E")
    *libanchor_lang-*.rlib:*(".text._ZN11anchor_lang3idl10IdlAccount7address17h34449f269156ef56E")
    *libanchor_lang-*.rlib:*(".text._ZN11anchor_lang14system_program8allocate17hcf3e1f1e914bbb36E")
    *libanchor_lang-*.rlib:*(".text._ZN11anchor_lang14system_program6assign17hff5ff84b6cc28d37E")
    *libanchor_lang-*.rlib:*(".text._ZN11anchor_lang14system_program14create_account17hec3080396dc1aba7E")
    *libanchor_lang-*.rlib:*(".text._ZN11anchor_lang14system_program8transfer17h30816397b17e9494E")
    *libanchor_lang-*.rlib:*(".text._ZN11anchor_lang14system_program18transfer_with_seed17hd4bc5e890252ee76E")
    *libanchor_lang-*.rlib:*(".text._ZN11anchor_lang5error9ErrorCode4name17h4f8143ac990f2107E")
    *libanchor_lang-*.rlib:*(".text._ZN102_$LT$anchor_lang..error..Error$u20$as$u20$core..convert..From$LT$anchor_lang..error..ErrorCode$GT$$GT$4from17hb49236445887dbb0E")
    *libanchor_lang-*.rlib:*(".text._ZN68_$LT$anchor_lang..error..ErrorCode$u20$as$u20$core..fmt..Display$GT$3fmt17h3149de8d83148b03E")
    *libanchor_lang-*.rlib:*(".text._ZN80_$LT$anchor_lang..idl..IdlAccount$u20$as$u20$anchor_lang..AccountDeserialize$GT$15try_deserialize17h0a0b727184e45895E")
    *libanchor_lang-*.rlib:*(".text._ZN80_$LT$anchor_lang..idl..IdlAccount$u20$as$u20$anchor_lang..AccountDeserialize$GT$25try_deserialize_unchecked17h465dfe6a3ed33fe0E")
    *libsolana_program-*.rlib:*(".text._ZN14solana_program3log12sol_log_data17h1e024b73f122854fE")
    *libsolana_program-*.rlib:*(".text._ZN14solana_program7program6invoke17haf08bc5ab5ce16cdE")
    *libsolana_program-*.rlib:*(".text._ZN14solana_program7program13invoke_signed17h01c3b84bc1fc491eE")
    *libsolana_program-*.rlib:*(".text._ZN14solana_program7program15set_return_data17hd44314d45a78470cE")
    *libsolana_program-*.rlib:*(".text._ZN14solana_program7program15get_return_data17h4ed843c3646c0cefE")
    *libsolana_borsh-*.rlib:*(".text._ZN65_$LT$solana_borsh..v1..WriteCounter$u20$as$u20$std..io..Write$GT$5write17he97dd9a57015c83fE")
    *libsolana_sysvar-*.rlib:*(".text._ZN13solana_sysvar5clock71_$LT$impl$u20$solana_sysvar..Sysvar$u20$for$u20$solana_clock..Clock$GT$3get17hf864a57fc372ac1bE")
    *libsolana_sysvar-*.rlib:*(".text._ZN13solana_sysvar4rent69_$LT$impl$u20$solana_sysvar..Sysvar$u20$for$u20$solana_rent..Rent$GT$3get17hd4b89a48ea901882E")
    *libsolana_rent-*.rlib:*(".text._ZN11solana_rent4Rent15minimum_balance17h06f7367e702730e1E")
    *libsolana_rent-*.rlib:*(".text._ZN11solana_rent4Rent9is_exempt17hf5063b3ea1a13284E")
    *libsolana_rent-*.rlib:*(".text._ZN11solana_rent6sysvar74_$LT$impl$u20$solana_sysvar_id..SysvarId$u20$for$u20$solana_rent..Rent$GT$8check_id17hc1c442a53a45f194E")
    *libsolana_program_entrypoint-*.rlib:*(".text._ZN5alloc7raw_vec11finish_grow17hfff2fa5211039aa8E")
    *libsolana_program_entrypoint-*.rlib:*(".text._ZN5alloc7raw_vec19RawVec$LT$T$C$A$GT$8grow_one17h638f5e883bf4bc9eE")
    *libsolana_program_entrypoint-*.rlib:*(".text._ZN25solana_program_entrypoint11deserialize17h58b2ff8cb9e94bf5E")
    *libsolana_cpi-*.rlib:*(".text._ZN10solana_cpi23invoke_signed_unchecked17h29c3e5ddf8e2a195E")
    *libsolana_cpi-*.rlib:*(".text._ZN10solana_cpi15set_return_data17h5fe9b553a761ef6eE")
    *libsolana_cpi-*.rlib:*(".text._ZN10solana_cpi15get_return_data17h1638e3e798a8fa5bE")
    *libsolana_account_info-*.rlib:*(".text._ZN41_$LT$bool$u20$as$u20$core..fmt..Debug$GT$3fmt17ha1b7b3de7be44e11E")
    *libsolana_account_info-*.rlib:*(".text._ZN42_$LT$$RF$T$u20$as$u20$core..fmt..Debug$GT$3fmt17h4559e188727ffbdfE")
    *libsolana_account_info-*.rlib:*(".text._ZN4core3fmt3num50_$LT$impl$u20$core..fmt..Debug$u20$for$u20$u64$GT$3fmt17ha41bc41457914c76E")
    *libsolana_account_info-*.rlib:*(".text._ZN4core3fmt3num52_$LT$impl$u20$core..fmt..Debug$u20$for$u20$usize$GT$3fmt17h92ca3aff4bf1c48dE")
    *libsolana_account_info-*.rlib:*(".text._ZN4core3ptr24drop_in_place$LT$u64$GT$17h722859e93607615dE")
    *libsolana_account_info-*.rlib:*(".text._ZN4core3ptr25drop_in_place$LT$bool$GT$17h25852b4d3fc6c83bE")
    *libsolana_account_info-*.rlib:*(".text._ZN81_$LT$solana_account_info..debug_account_data..Hex$u20$as$u20$core..fmt..Debug$GT$3fmt17h32ea60aec043a266E")
    *libsolana_account_info-*.rlib:*(".text._ZN69_$LT$solana_account_info..AccountInfo$u20$as$u20$core..fmt..Debug$GT$3fmt17hef223caa78368864E")
    *libsolana_account_info-*.rlib:*(".text._ZN19solana_account_info11AccountInfo8lamports17h0ca2b04e77f2c7d8E")
    *libsolana_account_info-*.rlib:*(".text._ZN19solana_account_info11AccountInfo8data_len17hc7887ca2703f481dE")
    *libsolana_account_info-*.rlib:*(".text._ZN19solana_account_info11AccountInfo12try_data_len17h96e1c2e8a86a3037E")
    *libsolana_account_info-*.rlib:*(".text._ZN19solana_account_info11AccountInfo13data_is_empty17h4cbad3bc61143bcfE")
    *libsolana_account_info-*.rlib:*(".text._ZN19solana_account_info11AccountInfo19try_borrow_lamports17h7ffa9b9c90c53c02E")
    *libsolana_account_info-*.rlib:*(".text._ZN19solana_account_info11AccountInfo23try_borrow_mut_lamports17hc75a8bf8e315e81bE")
    *libsolana_account_info-*.rlib:*(".text._ZN19solana_account_info11AccountInfo15try_borrow_data17hb083aa8a48fb7724E")
    *libsolana_account_info-*.rlib:*(".text._ZN19solana_account_info11AccountInfo19try_borrow_mut_data17h544b4a458d62062bE")
    *libsolana_account_info-*.rlib:*(".text._ZN19solana_account_info11AccountInfo7realloc17hc533e0163a3ca210E")
    *libsolana_account_info-*.rlib:*(".text._ZN19solana_account_info11AccountInfo6assign17h7a55a46b81f02e00E")
    *libsolana_program_error-*.rlib:*(".text._ZN44_$LT$$RF$T$u20$as$u20$core..fmt..Display$GT$3fmt17h660bd7783ca09077E")
    *libsolana_program_error-*.rlib:*(".text._ZN45_$LT$$RF$T$u20$as$u20$core..fmt..LowerHex$GT$3fmt17hdf06088e8216d91cE")
    *libsolana_program_error-*.rlib:*(".text._ZN73_$LT$solana_program_error..ProgramError$u20$as$u20$core..fmt..Display$GT$3fmt17h1e188b40faa0cb24E")
    *libsolana_program_error-*.rlib:*(".text._ZN20solana_program_error95_$LT$impl$u20$core..convert..From$LT$solana_program_error..ProgramError$GT$$u20$for$u20$u64$GT$4from17hb8aed36b45674346E")
    *libsolana_program_error-*.rlib:*(".text._ZN85_$LT$solana_program_error..ProgramError$u20$as$u20$core..convert..From$LT$u64$GT$$GT$4from17haa3345210f69a42fE")
    *libsolana_program_error-*.rlib:*(".text._ZN103_$LT$solana_program_error..ProgramError$u20$as$u20$core..convert..From$LT$std..io..error..Error$GT$$GT$4from17h5a7def7b19a40fd7E")
    *libsolana_system_interface-*.rlib:*(".text._ZN13solana_pubkey1_78_$LT$impl$u20$serde_core..ser..Serialize$u20$for$u20$solana_pubkey..Pubkey$GT$9serialize17h91e068a4628b766bE")
    *libsolana_system_interface-*.rlib:*(".text._ZN18solana_instruction11Instruction16new_with_bincode17h150dad522d376173E")
    *libsolana_system_interface-*.rlib:*(".text._ZN42_$LT$$RF$T$u20$as$u20$core..fmt..Debug$GT$3fmt17h8b29659473c3c701E")
    *libsolana_system_interface-*.rlib:*(".text._ZN42_$LT$$RF$T$u20$as$u20$core..fmt..Debug$GT$3fmt17h44c9329f2f481a15E")
    *libsolana_system_interface-*.rlib:*(".text._ZN42_$LT$$RF$T$u20$as$u20$core..fmt..Debug$GT$3fmt17h928637304d467304E")
    *libsolana_system_interface-*.rlib:*(".text._ZN42_$LT$$RF$T$u20$as$u20$core..fmt..Debug$GT$3fmt17h12dcad81600c5d64E")
    *libsolana_system_interface-*.rlib:*(".text._ZN42_$LT$$RF$T$u20$as$u20$core..fmt..Debug$GT$3fmt17h6299f5bbf81949dfE")
    *libsolana_system_interface-*.rlib:*(".text._ZN42_$LT$$RF$T$u20$as$u20$core..fmt..Debug$GT$3fmt17h28b5f2de83974917E")
    *libsolana_system_interface-*.rlib:*(".text._ZN4core3fmt3num52_$LT$impl$u20$core..fmt..Debug$u20$for$u20$usize$GT$3fmt17h92ca3aff4bf1c48dE")
    *libsolana_system_interface-*.rlib:*(".text._ZN4core3ptr26drop_in_place$LT$usize$GT$17h70c9f418575e7f5eE")
    *libsolana_system_interface-*.rlib:*(".text._ZN4core3ptr71drop_in_place$LT$alloc..boxed..Box$LT$bincode..error..ErrorKind$GT$$GT$17hcdc72ddeae465c9bE")
    *libsolana_system_interface-*.rlib:*(".text._ZN5alloc7raw_vec11finish_grow17hdc7772e3b6f77696E")
    *libsolana_system_interface-*.rlib:*(".text.unlikely._ZN5alloc7raw_vec19RawVec$LT$T$C$A$GT$7reserve21do_reserve_and_handle17h19cbebac703ce804E")
    *libsolana_system_interface-*.rlib:*(".text._ZN67_$LT$alloc..boxed..Box$LT$T$C$A$GT$$u20$as$u20$core..fmt..Debug$GT$3fmt17ha5eba5405709d071E")
    *libsolana_system_interface-*.rlib:*(".text._ZN23solana_system_interface11instruction14create_account17h6121d69cf48fb40dE")
    *libsolana_system_interface-*.rlib:*(".text._ZN23solana_system_interface11instruction24create_account_with_seed17hae92c3b160cb71c3E")
    *libsolana_system_interface-*.rlib:*(".text._ZN23solana_system_interface11instruction6assign17h3ce5c7e2e06ac7d2E")
    *libsolana_system_interface-*.rlib:*(".text._ZN23solana_system_interface11instruction8transfer17h1b1fbf6c69a2e7bdE")
    *libsolana_system_interface-*.rlib:*(".text._ZN23solana_system_interface11instruction18transfer_with_seed17h1afab979dad0e39bE")
    *libsolana_system_interface-*.rlib:*(".text._ZN23solana_system_interface11instruction8allocate17h203b3275556d3462E")
    *libsolana_instruction-*.rlib:*(".text._ZN18solana_instruction11Instruction14new_with_bytes17h836fab8fb6401158E")
    *libbincode-*.rlib:*(".text._ZN7bincode5error129_$LT$impl$u20$core..convert..From$LT$std..io..error..Error$GT$$u20$for$u20$alloc..boxed..Box$LT$bincode..error..ErrorKind$GT$$GT$4from17h0a847bc26ba85aafE")
    *libsolana_sdk_ids-*.rlib:*(".text._ZN14solana_sdk_ids6sysvar4rent8check_id17h384c6eb64c87b9dfE")
    *libsolana_pubkey-*.rlib:*(".text._ZN42_$LT$$RF$T$u20$as$u20$core..fmt..Debug$GT$3fmt17h077ac071f05442b5E")
    *libsolana_pubkey-*.rlib:*(".text._ZN42_$LT$$RF$T$u20$as$u20$core..fmt..Debug$GT$3fmt17hb16df079a9fe81fcE")
    *libsolana_pubkey-*.rlib:*(".text._ZN4core3fmt3num52_$LT$impl$u20$core..fmt..Debug$u20$for$u20$usize$GT$3fmt17h92ca3aff4bf1c48dE")
    *libsolana_pubkey-*.rlib:*(".text._ZN4core3ptr101drop_in_place$LT$$RF$alloc..vec..Vec$LT$$LP$alloc..string..String$C$alloc..string..String$RP$$GT$$GT$17h145071736d872267E")
    *libsolana_pubkey-*.rlib:*(".text._ZN4core3ptr40drop_in_place$LT$bs58..encode..Error$GT$17hcb68b00c4d39fa07E")
    *libsolana_pubkey-*.rlib:*(".text._ZN56_$LT$bs58..encode..Error$u20$as$u20$core..fmt..Debug$GT$3fmt17hbd8d9bf83541067cE")
    *libsolana_pubkey-*.rlib:*(".text._ZN64_$LT$core..str..error..Utf8Error$u20$as$u20$core..fmt..Debug$GT$3fmt17h2fa41155b122786bE")
    *libsolana_pubkey-*.rlib:*(".text._ZN13solana_pubkey6Pubkey16create_with_seed17h3aed4c8b4797b187E")
    *libsolana_pubkey-*.rlib:*(".text._ZN13solana_pubkey6Pubkey20find_program_address17h57945082f260e69dE")
    *libsolana_pubkey-*.rlib:*(".text._ZN13solana_pubkey6Pubkey22create_program_address17hd01da4058de4993eE")
    *libsolana_pubkey-*.rlib:*(".text._ZN13solana_pubkey6Pubkey3log17h9fb422368b4f937eE")
    *libsolana_pubkey-*.rlib:*(".text._ZN13solana_pubkey15write_as_base5817h626988d815281065E")
    *libsolana_pubkey-*.rlib:*(".text._ZN58_$LT$solana_pubkey..Pubkey$u20$as$u20$core..fmt..Debug$GT$3fmt17h0be84a3310f6ca2bE")
    *libborsh-*.rlib:*(".text._ZN3std2io5error14repr_bitpacked14kind_from_prim17h357bcb36090597d1E")
    *libborsh-*.rlib:*(".text._ZN3std2io5error5Error3new17he832ce4eaf1029fbE")
    *libborsh-*.rlib:*(".text._ZN4core3ptr205drop_in_place$LT$$LT$alloc..boxed..Box$LT$dyn$u20$core..error..Error$u2b$core..marker..Sync$u2b$core..marker..Send$GT$$u20$as$u20$core..convert..From$LT$alloc..string..String$GT$$GT$..from..StringError$GT$17h8b2327f9044efadaE")
    *libborsh-*.rlib:*(".text._ZN4core5error5Error5cause17he921f99a702beb57E")
    *libborsh-*.rlib:*(".text._ZN4core5error5Error7provide17haba10cf311548053E")
    *libborsh-*.rlib:*(".text._ZN4core5error5Error7type_id17h39b9187e3d15274aE")
    *libborsh-*.rlib:*(".text._ZN5borsh2de44unexpected_eof_to_unexpected_length_of_input17h0c10e5925485b863E")
    *libsolana_sha256_hasher-*.rlib:*(".text._ZN20solana_sha256_hasher5hashv17he612c0350bffd221E")
    *libbs58-*.rlib:*(".text._ZN4bs586encode15max_encoded_len17h172d102a92bba951E")
    *libstd-*.rlib:*(".text._ZN42_$LT$$RF$T$u20$as$u20$core..fmt..Debug$GT$3fmt17hacd4ffaa7c47be3eE")
    *libstd-*.rlib:*(".text._ZN42_$LT$$RF$T$u20$as$u20$core..fmt..Debug$GT$3fmt17hb3a48d441e166368E")
    *libstd-*.rlib:*(".text._ZN44_$LT$$RF$T$u20$as$u20$core..fmt..Display$GT$3fmt17h4a12aaf00bc6eb91E")
    *libstd-*.rlib:*(".text._ZN4core3fmt3num50_$LT$impl$u20$core..fmt..Debug$u20$for$u20$i32$GT$3fmt17hc11af8c6428b7be9E")
    *libstd-*.rlib:*(".text._ZN4core3ptr122drop_in_place$LT$$RF$alloc..boxed..Box$LT$dyn$u20$core..error..Error$u2b$core..marker..Sync$u2b$core..marker..Send$GT$$GT$17hffb69c92d326aa89E")
    *libstd-*.rlib:*(".text._ZN4core3ptr24drop_in_place$LT$i32$GT$17h5892138452e8d0acE")
    *libstd-*.rlib:*(".text._ZN4core3ptr25drop_in_place$LT$bool$GT$17hc0900eae472d6565E")
    *libstd-*.rlib:*(".text._ZN4core3ptr42drop_in_place$LT$alloc..string..String$GT$17hbac89b01ec5b6e98E")
    *libstd-*.rlib:*(".text._ZN58_$LT$alloc..string..String$u20$as$u20$core..fmt..Debug$GT$3fmt17he9ae983dac9351bdE")
    *libstd-*.rlib:*(".text._ZN60_$LT$alloc..string..String$u20$as$u20$core..fmt..Display$GT$3fmt17heb0494973da8b0beE")
    *libstd-*.rlib:*(".text._ZN3std2io5error14repr_bitpacked14kind_from_prim17h357bcb36090597d1E")
    *libstd-*.rlib:*(".text._ZN58_$LT$std..io..error..Error$u20$as$u20$core..fmt..Debug$GT$3fmt17had9d55c5608fe73bE")
    *libstd-*.rlib:*(".text._ZN3std2io5error9ErrorKind6as_str17h9f2f9fbb981740c3E")
    *libstd-*.rlib:*(".text._ZN3std2io5error5Error4_new17h22f74a6f7f505a25E")
    *libstd-*.rlib:*(".text._ZN3std2io5error83_$LT$impl$u20$core..fmt..Debug$u20$for$u20$std..io..error..repr_bitpacked..Repr$GT$3fmt17h882efd8da84ce68bE")
    *libstd-*.rlib:*(".text._ZN60_$LT$std..io..error..Error$u20$as$u20$core..fmt..Display$GT$3fmt17h6f1fce23b165cb49E")
    *libstd-*.rlib:*(".text.unlikely._ZN3std7process5abort17h6e9c75c1fb1896a3E")
    *libstd-*.rlib:*(".text.rust_begin_unwind")
    *libstd-*.rlib:*(".text._ZN62_$LT$std..io..error..ErrorKind$u20$as$u20$core..fmt..Debug$GT$3fmt17h7056c3897a928533E")
    *libstd-*.rlib:*(".text._ZN3std3sys3pal3sbf7sol_log17h72e39c62458c86feE")
    *libstd-*.rlib:*(".text._ZN3std3sys3pal3sbf5panic17h0bde0aa91ab47d38E")
    *libstd-*.rlib:*(".text._ZN3std3sys3pal3sbf14abort_internal17h3bd5992ddcab11c6E")
    *libstd-*.rlib:*(".text._ZN3std5alloc8rust_oom17he7a3a8dfb7e1e822E")
    *libstd-*.rlib:*(".text.__rg_oom")
    *liballoc-*.rlib:*(".text._ZN4core3fmt5Write9write_fmt17h41853e2b01bf2bf4E")
    *liballoc-*.rlib:*(".text._ZN4core3ptr37drop_in_place$LT$core..fmt..Error$GT$17h727a76ec9e106744E")
    *liballoc-*.rlib:*(".text._ZN4core3ptr42drop_in_place$LT$alloc..string..String$GT$17hf9f11e0679d775efE")
    *liballoc-*.rlib:*(".text._ZN53_$LT$core..fmt..Error$u20$as$u20$core..fmt..Debug$GT$3fmt17h85666afa16c4890eE")
    *liballoc-*.rlib:*(".text._ZN5alloc7raw_vec17capacity_overflow17ha1c10832a9d67d74E")
    *liballoc-*.rlib:*(".text.unlikely._ZN5alloc7raw_vec19RawVec$LT$T$C$A$GT$7reserve21do_reserve_and_handle17hfb848a1eba01a183E")
    *liballoc-*.rlib:*(".text._ZN5alloc7raw_vec19RawVec$LT$T$C$A$GT$8grow_one17h3266ee234dbf1514E")
    *liballoc-*.rlib:*(".text._ZN5alloc7raw_vec11finish_grow17h2a9b58a4d29975d9E")
    *liballoc-*.rlib:*(".text.unlikely._ZN5alloc7raw_vec12handle_error17h22fdf317f3a37641E")
    *liballoc-*.rlib:*(".text.unlikely._ZN5alloc5alloc18handle_alloc_error17hdf8d5797c8d8bbffE")
    *liballoc-*.rlib:*(".text._ZN223_$LT$$LT$alloc..boxed..Box$LT$dyn$u20$core..error..Error$u2b$core..marker..Sync$u2b$core..marker..Send$GT$$u20$as$u20$core..convert..From$LT$alloc..string..String$GT$$GT$..from..StringError$u20$as$u20$core..error..Error$GT$11description17hf25e5ff77ea0398dE")
    *liballoc-*.rlib:*(".text._ZN223_$LT$$LT$alloc..boxed..Box$LT$dyn$u20$core..error..Error$u2b$core..marker..Sync$u2b$core..marker..Send$GT$$u20$as$u20$core..convert..From$LT$alloc..string..String$GT$$GT$..from..StringError$u20$as$u20$core..fmt..Display$GT$3fmt17h90a7b52b4b824722E")
    *liballoc-*.rlib:*(".text._ZN221_$LT$$LT$alloc..boxed..Box$LT$dyn$u20$core..error..Error$u2b$core..marker..Sync$u2b$core..marker..Send$GT$$u20$as$u20$core..convert..From$LT$alloc..string..String$GT$$GT$..from..StringError$u20$as$u20$core..fmt..Debug$GT$3fmt17hec448305f4a90e51E")
    *liballoc-*.rlib:*(".text._ZN5alloc3fmt6format12format_inner17ha2861f2eb5816c39E")
    *liballoc-*.rlib:*(".text._ZN5alloc6string6String4push17h96dfc48c19bd6e38E")
    *liballoc-*.rlib:*(".text._ZN67_$LT$alloc..string..FromUtf8Error$u20$as$u20$core..fmt..Display$GT$3fmt17h876048dc57804b5eE")
    *liballoc-*.rlib:*(".text._ZN60_$LT$alloc..string..String$u20$as$u20$core..clone..Clone$GT$5clone17h415f8832ba4c6f63E")
    *liballoc-*.rlib:*(".text._ZN58_$LT$alloc..string..String$u20$as$u20$core..fmt..Write$GT$9write_str17h4b62f46a222bd5b2E")
    *liballoc-*.rlib:*(".text._ZN58_$LT$alloc..string..String$u20$as$u20$core..fmt..Write$GT$10write_char17hfde5b685689164ccE")
    *libcore-*.rlib:*(".text._ZN4core3ptr26drop_in_place$LT$usize$GT$17h5739510b1afbdae5E")
    *libcore-*.rlib:*(".text._ZN4core3ptr37drop_in_place$LT$core..fmt..Error$GT$17ha026248e31a11692E")
    *libcore-*.rlib:*(".text._ZN72_$LT$core..num..error..TryFromIntError$u20$as$u20$core..fmt..Display$GT$3fmt17hbc9869a4fe3080f5E")
    *libcore-*.rlib:*(".text._ZN71_$LT$core..ops..range..Range$LT$Idx$GT$$u20$as$u20$core..fmt..Debug$GT$3fmt17hb4d8325772f511feE")
    *libcore-*.rlib:*(".text._ZN36_$LT$T$u20$as$u20$core..any..Any$GT$7type_id17h4929060c3423c41bE")
    *libcore-*.rlib:*(".text._ZN60_$LT$core..cell..BorrowError$u20$as$u20$core..fmt..Debug$GT$3fmt17h294c05841422bb75E")
    *libcore-*.rlib:*(".text._ZN63_$LT$core..cell..BorrowMutError$u20$as$u20$core..fmt..Debug$GT$3fmt17hf1ce37697cc17579E")
    *libcore-*.rlib:*(".text.unlikely._ZN4core4cell22panic_already_borrowed17heaf1d391c7e3ac3fE")
    *libcore-*.rlib:*(".text.unlikely._ZN4core4cell30panic_already_mutably_borrowed17h1b0d052ee073462cE")
    *libcore-*.rlib:*(".text._ZN4core4char7methods22_$LT$impl$u20$char$GT$16escape_debug_ext17h432481fd8a85ee26E")
    *libcore-*.rlib:*(".text.unlikely._ZN4core6option13unwrap_failed17h74c33646acebf943E")
    *libcore-*.rlib:*(".text.unlikely._ZN4core6option13expect_failed17h7e2cb204b05dab71E")
    *libcore-*.rlib:*(".text._ZN73_$LT$core..panic..panic_info..PanicInfo$u20$as$u20$core..fmt..Display$GT$3fmt17h4777505b2ae1d28dE")
    *libcore-*.rlib:*(".text.unlikely._ZN4core9panicking9panic_fmt17h0f7a5cdbeae7e874E")
    *libcore-*.rlib:*(".text.unlikely._ZN4core9panicking5panic17h0d41b9de9b340d2cE")
    *libcore-*.rlib:*(".text._ZN4core9panicking13panic_display17hc25466684451ad26E")
    *libcore-*.rlib:*(".text.unlikely._ZN4core9panicking18panic_bounds_check17h7ccbe16ef5157d86E")
    *libcore-*.rlib:*(".text.unlikely._ZN4core9panicking13assert_failed17h0bccda201990b6feE")
    *libcore-*.rlib:*(".text.unlikely._ZN4core9panicking19assert_failed_inner17hbe9d8d3e6281311cE")
    *libcore-*.rlib:*(".text.unlikely._ZN4core6result13unwrap_failed17h2dbd2ef42161686dE")
    *libcore-*.rlib:*(".text._ZN68_$LT$core..fmt..builders..PadAdapter$u20$as$u20$core..fmt..Write$GT$9write_str17hc0862e4b7f7f17f1E")
    *libcore-*.rlib:*(".text._ZN68_$LT$core..fmt..builders..PadAdapter$u20$as$u20$core..fmt..Write$GT$10write_char17h02e7db9e58475120E")
    *libcore-*.rlib:*(".text._ZN4core3fmt8builders11DebugStruct5field17ha37d013977aa91fdE")
    *libcore-*.rlib:*(".text._ZN4core3fmt8builders11DebugStruct21finish_non_exhaustive17hf554d15ace7a2712E")
    *libcore-*.rlib:*(".text._ZN4core3fmt8builders11DebugStruct6finish17h8fd3f9471c3ff6f0E")
    *libcore-*.rlib:*(".text._ZN4core3fmt8builders10DebugTuple5field17hf6b28860505edb28E")
    *libcore-*.rlib:*(".text._ZN4core3fmt8builders10DebugTuple6finish17he8ef120405a3623aE")
    *libcore-*.rlib:*(".text._ZN4core3fmt8builders8DebugSet5entry17hbdf59f8814adbd1dE")
    *libcore-*.rlib:*(".text._ZN4core3fmt8builders9DebugList6finish17he23fd077c2176cc5E")
    *libcore-*.rlib:*(".text._ZN4core3fmt5Write9write_fmt17h6837fd873343534aE")
    *libcore-*.rlib:*(".text._ZN59_$LT$core..fmt..Arguments$u20$as$u20$core..fmt..Display$GT$3fmt17h26470d47aac2b227E")
    *libcore-*.rlib:*(".text._ZN4core3fmt5write17h7d5c5d972f6bf082E")
    *libcore-*.rlib:*(".text._ZN4core3fmt9Formatter12pad_integral17heaa37964a6dd8056E")
    *libcore-*.rlib:*(".text._ZN4core3fmt9Formatter12pad_integral12write_prefix17hfbe5552cd6b30346E")
    *libcore-*.rlib:*(".text._ZN4core3fmt9Formatter3pad17h5907829474a9bceeE")
    *libcore-*.rlib:*(".text._ZN4core3fmt9Formatter9write_str17h97ca3d8b34e3baaaE")
    *libcore-*.rlib:*(".text._ZN4core3fmt9Formatter12debug_struct17h37580ee70d759b9aE")
    *libcore-*.rlib:*(".text._ZN4core3fmt9Formatter26debug_struct_field2_finish17h82b80710749c7cfaE")
    *libcore-*.rlib:*(".text._ZN4core3fmt9Formatter26debug_struct_fields_finish17h0d6f5eb6e5e3cf42E")
    *libcore-*.rlib:*(".text._ZN4core3fmt9Formatter11debug_tuple17hb3e7b749cdefa079E")
    *libcore-*.rlib:*(".text._ZN4core3fmt9Formatter25debug_tuple_field1_finish17h1ecb531db1e81cbcE")
    *libcore-*.rlib:*(".text._ZN4core3fmt9Formatter10debug_list17h2bcc3c1fc62b2501E")
    *libcore-*.rlib:*(".text._ZN43_$LT$bool$u20$as$u20$core..fmt..Display$GT$3fmt17h12fdd96791bf4720E")
    *libcore-*.rlib:*(".text._ZN40_$LT$str$u20$as$u20$core..fmt..Debug$GT$3fmt17hae48b4192ee269ddE")
    *libcore-*.rlib:*(".text._ZN42_$LT$str$u20$as$u20$core..fmt..Display$GT$3fmt17h0b6b1c0d11558f97E")
    *libcore-*.rlib:*(".text._ZN41_$LT$char$u20$as$u20$core..fmt..Debug$GT$3fmt17h1fe6a75374a14bbdE")
    *libcore-*.rlib:*(".text.unlikely._ZN4core5slice5index26slice_start_index_len_fail17hb959cdd5411bf208E")
    *libcore-*.rlib:*(".text._ZN4core5slice5index29slice_start_index_len_fail_rt17hce7760188b5b6773E")
    *libcore-*.rlib:*(".text.unlikely._ZN4core5slice5index24slice_end_index_len_fail17h3f8438963677f5b8E")
    *libcore-*.rlib:*(".text._ZN4core5slice5index27slice_end_index_len_fail_rt17h8c7011f54f8a6ea8E")
    *libcore-*.rlib:*(".text.unlikely._ZN4core5slice5index22slice_index_order_fail17hcc61bcee7ef2204dE")
    *libcore-*.rlib:*(".text._ZN4core5slice5index25slice_index_order_fail_rt17h8328cf0ce2de080cE")
    *libcore-*.rlib:*(".text._ZN4core3str8converts9from_utf817he402f91d70305d69E")
    *libcore-*.rlib:*(".text._ZN4core3str5count14do_count_chars17h482c90f559dea5ddE")
    *libcore-*.rlib:*(".text._ZN66_$LT$core..str..error..Utf8Error$u20$as$u20$core..fmt..Display$GT$3fmt17he47bb0dd3b9305e4E")
    *libcore-*.rlib:*(".text.unlikely._ZN4core3str16slice_error_fail17hf42b0f231ab5f2a3E")
    *libcore-*.rlib:*(".text._ZN4core3str19slice_error_fail_rt17h46e4f0f443d74f6aE")
    *libcore-*.rlib:*(".text._ZN4core7unicode9printable5check17hd49316ac30aef8eaE")
    *libcore-*.rlib:*(".text._ZN4core7unicode9printable12is_printable17hfc735d3bd1e2f4bdE")
    *libcore-*.rlib:*(".text.unlikely._ZN4core9panicking11panic_const24panic_const_add_overflow17hf6e3f7f30ea7b475E")
    *libcore-*.rlib:*(".text.unlikely._ZN4core9panicking11panic_const24panic_const_mul_overflow17hda4f409bbdb81e0fE")
    *libcore-*.rlib:*(".text._ZN4core3fmt3num52_$LT$impl$u20$core..fmt..LowerHex$u20$for$u20$i8$GT$3fmt17h9b21bb3d68d263e2E")
    *libcore-*.rlib:*(".text._ZN4core3fmt3num52_$LT$impl$u20$core..fmt..UpperHex$u20$for$u20$i8$GT$3fmt17hc21886e9f484c040E")
    *libcore-*.rlib:*(".text._ZN4core3fmt3num53_$LT$impl$u20$core..fmt..LowerHex$u20$for$u20$i32$GT$3fmt17hba592a4ed6a952beE")
    *libcore-*.rlib:*(".text._ZN4core3fmt3num53_$LT$impl$u20$core..fmt..UpperHex$u20$for$u20$i32$GT$3fmt17h119275f35091df64E")
    *libcore-*.rlib:*(".text._ZN4core3fmt3num53_$LT$impl$u20$core..fmt..LowerHex$u20$for$u20$i64$GT$3fmt17hd6e473fabd88c0e3E")
    *libcore-*.rlib:*(".text._ZN4core3fmt3num53_$LT$impl$u20$core..fmt..UpperHex$u20$for$u20$i64$GT$3fmt17h846afeb54ce0baf8E")
    *libcore-*.rlib:*(".text._ZN4core3fmt3num52_$LT$impl$u20$core..fmt..Debug$u20$for$u20$usize$GT$3fmt17h92ca3aff4bf1c48dE")
    *libcore-*.rlib:*(".text._ZN4core3fmt3num3imp7fmt_u6417h1a8e9846ca374650E")
    *libcore-*.rlib:*(".text._ZN4core3fmt3num3imp51_$LT$impl$u20$core..fmt..Display$u20$for$u20$u8$GT$3fmt17h3fdeac06436d4c67E")
    *libcore-*.rlib:*(".text._ZN4core3fmt3num3imp52_$LT$impl$u20$core..fmt..Display$u20$for$u20$i32$GT$3fmt17hb00e11d2392487b4E")
    *libcore-*.rlib:*(".text._ZN4core3fmt3num3imp52_$LT$impl$u20$core..fmt..Display$u20$for$u20$u32$GT$3fmt17hdf9bfd9306a960f1E")
    *libcore-*.rlib:*(".text._ZN4core3fmt3num3imp52_$LT$impl$u20$core..fmt..Display$u20$for$u20$i64$GT$3fmt17h910bef7c5c363c6cE")
    *libcore-*.rlib:*(".text._ZN4core3fmt3num3imp52_$LT$impl$u20$core..fmt..Display$u20$for$u20$u64$GT$3fmt17h507b2a1c734f693aE")
    *libcore-*.rlib:*(".text._ZN42_$LT$$RF$T$u20$as$u20$core..fmt..Debug$GT$3fmt17h5cebf789a726af6bE")
    *libcore-*.rlib:*(".text._ZN42_$LT$$RF$T$u20$as$u20$core..fmt..Debug$GT$3fmt17hba22cabdf2fe6533E")
    *libcore-*.rlib:*(".text._ZN44_$LT$$RF$T$u20$as$u20$core..fmt..Display$GT$3fmt17had943f84706d0d41E")
    *libcore-*.rlib:*(".text._ZN4core7unicode12unicode_data15grapheme_extend11lookup_slow17hcf98483823ff1d10E")
    *libcompiler_builtins-*.rlib:*(".text.__fixunsdfdi")
    *libcompiler_builtins-*.rlib:*(".text.memcpy")
    *libcompiler_builtins-*.rlib:*(".text.memmove")
    *libcompiler_builtins-*.rlib:*(".text.memset")
    *libcompiler_builtins-*.rlib:*(".text.memcmp")
    *libcompiler_builtins-*.rlib:*(".text.__floatundidf")
    *libcompiler_builtins-*.rlib:*(".text.__muldf3")
    *libcompiler_builtins-*.rlib:*(".text._ZN17compiler_builtins5float3mul8__muldf317hccb5c4c520220eeaE")
    *libcompiler_builtins-*.rlib:*(".text.__udivti3")
    *libcompiler_builtins-*.rlib:*(".text._ZN17compiler_builtins3int19specialized_div_rem12u128_div_rem17h8126f7c9bea9df73E")
    *libcompiler_builtins-*.rlib:*(".text.__lshrti3")
    *libcompiler_builtins-*.rlib:*(".text.__multi3")
    *libcompiler_builtins-*.rlib:*(".text.__gtdf2")
    *libcompiler_builtins-*.rlib:*(".text.__gedf2")
    *libcompiler_builtins-*.rlib:*(".text.__ashlti3")
    *(.text*)
  } :text
  .rodata : { *(.rodata*) } :rodata
  .data.rel.ro : { *(.data.rel.ro*) } :rodata
  .dynamic : { *(.dynamic) } :dynamic
  .dynsym : { *(.dynsym) } :data
  .dynstr : { *(.dynstr) } :data
  .rel.dyn : { *(.rel.dyn) } :data
  /DISCARD/ : {
      *(.eh_frame*)
      *(.gnu.hash*)
      *(.hash*)
    }
}
